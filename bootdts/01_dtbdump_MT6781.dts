/dts-v1/;

/ {
	#address-cells = <0x2>;
	#size-cells = <0x2>;
	compatible = "mediatek,MT6781";
	interrupt-parent = <0x1>;
	model = "MT6781";

	2x1_sub_common@1502f000 {
		clock-names = "scp-isp";
		clocks = <0x2d 0x5>;
		common-clamp = <0x1>;
		compatible = "mediatek,2x1_sub_common", "mediatek,smi_common";
		mediatek,smi-id = <0x1c>;
		reg = <0x0 0x1502f000 0x0 0x1000>;
	};

	__symbols__ {
		accdet = "/accdet";
		adsp_common = "/adsp_common@10600000";
		adsp_core0 = "/adsp_core0@10610000";
		afe = "/mt6781-afe-pcm@11210000";
		apdma = "/dma-controller@10200d80";
		apmixed = "/apmixed@1000c000";
		apuart0 = "/serial@11002000";
		apuart1 = "/serial@11003000";
		aud_clk_mosi_off = "/pinctrl/aud_clk_mosi_off";
		aud_clk_mosi_on = "/pinctrl/aud_clk_mosi_on";
		aud_dat_miso0_off = "/pinctrl/aud_dat_miso0_off";
		aud_dat_miso0_on = "/pinctrl/aud_dat_miso0_on";
		aud_dat_miso1_off = "/pinctrl/aud_dat_miso1_off";
		aud_dat_miso1_on = "/pinctrl/aud_dat_miso1_on";
		aud_dat_mosi_off = "/pinctrl/aud_dat_mosi_off";
		aud_dat_mosi_on = "/pinctrl/aud_dat_mosi_on";
		aud_gpio_i2s0_off = "/pinctrl/aud_gpio_i2s0_off";
		aud_gpio_i2s0_on = "/pinctrl/aud_gpio_i2s0_on";
		aud_gpio_i2s1_off = "/pinctrl/aud_gpio_i2s1_off";
		aud_gpio_i2s1_on = "/pinctrl/aud_gpio_i2s1_on";
		aud_gpio_i2s2_off = "/pinctrl/aud_gpio_i2s2_off";
		aud_gpio_i2s2_on = "/pinctrl/aud_gpio_i2s2_on";
		aud_gpio_i2s3_off = "/pinctrl/aud_gpio_i2s3_off";
		aud_gpio_i2s3_on = "/pinctrl/aud_gpio_i2s3_on";
		audio = "/audio@11210000";
		auxadc = "/auxadc@11001000";
		bat_gm30 = "/battery";
		boot_dramboost = "/boot_dramboost";
		btcvsd_snd = "/mtk-btcvsd-snd@18050000";
		btif = "/btif@1100c000";
		bus26m = "/mtk_lpm/resource-ctrl-list/bus26m";
		camera_af_node = "/camera_af_node";
		camisp = "/camisp@1a000000";
		camsys = "/camsys@1a000000";
		camsys_a = "/camsys_a@1a04f000";
		camsys_b = "/camsys_b@1a06f000";
		camsys_c = "/camsys_c@1a08f000";
		camsys_rawa = "/camsys_rawa@1a04f000";
		camsys_rawb = "/camsys_rawb@1a06f000";
		charger = "/charger";
		chosen = "/chosen";
		clk13m = "/clocks/clk13m";
		clk26m = "/clocks/clk26m";
		clk32k = "/clocks/clk32k";
		clk_null = "/clocks/clk_null";
		clkitg = "/clkitg";
		clusteroff_b = "/cpus/idle-states/clusteroff_b";
		clusteroff_l = "/cpus/idle-states/clusteroff_l";
		consys = "/consys@18002000";
		consys_pins_default = "/pinctrl/consys_default";
		cp_qc30 = "/cp_qc30";
		cpu0 = "/cpus/cpu@000";
		cpu1 = "/cpus/cpu@001";
		cpu2 = "/cpus/cpu@002";
		cpu3 = "/cpus/cpu@003";
		cpu4 = "/cpus/cpu@100";
		cpu5 = "/cpus/cpu@101";
		cpu6 = "/cpus/cpu@102";
		cpu7 = "/cpus/cpu@103";
		cpumssv = "/cpumssv";
		cpuoff_b = "/cpus/idle-states/cpuoff_b";
		cpuoff_l = "/cpus/idle-states/cpuoff_l";
		cpupm_sysram = "/mtk_lpm/cpupm-sysram@0011b000";
		dcm = "/dcm@10001000";
		dfd = "/dfd";
		dfd_cache = "/dfd_cache";
		disp_aal0 = "/disp_aal0@1400c000";
		disp_ccorr0 = "/disp_ccorr0@1400b000";
		disp_color0 = "/disp_color0@14009000";
		disp_dither0 = "/disp_dither0@1400f000";
		disp_dsc_wrap = "/disp_dsc_wrap@14012000";
		disp_gamma0 = "/disp_gamma0@1400d000";
		disp_mutex0 = "/disp_mutex@14001000";
		disp_ovl0 = "/disp_ovl0@14005000";
		disp_ovl0_2l = "/disp_ovl0_2l@14006000";
		disp_postmask0 = "/disp_postmask0@1400e000";
		disp_pwm = "/disp_pwm0@1100e000";
		disp_rdma0 = "/disp_rdma0@14007000";
		disp_rsz0 = "/disp_rsz0@14008000";
		disp_wdma0 = "/disp_wdma0@14014000";
		dispsys_config = "/dispsys_config@14000000";
		doe_dvfs_cl0 = "/cpus/cpu-map/cluster0/doe";
		doe_dvfs_cl1 = "/cpus/cpu-map/cluster1/doe";
		dpmaif = "/dpmaif@10014000";
		dram_s0 = "/mtk_lpm/resource-ctrl-list/dram_s0";
		dram_s1 = "/mtk_lpm/resource-ctrl-list/dram_s1";
		dsi0 = "/dsi@14013000";
		dsi_te = "/dsi_te";
		dvfsp = "/dvfsp@0011bc00";
		dvfsrc = "/dvfsrc@10012000";
		edge_keypad = "/mtk_lpm/irq-remain-list/edge_keypad";
		edge_mdwdt = "/mtk_lpm/irq-remain-list/edge_mdwdt";
		eem_fsm = "/eem_fsm@1100b000";
		eint = "/apirq@1000b000";
		emicen = "/emicen@10219000";
		emichn = "/emichn@10225000";
		flashlight_core = "/flashlight_core";
		flashlights_mt6370 = "/flashlights_mt6370";
		flashlights_ocp8132 = "/flashlights_ocp8132";
		fpsensor_finger = "/fpsensor_finger";
		fpsensor_fp_eint = "/fpsensor_fp_eint";
		gce_mbox = "/gce_mbox@1022c000";
		gce_mbox_sec = "/gce_mbox_sec@1022c000";
		gic = "/interrupt-controller";
		gpio = "/gpio@10005000";
		gpio_usage_mapping = "/gpio_usage_mapping";
		gps = "/gps@18c00000";
		gpslna_pins_init = "/pinctrl/gpslna@0";
		gpslna_pins_oh = "/pinctrl/gpslna@1";
		gpslna_pins_ol = "/pinctrl/gpslna@2";
		gyro = "/gyro";
		haptic_gpio_aw8622_default = "/pinctrl/haptic_gpio_aw8622_default@gpio171";
		haptic_gpio_aw8622_set = "/pinctrl/haptic_gpio_aw8622_set@gpio171";
		hwrng = "/hwrng";
		i2c0 = "/i2c0@11007000";
		i2c1 = "/i2c1@11008000";
		i2c2 = "/i2c2@11009000";
		i2c3 = "/i2c3@1100f000";
		i2c4 = "/i2c4@11011000";
		i2c5 = "/i2c5@11016000";
		i2c6 = "/i2c6@1100d000";
		i2c7 = "/i2c7@11004000";
		i2c8 = "/i2c8@11005000";
		i2c9 = "/i2c9@11019000";
		i2c_common = "/i2c_common";
		imgsys1 = "/imgsys1@15020000";
		imgsys2 = "/imgsys2@15820000";
		imgsys_config = "/imgsys_config@15020000";
		imp_iic_wrap = "/imp_iic_wrap@11017000";
		infra = "/mtk_lpm/resource-ctrl-list/infra";
		infracfg_ao = "/infracfg_ao@10001000";
		iocfg_bl = "/iocfg_bl@10002600";
		iocfg_bm = "/iocfg_bm@10002800";
		iocfg_lb = "/iocfg_lb@10002400";
		iocfg_lm = "/iocfg_lm@10002200";
		iocfg_lt = "/iocfg_lt@10002000";
		iocfg_rm = "/iocfg_rm@10002A00";
		iocfg_rt = "/iocfg_rt@10002C00";
		iocfg_tl = "/iocfg_tl@10002E00";
		iommu0 = "/m4u@14016000";
		iommu0_bank1 = "/m4u@14017000";
		iommu0_bank2 = "/m4u@14018000";
		iommu0_bank3 = "/m4u@14019000";
		iommu0_sec = "/m4u@1401a000";
		ion = "/iommu";
		ipesys = "/ipesys@1c000000";
		irq_nfc = "/irq_nfc";
		irtx_pwm = "/irtx_pwm";
		kd_camera_hw1 = "/kd_camera_hw1@1a004000";
		keypad = "/kp@10010000";
		level_btif_rx = "/mtk_lpm/irq-remain-list/level_btif_rx";
		level_btif_tx = "/mtk_lpm/irq-remain-list/level_btif_tx";
		lk_charger = "/lk_charger";
		lpm_sysram = "/mtk_lpm/lpm_sysram@0011b500";
		main_pmic = "/pwrap@1000d000/mt6358-pmic";
		mali = "/mali@13000000";
		maxim_ds28e16 = "/maxim_ds28e16";
		mcucfg = "/mcucfg@0c530000";
		mcusys_ctrl = "/mtk_lpm/mcusys-ctrl@0c53a000";
		mcusysoff = "/cpus/idle-states/mcusysoff";
		md1_sim1_hot_plug_eint = "/md1_sim1_hot_plug_eint";
		md1_sim2_hot_plug_eint = "/md1_sim2_hot_plug_eint";
		md_auxadc = "/md_auxadc";
		mddriver = "/mddriver";
		mdp_aal0 = "/mdp_aal0@1b005000";
		mdp_hdr0 = "/mdp_hdr0@1b007000";
		mdp_mutex = "/mdp_mutex@1b001000";
		mdp_rdma0 = "/mdp_rdma0@1b003000";
		mdp_rsz0 = "/mdp_rsz@1b008000";
		mdp_rsz1 = "/mdp_rsz1@1bf009000";
		mdp_tdshp0 = "/mdp_tdshp0@1b00c000";
		mdp_wrot0 = "/mdp_wrot0@1b00a000";
		mdp_wrot1 = "/mdp_wrot1@1b00b000";
		mdpsys_config = "/mdpsys_config@1b000000";
		memory_ssmr_features = "/memory-ssmr-features";
		mfgcfg = "/mfgcfg@13fbf000";
		mipi_tx_config0 = "/mipi_tx_config@11c80000";
		mmdvfs = "/mmdvfs_pmqos";
		mmqos = "/mmqos";
		mmsys_config = "/syson@14000000";
		mrdump_ext_rst = "/mrdump_ext_rst";
		msdc0 = "/msdc0@11230000";
		msdc0_pins_default = "/pinctrl/msdc0@default";
		msdc0_pins_hs200 = "/pinctrl/msdc0@hs200";
		msdc0_pins_hs400 = "/pinctrl/msdc0@hs400";
		msdc0_register_setting_default = "/pinctrl/msdc0@register_default";
		msdc1 = "/msdc1@11240000";
		msdc1_ins = "/msdc1_ins";
		msdc1_pins_ddr50 = "/pinctrl/msdc1@ddr50";
		msdc1_pins_default = "/pinctrl/msdc1@default";
		msdc1_pins_hs200 = "/pinctrl/msdc1@hs200";
		msdc1_pins_sdr104 = "/pinctrl/msdc1@sdr104";
		msdc1_pins_sdr50 = "/pinctrl/msdc1@sdr50";
		msdc1_register_setting_default = "/pinctrl/msdc1@register_default";
		mt6358_misc = "/pwrap@1000d000/mt6358-pmic/mt6358_misc";
		mt6358_rtc = "/pwrap@1000d000/mt6358-pmic/mt6358_rtc";
		mt6358regulator = "/pwrap@1000d000/mt6358-pmic/mt6358regulator";
		mt6366_snd = "/mt6366_snd";
		mt6370_pmu = "/mt6370_pmu_dts";
		mt6370_typec = "/type_c_port0";
		mt_charger = "/mt_charger";
		mt_cpufreq = "/mt_cpufreq";
		mt_pmic_va09_ldo_reg = "/pwrap@1000d000/mt6358-pmic/mt6358regulator/ldo_va09";
		mt_pmic_va12_ldo_reg = "/pwrap@1000d000/mt6358-pmic/mt6358regulator/ldo_va12";
		mt_pmic_vaud28_ldo_reg = "/pwrap@1000d000/mt6358-pmic/mt6358regulator/ldo_vaud28";
		mt_pmic_vaux18_ldo_reg = "/pwrap@1000d000/mt6358-pmic/mt6358regulator/ldo_vaux18";
		mt_pmic_vbif28_ldo_reg = "/pwrap@1000d000/mt6358-pmic/mt6358regulator/ldo_vbif28";
		mt_pmic_vcn18_ldo_reg = "/pwrap@1000d000/mt6358-pmic/mt6358regulator/ldo_vcn18";
		mt_pmic_vcn28_ldo_reg = "/pwrap@1000d000/mt6358-pmic/mt6358regulator/ldo_vcn28";
		mt_pmic_vcn33_bt_ldo_reg = "/pwrap@1000d000/mt6358-pmic/mt6358regulator/ldo_vcn33_bt";
		mt_pmic_vcn33_wifi_ldo_reg = "/pwrap@1000d000/mt6358-pmic/mt6358regulator/ldo_vcn33_wifi";
		mt_pmic_vcore_buck_reg = "/pwrap@1000d000/mt6358-pmic/mt6358regulator/buck_vcore";
		mt_pmic_vdram1_buck_reg = "/pwrap@1000d000/mt6358-pmic/mt6358regulator/buck_vdram1";
		mt_pmic_vdram2_ldo_reg = "/pwrap@1000d000/mt6358-pmic/mt6358regulator/ldo_vdram2";
		mt_pmic_vefuse_ldo_reg = "/pwrap@1000d000/mt6358-pmic/mt6358regulator/ldo_vefuse";
		mt_pmic_vemc_ldo_reg = "/pwrap@1000d000/mt6358-pmic/mt6358regulator/ldo_vemc";
		mt_pmic_vfe28_ldo_reg = "/pwrap@1000d000/mt6358-pmic/mt6358regulator/ldo_vfe28";
		mt_pmic_vgpu_buck_reg = "/pwrap@1000d000/mt6358-pmic/mt6358regulator/buck_vgpu";
		mt_pmic_vibr_ldo_reg = "/pwrap@1000d000/mt6358-pmic/mt6358regulator/ldo_vibr";
		mt_pmic_vio18_ldo_reg = "/pwrap@1000d000/mt6358-pmic/mt6358regulator/ldo_vio18";
		mt_pmic_vio28_ldo_reg = "/pwrap@1000d000/mt6358-pmic/mt6358regulator/ldo_vio28";
		mt_pmic_vmc_ldo_reg = "/pwrap@1000d000/mt6358-pmic/mt6358regulator/ldo_vmc";
		mt_pmic_vmch_ldo_reg = "/pwrap@1000d000/mt6358-pmic/mt6358regulator/ldo_vmch";
		mt_pmic_vmodem_buck_reg = "/pwrap@1000d000/mt6358-pmic/mt6358regulator/buck_vmodem";
		mt_pmic_vpa_buck_reg = "/pwrap@1000d000/mt6358-pmic/mt6358regulator/buck_vpa";
		mt_pmic_vproc11_buck_reg = "/pwrap@1000d000/mt6358-pmic/mt6358regulator/buck_vproc11";
		mt_pmic_vproc12_buck_reg = "/pwrap@1000d000/mt6358-pmic/mt6358regulator/buck_vproc12";
		mt_pmic_vrf12_ldo_reg = "/pwrap@1000d000/mt6358-pmic/mt6358regulator/ldo_vrf12";
		mt_pmic_vrf18_ldo_reg = "/pwrap@1000d000/mt6358-pmic/mt6358regulator/ldo_vrf18";
		mt_pmic_vs1_buck_reg = "/pwrap@1000d000/mt6358-pmic/mt6358regulator/buck_vs1";
		mt_pmic_vs2_buck_reg = "/pwrap@1000d000/mt6358-pmic/mt6358regulator/buck_vs2";
		mt_pmic_vsim1_ldo_reg = "/pwrap@1000d000/mt6358-pmic/mt6358regulator/ldo_vsim1";
		mt_pmic_vsim2_ldo_reg = "/pwrap@1000d000/mt6358-pmic/mt6358regulator/ldo_vsim2";
		mt_pmic_vsram_core_ldo_reg = "/pwrap@1000d000/mt6358-pmic/mt6358regulator/ldo_vsram_core";
		mt_pmic_vsram_gpu_ldo_reg = "/pwrap@1000d000/mt6358-pmic/mt6358regulator/ldo_vsram_gpu";
		mt_pmic_vsram_others_ldo_reg = "/pwrap@1000d000/mt6358-pmic/mt6358regulator/ldo_vsram_others";
		mt_pmic_vsram_proc11_ldo_reg = "/pwrap@1000d000/mt6358-pmic/mt6358regulator/ldo_vsram_proc11";
		mt_pmic_vsram_proc12_ldo_reg = "/pwrap@1000d000/mt6358-pmic/mt6358regulator/ldo_vsram_proc12";
		mt_pmic_vusb_ldo_reg = "/pwrap@1000d000/mt6358-pmic/mt6358regulator/ldo_vusb";
		mt_pmic_vxo22_ldo_reg = "/pwrap@1000d000/mt6358-pmic/mt6358regulator/ldo_vxo22";
		mtk_lpm = "/mtk_lpm";
		mtkfb = "/mtkfb@0";
		nfc = "/nfc";
		odm = "/odm";
		onewire_gpio = "/onewire_gpio";
		onewire_gpio_active = "/pinctrl/onewire_gpio_active@gpio14";
		onewire_gpio_sleep = "/pinctrl/onewire_gpio_sleep@gpio14";
		pd_adapter = "/pd_adapter";
		pericfg = "/pericfg@10003000";
		pio = "/pinctrl";
		pmic = "/pwrap@1000d000/mt6358-pmic/mt-pmic";
		pmic_auxadc = "/pwrap@1000d000/mt6358-pmic/mt635x-auxadc";
		pmic_clock_buffer_ctrl = "/pmic_clock_buffer_ctrl";
		pmic_oc_debug = "/pwrap@1000d000/mt6358-pmic/pmic-oc-debug";
		pwrap = "/pwrap@1000d000";
		pwraph = "/pwraphal@";
		radio_md_cfg = "/radio_md_cfg";
		rc_bus26m = "/mtk_lpm/constraint-list/rc_bus26m";
		rc_dram = "/mtk_lpm/constraint-list/rc_dram";
		rc_syspll = "/mtk_lpm/constraint-list/rc_syspll";
		reserved_memory = "/reserved-memory";
		rt1711_typec = "/rt1711_type_c_port0";
		rt5133 = "/i2c5@11016000/rt5133@18";
		rt5133_eint = "/odm/rt5133_eint";
		rt5133_gpio1 = "/odm/rt5133-gpio1";
		rt5133_gpio2 = "/odm/rt5133-gpio2";
		rt5133_gpio3 = "/odm/rt5133-gpio3";
		rt5133_ldo1 = "/i2c5@11016000/rt5133@18/regulators/LDO1";
		rt5133_ldo2 = "/i2c5@11016000/rt5133@18/regulators/LDO2";
		rt5133_ldo3 = "/i2c5@11016000/rt5133@18/regulators/LDO3";
		rt5133_ldo4 = "/i2c5@11016000/rt5133@18/regulators/LDO4";
		rt5133_ldo5 = "/i2c5@11016000/rt5133@18/regulators/LDO5";
		rt5133_ldo6 = "/i2c5@11016000/rt5133@18/regulators/LDO6";
		rt5133_ldo7 = "/i2c5@11016000/rt5133@18/regulators/LDO7";
		rt5133_ldo8 = "/i2c5@11016000/rt5133@18/regulators/LDO8";
		s2idle = "/cpus/idle-states/s2idle";
		scpsys = "/scpsys@10001000";
		seninf_n3d_top = "/seninf_n3d_top@1a004000";
		simtray = "/simtray";
		sleep = "/sleep@10006000";
		smart_pa = "/smart_pa";
		smi_larb0 = "/smi_larb0@14003000";
		smi_larb1 = "/smi_larb1@14004000";
		smi_larb11 = "/smi_larb11@1582e000";
		smi_larb13 = "/smi_larb13@1a001000";
		smi_larb14 = "/smi_larb14@1a002000";
		smi_larb16 = "/smi_larb16@1a00f000";
		smi_larb17 = "/smi_larb17@1a010000";
		smi_larb18 = "/smi_larb18@1a011000";
		smi_larb19 = "/smi_larb19@1c10f000";
		smi_larb2 = "/smi_larb2@1b002000";
		smi_larb20 = "/smi_larb20@1c00f000";
		smi_larb4 = "/smi_larb4@1602e000";
		smi_larb7 = "/smi_larb7@17010000";
		smi_larb9 = "/smi_larb9@1502e000";
		snd_audio_dsp = "/snd_audio_dsp";
		snd_scp_ultra = "/snd_scp_ultra";
		sound = "/sound";
		speaker_amp = "/i2c6@1100d000/speaker_amp@34";
		spi0 = "/spi0@1100a000";
		spi1 = "/spi1@11010000";
		spi2 = "/spi2@11012000";
		spi3 = "/spi3@11013000";
		spi4 = "/spi4@11014000";
		spi5 = "/spi5@11015000";
		spmtwam = "/spmtwam@10006000";
		subpmic_pmu_eint = "/mt6370_pmu_eint";
		swtp = "/swtp";
		syspll = "/mtk_lpm/resource-ctrl-list/syspll";
		tboard_thermistor1 = "/thermal-sensor1";
		tboard_thermistor2 = "/thermal-sensor2";
		thermal_message = "/thermal-message";
		timer = "/timer";
		topckgen = "/topckgen@10000000";
		toprgu = "/toprgu@10007000";
		touch = "/touch";
		udi = "/udi@10005000";
		ufshci = "/ufshci@11270000";
		usbpd_pm = "/usbpd_pm";
		vcu = "/vcu@16000000";
		vdec_fmt = "/vdec_fmt@16080000";
		vdec_gcon = "/vdec_gcon@1602f000";
		vdec_gcon_clk = "/vdec_gcon@16010000";
		venc_gcon = "/venc_gcon@17000000";
		vow_clk_miso_off = "/pinctrl/vow_clk_miso_off";
		vow_clk_miso_on = "/pinctrl/vow_clk_miso_on";
		vow_dat_miso_off = "/pinctrl/vow_dat_miso_off";
		vow_dat_miso_on = "/pinctrl/vow_dat_miso_on";
		wifi_mem = "/reserved-memory/wifi-reserve-memory";
		xiaomi_touch = "/xiaomi_touch";
	};

	accdet {
		compatible = "mediatek,pmic-accdet";
		mediatek,accdet-pmic = <0x66>;
		phandle = <0xd9>;
	};

	adsp_common@10600000 {
		adsp-rsv-audio = <0x5c0000>;
		adsp-rsv-core-dump-a = <0x400>;
		adsp-rsv-dbg-dump-a = <0x80000>;
		adsp-rsv-ipidma-a = <0x200000>;
		adsp-rsv-logger-a = <0x80000>;
		clock-names = "clk_adsp_infra_26m", "clk_adsp_infra_32k", "clk_adsp_infra", "clk_top_adsp_sel", "clk_adsp_clk26m", "clk_top_adsppll_ck";
		clocks = <0x30 0x6c 0x30 0x6d 0x30 0x68 0x21 0x30 0x20 0x21 0x75>;
		compatible = "mediatek,adsp_common";
		phandle = <0xdd>;
		reg = <0x0 0x10001000 0x0 0x1000 0x0 0x10003000 0x0 0x1000>;
	};

	adsp_core0@10610000 {
		compatible = "mediatek,adsp_core_0";
		interrupts = <0x0 0xf0 0x4 0x0 0xef 0x4>;
		phandle = <0xde>;
		reg = <0x0 0x10600000 0x0 0x10000 0x0 0x10630000 0x0 0x9000 0x0 0x10610000 0x0 0x8000>;
		system = <0x0 0x56000000 0x0 0x700000>;
	};

	aes_top0@10016000 {
		compatible = "mediatek,aes_top0";
		reg = <0x0 0x10016000 0x0 0x1000>;
	};

	aliases {
		ccorr0 = "/disp_ccorr0@1400b000";
		dsi0 = "/dsi@14013000";
		ovl0 = "/disp_ovl0@14005000";
		ovl3 = "/disp_ovl0_2l@14006000";
		rdma0 = "/disp_rdma0@14007000";
	};

	amms_control {
		compatible = "mediatek,amms";
		interrupts = <0x0 0x155 0x1>;
	};

	ant_check {
		ant_check_gpio = <0x22 0xd 0x0>;
		compatible = "longcheer,ant_check";
	};

	ap_ccif0@10209000 {
		compatible = "mediatek,ap_ccif0";
		reg = <0x0 0x10209000 0x0 0x1000>;
	};

	ap_ccif1@1020b000 {
		compatible = "mediatek,ap_ccif1";
		reg = <0x0 0x1020b000 0x0 0x1000>;
	};

	ap_ccif2@1023c000 {
		compatible = "mediatek,ap_ccif2";
		reg = <0x0 0x1023c000 0x0 0x1000>;
	};

	ap_ccif3@1023e000 {
		compatible = "mediatek,ap_ccif3";
		reg = <0x0 0x1023e000 0x0 0x1000>;
	};

	ap_ccif4@10211000 {
		compatible = "mediatek,ap_ccif4";
		reg = <0x0 0x10211000 0x0 0x1000>;
	};

	ap_uart2@11018000 {
		compatible = "mediatek,ap_uart2";
		reg = <0x0 0x11018000 0x0 0x1000>;
	};

	apcldmain_ao@10014000 {
		compatible = "mediatek,apcldmain_ao";
		reg = <0x0 0x10014000 0x0 0x400>;
	};

	apcldmamisc_ao@10014800 {
		compatible = "mediatek,apcldmamisc_ao";
		reg = <0x0 0x10014800 0x0 0x400>;
	};

	apcldmamisc_ao@10014c00 {
		compatible = "mediatek,apcldmamisc_ao";
		reg = <0x0 0x10014c00 0x0 0x400>;
	};

	apcldmaout_ao@10014400 {
		compatible = "mediatek,apcldmaout_ao";
		reg = <0x0 0x10014400 0x0 0x400>;
	};

	apirq@1000b000 {
		compatible = "mediatek,apirq";
		phandle = <0x2c>;
		reg = <0x0 0x1000b000 0x0 0x1000>;
	};

	apmixed@1000c000 {
		#clock-cells = <0x1>;
		compatible = "mediatek,apmixed", "syscon";
		phandle = <0x40>;
		reg = <0x0 0x1000c000 0x0 0x1000>;
	};

	apxgpt@10008000 {
		compatible = "mediatek,apxgpt";
		mediatek,kick_off = <0xb4>;
		reg = <0x0 0x10008000 0x0 0x1000>;
	};

	atf_logger {
		compatible = "mediatek,atf_logger";
	};

	audio@11210000 {
		#clock-cells = <0x1>;
		compatible = "mediatek,audio", "syscon";
		phandle = <0x41>;
		reg = <0x0 0x11210000 0x0 0x2000>;
	};

	audio_sram@11212000 {
		block_size = <0x1000>;
		compatible = "mediatek,audio_sram";
		mode_size = <0x9c00 0xd000>;
		prefer_mode = <0x0>;
		reg = <0x0 0x11212000 0x0 0xd000>;
	};

	auxadc@11001000 {
		#io-channel-cells = <0x1>;
		clock-names = "main";
		clocks = <0x30 0x24>;
		compatible = "mediatek,mt6768-auxadc";
		interrupts = <0x0 0x42 0x2>;
		mediatek,cali-efuse-index = <0x6a>;
		mediatek,cali-en-bit = <0x14>;
		mediatek,cali-ge-bit = <0xa>;
		mediatek,cali-oe-bit = <0x0>;
		phandle = <0x3b>;
		reg = <0x0 0x11001000 0x0 0x1000>;
	};

	aw8622 {
		center_freq = <0xd0>;
		compatible = "awinic,aw8622";
		default_pwm_freq = <0x6590>;
		hwen-gpio = <0x22 0xad 0x0>;
		pinctrl-0 = <0x97>;
		pinctrl-1 = <0x98>;
		pinctrl-names = "haptic_gpio_aw8622_default", "haptic_gpio_aw8622_set";
		pwm_ch = <0x0>;
		status = "okay";
		waveform_sample_period = <0xa2c2>;
	};

	battery {
		ACTIVE_TABLE = <0x0>;
		CAR_TUNE_VALUE = <0x64>;
		COM_FG_METER_RESISTANCE = <0x64>;
		COM_R_FG_VALUE = <0x0>;
		DIFFERENCE_FULLOCV_ITH = <0xfa>;
		EMBEDDED_SEL = <0x1>;
		FG_METER_RESISTANCE = <0x64>;
		KEEP_100_PERCENT = <0x1>;
		MULTI_TEMP_GAUGE0 = <0x1>;
		PMIC_MIN_VOL = <0x82dc>;
		PMIC_SHUTDOWN_CURRENT = <0x14>;
		POWERON_SYSTEM_IBOOT = <0x1f4>;
		Q_MAX_SYS_VOLTAGE_BAT0 = <0xd16>;
		Q_MAX_SYS_VOLTAGE_BAT1 = <0xd16>;
		Q_MAX_SYS_VOLTAGE_BAT2 = <0xd16>;
		Q_MAX_SYS_VOLTAGE_BAT3 = <0xd16>;
		R_FG_VALUE = <0x5>;
		SHUTDOWN_1_TIME = <0x1e>;
		SHUTDOWN_GAUGE0_VOLTAGE = <0x84d0>;
		TEMPERATURE_T0 = <0x32>;
		TEMPERATURE_T1 = <0x19>;
		TEMPERATURE_T2 = <0xa>;
		TEMPERATURE_T3 = <0x0>;
		TEMPERATURE_T4 = <0xfffffff6>;
		compatible = "mediatek,bat_gm30";
		enable_tmp_intr_suspend = <0x0>;
		g_FG_PSEUDO100 = <0x5e 0x5e 0x5e 0x64 0x5e 0x5e 0x5e 0x64 0x5e 0x5e 0x5e 0x64 0x5b 0x56 0x5e 0x64 0x57 0x50 0x5a 0x64 0x64 0x64 0x61 0x64 0x64 0x64 0x61 0x64 0x64 0x64 0x61 0x64 0x64 0x64 0x61 0x64 0x64 0x64 0x61 0x64>;
		g_FG_PSEUDO100_T0 = <0x61>;
		g_FG_PSEUDO100_T1 = <0x61>;
		g_FG_PSEUDO100_T2 = <0x61>;
		g_FG_PSEUDO100_T3 = <0x5a>;
		g_FG_PSEUDO100_T4 = <0x56>;
		g_FG_PSEUDO100_col = <0xa>;
		g_FG_PSEUDO100_row = <0x4>;
		g_PMIC_MIN_VOL = <0x82dc 0x82dc 0x82dc 0x82dc 0x80e8 0x80e8 0x80e8 0x80e8 0x82dc 0x82dc 0x8462 0x82dc 0x7dc8 0x7dc8 0x82dc 0x7dc8 0x7918 0x7918 0x82dc 0x7918 0x7b0c 0x7b0c 0x7b0c 0x7b0c 0x7918 0x7918 0x7918 0x7918 0x7918 0x7918 0x7918 0x7918 0x7918 0x7918 0x7918 0x7918 0x7918 0x7918 0x7918 0x79e0>;
		g_PMIC_MIN_VOL_col = <0xa>;
		g_PMIC_MIN_VOL_row = <0x4>;
		g_PON_SYS_IBOOT = <0x1388 0x1388 0x1388 0x1388 0x1388 0x1388 0x1388 0x1388 0x1388 0x1388 0x1388 0x1388 0x1388 0x1388 0x1388 0x1388 0x1388 0x1388 0x1388 0x1388 0x1388 0x1388 0x1388 0x1388 0x1388 0x1388 0x1388 0x1388 0x1388 0x1388 0x1388 0x1388 0x1388 0x1388 0x1388 0x1388 0x1388 0x1388 0x1388 0x1388>;
		g_PON_SYS_IBOOT_col = <0xa>;
		g_PON_SYS_IBOOT_row = <0x4>;
		g_QMAX_SYS_VOL = <0x8886 0x8886 0x8886 0x8886 0x8886 0x8886 0x8886 0x8886 0x8886 0x8886 0x8886 0x85ca 0x8886 0x8886 0x8886 0x85ca 0x8822 0x8822 0x8822 0x85ca 0x7ef4 0x7ef4 0x7ef4 0x7ef4 0x8020 0x8020 0x8020 0x8020 0x8020 0x8020 0x8020 0x8020 0x8020 0x8020 0x8020 0x8020 0x8020 0x8020 0x8020 0x8020>;
		g_QMAX_SYS_VOL_col = <0xa>;
		g_QMAX_SYS_VOL_row = <0x4>;
		io-channel-names = "batteryID-channel";
		io-channels = <0x3b 0x4>;
		phandle = <0xdc>;
	};

	boot_dramboost {
		boost_opp = <0x0>;
		compatible = "mediatek,dvfsrc-boost";
		phandle = <0xd0>;
	};

	btif@1100c000 {
		clock-names = "btifc", "apdmac";
		clocks = <0x30 0x1b 0x30 0x2b>;
		compatible = "mediatek,btif";
		interrupts = <0x0 0x85 0x4 0x0 0x17e 0x4 0x0 0x17f 0x4>;
		phandle = <0x1e>;
		reg = <0x0 0x1100c000 0x0 0x1000 0x0 0x10201080 0x0 0x80 0x0 0x10201100 0x0 0x80>;
	};

	bus_dbg@10208000 {
		compatible = "mediatek,bus_dbg-v2";
		interrupts = <0x0 0x9e 0x4>;
		mediatek,bus_dbg_con_offset = <0x2fc>;
		reg = <0x0 0x10208000 0x0 0x1000 0x0 0x10001000 0x0 0x1000>;
	};

	cache_parity {
		compatible = "mediatek,cache_parity";
		err_level = <0x1>;
		interrupts = <0x0 0x16 0x4 0x0 0x17 0x4 0x0 0x18 0x4 0x0 0x19 0x4 0x0 0x1a 0x4 0x0 0x1b 0x4 0x0 0x1c 0x4 0x0 0x1d 0x4 0x0 0x13 0x4>;
		irq_config = <0x0 0x8090 0xff00 0x8090 0x44 0x8090 0xff 0x1 0x8090 0xff00 0x8090 0x44 0x8090 0xff 0x2 0x8090 0xff00 0x8090 0x44 0x8090 0xff 0x3 0x8090 0xff00 0x8090 0x44 0x8090 0xff 0x4 0x8090 0xff00 0x8090 0x44 0x8090 0xff 0x5 0x8090 0xff00 0x8090 0x44 0x8090 0xff 0x6 0x8090 0xff00 0x8090 0x44 0x8090 0xff 0x7 0x8090 0xff00 0x8090 0x44 0x8090 0xff 0x400 0xc8c0 0x1000000 0xc8c0 0xc 0xc8c8 0x1>;
		reg = <0x0 0xc530000 0x0 0x10000>;
		version = <0x1>;
	};

	cam1@1a030000 {
		compatible = "mediatek,cam1";
		interrupts = <0x0 0xf9 0x4>;
		reg = <0x0 0x1a030000 0x0 0x8000>;
	};

	cam1_inner@1a038000 {
		compatible = "mediatek,cam1_inner";
		reg = <0x0 0x1a038000 0x0 0x8000>;
	};

	cam2@1a050000 {
		compatible = "mediatek,cam2";
		interrupts = <0x0 0xfa 0x4>;
		reg = <0x0 0x1a050000 0x0 0x8000>;
	};

	cam2_inner@1a058000 {
		compatible = "mediatek,cam2_inner";
		reg = <0x0 0x1a058000 0x0 0x8000>;
	};

	cam3@1a070000 {
		compatible = "mediatek,cam3";
		reg = <0x0 0x1a070000 0x0 0x8000>;
	};

	cam3_inner@1a078000 {
		compatible = "mediatek,cam3_inner";
		reg = <0x0 0x1a078000 0x0 0x8000>;
	};

	cam_smi_subcom@1a00c000 {
		clock-names = "scp-cam";
		clocks = <0x2d 0x8>;
		common-clamp = <0x2>;
		compatible = "mediatek,cam_smi_subcom", "mediatek,smi_common";
		mediatek,smi-id = <0x1a>;
		reg = <0x0 0x1a00c000 0x0 0x1000>;
	};

	cam_smi_subcom@1a00d000 {
		clock-names = "scp-cam";
		clocks = <0x2d 0x8>;
		common-clamp = <0x3>;
		compatible = "mediatek,cam_smi_subcom", "mediatek,smi_common";
		mediatek,smi-id = <0x1b>;
		reg = <0x0 0x1a00d000 0x0 0x1000>;
	};

	camera_af_node {
		compatible = "mediatek,CAMERA_MAIN_AF";
		phandle = <0xa7>;
	};

	camisp@1a000000 {
		clock-names = "ISP_SCP_SYS_CAM", "ISP_SCP_SYS_RAWA", "ISP_SCP_SYS_RAWB", "CAMSYS_CAM_CGPDN", "CAMSYS_CAMTG_CGPDN", "CAMSYS_CAMSV0_CGPDN", "CAMSYS_CAMSV1_CGPDN", "CAMSYS_CAMSV2_CGPDN", "CAMSYS_LARB13_CGPDN", "CAMSYS_LARB14_CGPDN", "CAMSYS_SENINF_CGPDN", "CAMSYS_MAIN_CAM2MM_GALS_CGPDN", "CAMSYS_RAWALARB16_CGPDN", "CAMSYS_RAWACAM_CGPDN", "CAMSYS_RAWATG_CGPDN", "CAMSYS_RAWBLARB17_CGPDN", "CAMSYS_RAWBCAM_CGPDN", "CAMSYS_RAWBTG_CGPDN", "TOPCKGEN_TOP_MUX_CAMTM";
		clocks = <0x2d 0x8 0x2d 0xe 0x2d 0xf 0x2e 0x3 0x2e 0x4 0x2e 0x6 0x2e 0x7 0x2e 0x8 0x2e 0x0 0x2e 0x1 0x2e 0x5 0x2e 0xf 0x71 0x0 0x71 0x1 0x71 0x2 0x72 0x0 0x72 0x1 0x72 0x2 0x21 0x24>;
		compatible = "mediatek,camisp", "syscon";
		phandle = <0x125>;
		reg = <0x0 0x1a000000 0x0 0x10000>;
	};

	camsv3@1a092000 {
		compatible = "mediatek,camsv3";
		interrupts = <0x0 0x100 0x4>;
		reg = <0x0 0x1a092000 0x0 0x1000>;
	};

	camsv4@1a093000 {
		compatible = "mediatek,camsv4";
		interrupts = <0x0 0x101 0x4>;
		reg = <0x0 0x1a093000 0x0 0x1000>;
	};

	camsv5@1a094000 {
		compatible = "mediatek,camsv5";
		interrupts = <0x0 0x102 0x4>;
		reg = <0x0 0x1a094000 0x0 0x1000>;
	};

	camsv6@1a095000 {
		compatible = "mediatek,camsv6";
		interrupts = <0x0 0x103 0x4>;
		reg = <0x0 0x1a095000 0x0 0x1000>;
	};

	camsv7@1a096000 {
		compatible = "mediatek,camsv7";
		interrupts = <0x0 0x107 0x4>;
		reg = <0x0 0x1a096000 0x0 0x1000>;
	};

	camsv8@1a097000 {
		compatible = "mediatek,camsv8";
		interrupts = <0x0 0x108 0x4>;
		reg = <0x0 0x1a097000 0x0 0x1000>;
	};

	camsys@1a000000 {
		#clock-cells = <0x1>;
		compatible = "mediatek,camsys", "syscon";
		phandle = <0x2e>;
		reg = <0x0 0x1a000000 0x0 0x1000>;
	};

	camsys_a@1a04f000 {
		compatible = "mediatek,camsys_a";
		phandle = <0x126>;
		reg = <0x0 0x1a04f000 0x0 0x1000>;
	};

	camsys_b@1a06f000 {
		compatible = "mediatek,camsys_b";
		phandle = <0x127>;
		reg = <0x0 0x1a06f000 0x0 0x1000>;
	};

	camsys_c@1a08f000 {
		compatible = "mediatek,camsys_c";
		phandle = <0x128>;
		reg = <0x0 0x1a08f000 0x0 0x1000>;
	};

	camsys_rawa@1a04f000 {
		#clock-cells = <0x1>;
		compatible = "mediatek,camsys_rawa", "syscon";
		phandle = <0x71>;
		reg = <0x0 0x1a04f000 0x0 0x1000>;
	};

	camsys_rawb@1a06f000 {
		#clock-cells = <0x1>;
		compatible = "mediatek,camsys_rawb", "syscon";
		phandle = <0x72>;
		reg = <0x0 0x1a06f000 0x0 0x1000>;
	};

	charger {
		ac_charger_current = <0x1e8480>;
		ac_charger_input_current = <0x1e8480>;
		algorithm_name = "SwitchCharging2";
		apple_1_0a_charger_current = <0x9eb10>;
		apple_2_1a_charger_current = <0xc3500>;
		battery_cv = <0x43e6d0>;
		bc12_charger = <0x0>;
		bif_cv_under_threshold2 = <0x43e6d0>;
		bif_threshold1 = <0x40d990>;
		bif_threshold2 = <0x419ce0>;
		cable_imp_threshold = <0x2bb>;
		charging_host_charger_current = <0x16e360>;
		check_hv_current = <0xf4240>;
		compatible = "mediatek,charger";
		current_a = <0x507d78>;
		current_b = <0x35b600>;
		current_max = <0x5a06e0>;
		enable_dynamic_mivr;
		enable_ffc;
		enable_min_charge_temp;
		enable_sw_jeita;
		enable_type_c;
		enable_vote;
		ffc_cv = <0x445c00>;
		ffc_ieoc = <0xbb800>;
		ffc_ieoc2 = <0xbb800>;
		ffc_ieoc_warm = <0xdac00>;
		ffc_ieoc_warm2 = <0xcb200>;
		ffc_ieoc_warm_temp_thres = <0x23>;
		ibus_err = <0xe>;
		jeita_temp_above_t4_cv = <0x3e8fa0>;
		jeita_temp_below_t0_cv = <0x43e6d0>;
		jeita_temp_t0_to_t1_cv = <0x43e6d0>;
		jeita_temp_t1_to_t1p5_cv = <0x43e6d0>;
		jeita_temp_t1p5_to_t2_cv = <0x43e6d0>;
		jeita_temp_t2_to_t3_cv = <0x43e6d0>;
		jeita_temp_t3_to_t4_cv = <0x3e8fa0>;
		jeita_temp_tn1_to_t0_cv = <0x43e6d0>;
		max_charge_temp = <0x3c>;
		max_charge_temp_minus_x_degree = <0x3a>;
		max_charger_voltage = <0xcdfe60>;
		max_dmivr_charger_current = <0x155cc0>;
		mi,fcc-batt-unverify-ua = <0x1e8480>;
		min_charge_temp = <0x0>;
		min_charge_temp_plus_x_degree = <0x2>;
		min_charger_voltage = <0x4630c0>;
		min_charger_voltage_1 = <0x432380>;
		min_charger_voltage_2 = <0x401640>;
		non_ffc_cv = <0x43e6d0>;
		non_ffc_ieoc = <0x3e800>;
		non_std_ac_charger_current = <0xf4240>;
		pd_ichg_level_threshold = <0xf4240>;
		pd_stop_battery_soc = <0x50>;
		pd_vbus_low_bound = <0x4c4b40>;
		pd_vbus_upper_bound = <0x895440>;
		phandle = <0x142>;
		power_path_support;
		qc_charger_input_current = <0x1e8480>;
		qcom,soc_decimal_rate = <0x0 0x26 0xa 0x23 0x14 0x21 0x1e 0x21 0x28 0x21 0x32 0x21 0x3c 0x21 0x46 0x21 0x50 0x19 0x5a 0x14 0x5f 0xa 0x63 0x5>;
		qcom,thermal-mitigation-dcp = <0x1e8480 0x1e8480 0x1e8480 0x1e8480 0x1e8480 0x1e8480 0x1e8480 0x1cfde0 0x1b7740 0x19f0a0 0x186a00 0x16e360 0x155cc0 0x13d620 0xf4240 0xc3500 0xaae60 0x7a120 0x493e0>;
		qcom,thermal-mitigation-pd-base = <0x5b8d80 0x56f9a0 0x5265c0 0x4c4b40 0x47b760 0x419ce0 0x3e8fa0 0x39fbc0 0x3567e0 0x30d400 0x2ab980 0x249f00 0x1e8480 0x16e360 0xf4240 0xc3500 0xaae60 0x7a120 0x493e0>;
		qcom,thermal-mitigation-qc2 = <0x1b7740 0x1b7740 0x1b7740 0x1b7740 0x1b7740 0x1b7740 0x1b7740 0x1b7740 0x1b7740 0x19f0a0 0x186a00 0x16e360 0x155cc0 0x13d620 0xf4240 0xc3500 0xaae60 0x7a120 0x493e0>;
		qcom,thermal-mitigation-qc3 = <0x36ee80 0x36ee80 0x36ee80 0x3567e0 0x33e140 0x325aa0 0x30d400 0x2f4d60 0x2dc6c0 0x2ab980 0x27ac40 0x249f00 0x2191c0 0x1e8480 0xf4240 0xc3500 0xaae60 0x7a120 0x493e0>;
		qcom,thermal-mitigation-qc3-classb = <0x4dd1e0 0x47b760 0x419ce0 0x3d0900 0x36ee80 0x3567e0 0x33e140 0x33e140 0x33e140 0x30d400 0x2625a0 0x2191c0 0x1e8480 0x13d620 0xf4240 0xc3500 0xaae60 0x7a120 0x493e0>;
		qcom,thermal-mitigation-qc3p5 = <0x44aa20 0x401640 0x3d0900 0x39fbc0 0x36ee80 0x33e140 0x30d400 0x2f4d60 0x2dc6c0 0x2ab980 0x27ac40 0x249f00 0x2191c0 0x1e8480 0xf4240 0xc3500 0xaae60 0x7a120 0x493e0>;
		step_a = <0x40d990>;
		step_b = <0x43e6d0>;
		step_hy_down_a = <0x249f0>;
		step_hy_down_b = <0x249f0>;
		ta_ac_charger_current = <0x2d78a0>;
		temp_neg_10_thres = <0xfffffff6>;
		temp_t0_thres = <0x0>;
		temp_t0_thres_plus_x_degree = <0x1>;
		temp_t0_to_t1_fcc = <0xea600>;
		temp_t1_thres = <0x5>;
		temp_t1_thres_plus_x_degree = <0x6>;
		temp_t1_to_t1p5_fcc = <0x251c00>;
		temp_t1p5_thres = <0xa>;
		temp_t1p5_thres_plus_x_degree = <0xb>;
		temp_t1p5_to_t2_fcc = <0x39fbc0>;
		temp_t2_thres = <0xf>;
		temp_t2_thres_plus_x_degree = <0x11>;
		temp_t2_to_t3_fcc = <0x588040>;
		temp_t3_thres = <0x30>;
		temp_t3_thres_minus_x_degree = <0x2e>;
		temp_t3_to_t4_fcc = <0x251c00>;
		temp_t4_thres = <0x3c>;
		temp_t4_thres_minus_x_degree = <0x3a>;
		temp_tn1_thres = <0xfffffff6>;
		temp_tn1_thres_plus_x_degree = <0xfffffff7>;
		temp_tn1_to_t0_fcc = <0x6d600>;
		usb_charger_current = <0x7a120>;
		usb_charger_current_configured = <0x7a120>;
		usb_charger_current_suspend = <0x0>;
		usb_charger_current_unconfigured = <0x11170>;
		vbat_cable_imp_threshold = <0x3b8260>;
		vsys_watt = <0x4c4b40>;
		xm_pps_dual_charger_chg1_current = <0x7a120>;
		xm_pps_dual_charger_chg2_current = <0x2625a0>;
		xm_pps_dual_charger_input_current = <0x2d78a0>;
		xm_pps_max_ibus = <0x2d78a0>;
		xm_pps_max_vbus = <0xb71b00>;
		xm_pps_single_charger_current = <0x5b8d80>;
		xm_pps_single_charger_current_non_verified_pps = <0x493e00>;
		xm_pps_single_charger_input_current = <0x2d78a0>;
	};

	chipid@08000000 {
		compatible = "mediatek,chipid";
		reg = <0x0 0x8000000 0x0 0x4 0x0 0x8000004 0x0 0x4 0x0 0x8000008 0x0 0x4 0x0 0x800000c 0x0 0x4>;
	};

	chosen {
		bootargs = "console=tty0 console=ttyS0,921600n1 root=/dev/ram \t\t\tvmalloc=400M slub_debug=OFZPU swiotlb=noforce \t\t\tinitcall_debug=1 \t\t\tfirmware_class.path=/vendor/firmware \t\t\tpage_owner=on loop.max_part=7";
		kaslr-seed = <0x0 0x0>;
		phandle = <0x99>;
	};

	clkitg {
		compatible = "simple-bus";
		phandle = <0xa1>;
		status = "okay";

		bring-up {
			clocks = <0x20>;
			compatible = "mediatek,clk-bring-up";
		};
	};

	clocks {

		clk13m {
			#clock-cells = <0x0>;
			clock-frequency = <0xc65d40>;
			compatible = "fixed-clock";
			phandle = <0x31>;
		};

		clk26m {
			#clock-cells = <0x0>;
			clock-frequency = <0x18cba80>;
			compatible = "fixed-clock";
			phandle = <0x20>;
		};

		clk32k {
			#clock-cells = <0x0>;
			clock-frequency = <0x7d00>;
			compatible = "fixed-clock";
			phandle = <0xa3>;
		};

		clk_null {
			#clock-cells = <0x0>;
			clock-frequency = <0x0>;
			compatible = "fixed-clock";
			phandle = <0xa2>;
		};
	};

	cmdq-test {
		compatible = "mediatek,cmdq-test";
		mboxes = <0x38 0x15 0x0 0x1 0x38 0x16 0xffffffff 0x1 0x3a 0xb 0x0 0x1>;
		mediatek,gce = <0x38>;
		mediatek,gce-subsys = <0x63 0x1>;
		mmsys_config = <0x39>;
		token_gpr_set4 = [02 c0];
		token_user0 = [02 89];
	};

	consys@18002000 {
		#address-cells = <0x2>;
		#size-cells = <0x2>;
		clock-names = "conn", "ccif";
		clocks = <0x2d 0x2 0x30 0x66>;
		compatible = "mediatek,mt6781-consys";
		interrupts = <0x0 0x11c 0x4 0x0 0x4e 0x4 0x0 0x11f 0x4>;
		phandle = <0x121>;
		pinctrl-0 = <0x87>;
		pinctrl-1 = <0x88>;
		pinctrl-2 = <0x89>;
		pinctrl-3 = <0x8a>;
		pinctrl-names = "default", "gps_lna_state_init", "gps_lna_state_oh", "gps_lna_state_ol";
		reg = <0x0 0x18002000 0x0 0x1000 0x0 0x10007000 0x0 0x100 0x0 0x10001000 0x0 0x1000 0x0 0x10006000 0x0 0x1000 0x0 0x18007000 0x0 0x1000 0x0 0x180b1000 0x0 0x1000 0x0 0x180a3000 0x0 0x1000 0x0 0x180a5000 0x0 0x800 0x0 0x180c1000 0x0 0x1000 0x0 0x18004000 0x0 0x1000 0x0 0x10211000 0x0 0x40 0x0 0x10003000 0x0 0x1000>;
		status = "okay";
	};

	cp_qc30 {
		phandle = <0x144>;
	};

	cpumssv {
		compatible = "mediatek,cpumssv";
		phandle = <0xf6>;
		state = <0x0>;
	};

	cpus {
		#address-cells = <0x1>;
		#size-cells = <0x0>;

		cpu-map {

			cluster0 {

				core0 {
					cpu = <0x8>;
				};

				core1 {
					cpu = <0x9>;
				};

				core2 {
					cpu = <0xa>;
				};

				core3 {
					cpu = <0xb>;
				};

				core4 {
					cpu = <0xc>;
				};

				core5 {
					cpu = <0xd>;
				};

				doe {
					phandle = <0x9a>;
				};
			};

			cluster1 {

				core0 {
					cpu = <0xe>;
				};

				core1 {
					cpu = <0xf>;
				};

				doe {
					phandle = <0x9b>;
				};
			};
		};

		cpu@000 {
			clock-frequency = <0x77359400>;
			compatible = "arm,cortex-a55";
			cpu-idle-states = <0x2 0x3 0x4 0x5>;
			device_type = "cpu";
			enable-method = "psci";
			phandle = <0x8>;
			reg = <0x0>;
		};

		cpu@001 {
			clock-frequency = <0x77359400>;
			compatible = "arm,cortex-a55";
			cpu-idle-states = <0x2 0x3 0x4 0x5>;
			device_type = "cpu";
			enable-method = "psci";
			phandle = <0x9>;
			reg = <0x100>;
		};

		cpu@002 {
			clock-frequency = <0x77359400>;
			compatible = "arm,cortex-a55";
			cpu-idle-states = <0x2 0x3 0x4 0x5>;
			device_type = "cpu";
			enable-method = "psci";
			phandle = <0xa>;
			reg = <0x200>;
		};

		cpu@003 {
			clock-frequency = <0x77359400>;
			compatible = "arm,cortex-a55";
			cpu-idle-states = <0x2 0x3 0x4 0x5>;
			device_type = "cpu";
			enable-method = "psci";
			phandle = <0xb>;
			reg = <0x300>;
		};

		cpu@100 {
			clock-frequency = <0x77359400>;
			compatible = "arm,cortex-a55";
			cpu-idle-states = <0x2 0x3 0x4 0x5>;
			device_type = "cpu";
			enable-method = "psci";
			phandle = <0xc>;
			reg = <0x400>;
		};

		cpu@101 {
			clock-frequency = <0x77359400>;
			compatible = "arm,cortex-a55";
			cpu-idle-states = <0x2 0x3 0x4 0x5>;
			device_type = "cpu";
			enable-method = "psci";
			phandle = <0xd>;
			reg = <0x500>;
		};

		cpu@102 {
			clock-frequency = <0x7a308480>;
			compatible = "arm,cortex-a75";
			cpu-idle-states = <0x6 0x7 0x4 0x5>;
			device_type = "cpu";
			enable-method = "psci";
			phandle = <0xe>;
			reg = <0x600>;
		};

		cpu@103 {
			clock-frequency = <0x7a308480>;
			compatible = "arm,cortex-a75";
			cpu-idle-states = <0x6 0x7 0x4 0x5>;
			device_type = "cpu";
			enable-method = "psci";
			phandle = <0xf>;
			reg = <0x700>;
		};

		idle-states {
			entry-method = "arm,psci";

			clusteroff_b {
				arm,psci-suspend-param = <0x1010001>;
				compatible = "mediatek,idle-state";
				entry-latency-us = <0x64>;
				exit-latency-us = <0xfa>;
				local-timer-stop;
				min-residency-us = <0x76c>;
				phandle = <0x7>;
			};

			clusteroff_l {
				arm,psci-suspend-param = <0x1010001>;
				compatible = "mediatek,idle-state";
				entry-latency-us = <0x64>;
				exit-latency-us = <0xfa>;
				local-timer-stop;
				min-residency-us = <0x834>;
				phandle = <0x3>;
			};

			cpuoff_b {
				arm,psci-suspend-param = <0x10001>;
				compatible = "mediatek,idle-state";
				entry-latency-us = <0x32>;
				exit-latency-us = <0x64>;
				local-timer-stop;
				min-residency-us = <0x578>;
				phandle = <0x6>;
			};

			cpuoff_l {
				arm,psci-suspend-param = <0x10001>;
				compatible = "mediatek,idle-state";
				entry-latency-us = <0x32>;
				exit-latency-us = <0x64>;
				local-timer-stop;
				min-residency-us = <0x640>;
				phandle = <0x2>;
			};

			mcusysoff {
				arm,psci-suspend-param = <0x1010002>;
				compatible = "mediatek,idle-state";
				entry-latency-us = <0x12c>;
				exit-latency-us = <0x4b0>;
				local-timer-stop;
				min-residency-us = <0xa28>;
				phandle = <0x4>;
			};

			s2idle {
				arm,psci-suspend-param = <0x1010100>;
				compatible = "mediatek,idle-state";
				entry-latency-us = <0x1f4>;
				exit-latency-us = <0x578>;
				local-timer-stop;
				min-residency-us = <0xffffffff>;
				phandle = <0x5>;
			};
		};
	};

	cqdma-controller@10212000 {
		#dma-cells = <0x1>;
		clock-names = "cqdma";
		clocks = <0x30 0x4e>;
		compatible = "mediatek,cqdma";
		dma-channel-mask = <0x3f>;
		dma-requests = <0xa>;
		interrupts = <0x0 0x86 0x4 0x0 0x87 0x4 0x0 0x88 0x4 0x0 0x180 0x4>;
		nr_channel = <0x4>;
		reg = <0x0 0x10212000 0x0 0x80 0x0 0x10212100 0x0 0x80 0x0 0x10212200 0x0 0x80 0x0 0x10212300 0x0 0x80>;
	};

	dbg_cti@0d020000 {
		compatible = "mediatek,dbg_cti";
		reg = <0x0 0xd020000 0x0 0x10000>;
	};

	dbg_dem@0d0a0000 {
		compatible = "mediatek,dbg_dem";
		reg = <0x0 0xd0a0000 0x0 0x10000>;
	};

	dbg_etr@0d030000 {
		compatible = "mediatek,dbg_etr";
		reg = <0x0 0xd030000 0x0 0x10000>;
	};

	dbg_funnel@0d040000 {
		compatible = "mediatek,dbg_funnel";
		reg = <0x0 0xd040000 0x0 0x10000>;
	};

	dbg_mdsys1@0d0c0000 {
		compatible = "mediatek,dbg_mdsys1";
		reg = <0x0 0xd0c0000 0x0 0x40000>;
	};

	dcm@10001000 {
		compatible = "mediatek,mt6781-dcm";
		phandle = <0xa4>;
		reg = <0x0 0x10001000 0x0 0x1000 0x0 0xc538000 0x0 0x5000 0x0 0xc53a800 0x0 0x1000>;
		reg-names = "infracfg_ao", "mp_cpusys_top", "cpccfg_reg";
	};

	ddrphy@10015000 {
		compatible = "mediatek,ddrphy";
		reg = <0x0 0x10015000 0x0 0x1000>;
	};

	ddrphy@1001e000 {
		compatible = "mediatek,ddrphy";
		reg = <0x0 0x1001e000 0x0 0x1000>;
	};

	depth@1c100000 {
		compatible = "mediatek,depth";
		reg = <0x0 0x1c100000 0x0 0x1000>;
	};

	devapc@10207000 {
		compatible = "mediatek,mt6781-devapc";
		interrupts = <0x0 0x9f 0x4>;
		reg = <0x0 0x10207000 0x0 0x1000 0x0 0x1000e000 0x0 0x1000 0x0 0x10033000 0x0 0x1000>;
	};

	devapc_ao_infra_peri@1000e000 {
		compatible = "mediatek,devapc_ao_infra_peri";
		reg = <0x0 0x1000e000 0x0 0x1000>;
	};

	devapc_ao_md@10019000 {
		compatible = "mediatek,devapc_ao_md";
		reg = <0x0 0x10019000 0x0 0x1000>;
	};

	devapc_ao_mm@1001c000 {
		compatible = "mediatek,devapc_ao_mm";
		reg = <0x0 0x1001c000 0x0 0x1000>;
	};

	device_mpu_low@1021a000 {
		compatible = "mediatek,device_mpu_low";
		interrupts = <0x0 0xee 0x4>;
		page-size = <0x200000>;
		prot-base = <0x0 0x40000000>;
		prot-size = <0x4 0x0>;
		reg = <0x0 0x1021a000 0x0 0x1000>;
	};

	dfd {
		compatible = "mediatek,dfd";
		mediatek,chain_length = <0xa7f8>;
		mediatek,enabled = <0x1>;
		mediatek,rg_dfd_timeout = <0xa0>;
		phandle = <0x104>;
	};

	dfd_cache {
		compatible = "mediatek,dfd_cache";
		mediatek,enabled = <0x0>;
		mediatek,l2c_trigger = <0x0>;
		mediatek,rg_dfd_timeout = <0x3e80>;
		phandle = <0x105>;
	};

	dip_a0@15021000 {
		compatible = "mediatek,dip1";
		interrupts = <0x0 0xe0 0x4>;
		reg = <0x0 0x15021000 0x0 0xc000>;
	};

	dip_a10@1502b000 {
		compatible = "mediatek,dip_a10";
		reg = <0x0 0x1502b000 0x0 0x1000>;
	};

	dip_a11@1502c000 {
		compatible = "mediatek,dip_a11";
		reg = <0x0 0x1502c000 0x0 0x1000>;
	};

	dip_a1@15022000 {
		compatible = "mediatek,dip_a1";
		reg = <0x0 0x15022000 0x0 0x1000>;
	};

	dip_a2@15023000 {
		compatible = "mediatek,dip_a2";
		reg = <0x0 0x15023000 0x0 0x1000>;
	};

	dip_a3@15024000 {
		compatible = "mediatek,dip_a3";
		reg = <0x0 0x15024000 0x0 0x1000>;
	};

	dip_a4@15025000 {
		compatible = "mediatek,dip_a4";
		reg = <0x0 0x15025000 0x0 0x1000>;
	};

	dip_a5@15026000 {
		compatible = "mediatek,dip_a5";
		reg = <0x0 0x15026000 0x0 0x1000>;
	};

	dip_a6@15027000 {
		compatible = "mediatek,dip_a6";
		reg = <0x0 0x15027000 0x0 0x1000>;
	};

	dip_a7@15028000 {
		compatible = "mediatek,dip_a7";
		reg = <0x0 0x15028000 0x0 0x1000>;
	};

	dip_a8@15029000 {
		compatible = "mediatek,dip_a8";
		reg = <0x0 0x15029000 0x0 0x1000>;
	};

	dip_a9@1502a000 {
		compatible = "mediatek,dip_a9";
		reg = <0x0 0x1502a000 0x0 0x1000>;
	};

	dip_b0@15821000 {
		compatible = "mediatek,dip_b0";
		reg = <0x0 0x15821000 0x0 0x1000>;
	};

	dip_b10@1582b000 {
		compatible = "mediatek,dip_b10";
		reg = <0x0 0x1582b000 0x0 0x1000>;
	};

	dip_b11@1582c000 {
		compatible = "mediatek,dip_b11";
		reg = <0x0 0x1582c000 0x0 0x1000>;
	};

	dip_b1@15822000 {
		compatible = "mediatek,dip_b1";
		reg = <0x0 0x15822000 0x0 0x1000>;
	};

	dip_b2@15823000 {
		compatible = "mediatek,dip_b2";
		reg = <0x0 0x15823000 0x0 0x1000>;
	};

	dip_b3@15824000 {
		compatible = "mediatek,dip_b3";
		reg = <0x0 0x15824000 0x0 0x1000>;
	};

	dip_b4@15825000 {
		compatible = "mediatek,dip_b4";
		reg = <0x0 0x15825000 0x0 0x1000>;
	};

	dip_b5@15826000 {
		compatible = "mediatek,dip_b5";
		reg = <0x0 0x15826000 0x0 0x1000>;
	};

	dip_b6@15827000 {
		compatible = "mediatek,dip_b6";
		reg = <0x0 0x15827000 0x0 0x1000>;
	};

	dip_b7@15828000 {
		compatible = "mediatek,dip_b7";
		reg = <0x0 0x15828000 0x0 0x1000>;
	};

	dip_b8@15829000 {
		compatible = "mediatek,dip_b8";
		reg = <0x0 0x15829000 0x0 0x1000>;
	};

	dip_b9@1582a000 {
		compatible = "mediatek,dip_b9";
		reg = <0x0 0x1582a000 0x0 0x1000>;
	};

	disp_aal0@1400c000 {
		clocks = <0x39 0x8>;
		compatible = "mediatek,disp_aal0", "mediatek,mt6781-disp-aal";
		interrupts = <0x0 0x130 0x4>;
		phandle = <0x111>;
		reg = <0x0 0x1400c000 0x0 0x1000>;
	};

	disp_ccorr0@1400b000 {
		clocks = <0x39 0x9>;
		compatible = "mediatek,disp_ccorr0", "mediatek,mt6781-disp-ccorr";
		interrupts = <0x0 0x12e 0x4>;
		phandle = <0x110>;
		reg = <0x0 0x1400b000 0x0 0x1000>;
	};

	disp_color0@14009000 {
		clocks = <0x39 0xa>;
		compatible = "mediatek,disp_color0", "mediatek,mt6781-disp-color";
		interrupts = <0x0 0x12d 0x4>;
		phandle = <0x10f>;
		reg = <0x0 0x14009000 0x0 0x1000>;
	};

	disp_dither0@1400f000 {
		clocks = <0x39 0x10>;
		compatible = "mediatek,disp_dither0", "mediatek,mt6781-disp-dither";
		interrupts = <0x0 0x133 0x4>;
		phandle = <0x114>;
		reg = <0x0 0x1400f000 0x0 0x1000>;
	};

	disp_dsc_wrap@14012000 {
		clocks = <0x39 0xc>;
		compatible = "mediatek,disp_dsc_wrap", "mediatek,mt6781-disp-dsc";
		interrupts = <0x0 0x136 0x4>;
		phandle = <0x115>;
		reg = <0x0 0x14012000 0x0 0x1000>;
	};

	disp_gamma0@1400d000 {
		clocks = <0x39 0xd>;
		compatible = "mediatek,disp_gamma0", "mediatek,mt6781-disp-gamma";
		interrupts = <0x0 0x131 0x4>;
		phandle = <0x112>;
		reg = <0x0 0x1400d000 0x0 0x1000>;
	};

	disp_leds {
		compatible = "mediatek,disp-leds";

		backlight {
			default-state = "on";
			label = "lcd-backlight";
			led-bits = <0xb>;
			max-brightness = <0x7ff>;
			trans-bits = <0xb>;
		};
	};

	disp_mutex@14001000 {
		clocks = <0x39 0x0>;
		compatible = "mediatek,disp_mutex0", "mediatek,mt6781-disp-mutex";
		interrupts = <0x0 0x127 0x4>;
		phandle = <0x108>;
		reg = <0x0 0x14001000 0x0 0x1000>;
	};

	disp_ovl0@14005000 {
		clocks = <0x39 0x2>;
		compatible = "mediatek,disp_ovl0", "mediatek,mt6781-disp-ovl";
		interrupts = <0x0 0x129 0x4>;
		iommus = <0x6c 0x2 0x6c 0x1>;
		mediatek,larb = <0x6e>;
		mediatek,smi-id = <0x0>;
		phandle = <0x10b>;
		reg = <0x0 0x14005000 0x0 0x1000>;
	};

	disp_ovl0_2l@14006000 {
		clocks = <0x39 0x4>;
		compatible = "mediatek,disp_ovl0_2l", "mediatek,mt6781-disp-ovl";
		interrupts = <0x0 0x12a 0x4>;
		iommus = <0x6c 0x21 0x6c 0x20>;
		mediatek,larb = <0x6d>;
		mediatek,smi-id = <0x1>;
		phandle = <0x10c>;
		reg = <0x0 0x14006000 0x0 0x1000>;
	};

	disp_postmask0@1400e000 {
		clocks = <0x39 0xe>;
		compatible = "mediatek,disp_postmask0", "mediatek,mt6781-disp-postmask";
		interrupts = <0x0 0x132 0x4>;
		iommus = <0x6c 0x0>;
		mediatek,larb = <0x6e>;
		mediatek,smi-id = <0x0>;
		phandle = <0x113>;
		reg = <0x0 0x1400e000 0x0 0x1000>;
	};

	disp_pwm0@1100e000 {
		#pwm-cells = <0x2>;
		clock-names = "main", "mm", "pwm_src";
		clocks = <0x30 0x36 0x21 0x16 0x21 0x62>;
		compatible = "mediatek,disp_pwm0", "mediatek,mt6781-disp-pwm";
		interrupts = <0x0 0x8f 0x4>;
		phandle = <0x76>;
		pwm_src_addr = <0x420>;
		pwm_src_base = <0x6b>;
		reg = <0x0 0x1100e000 0x0 0x1000>;
	};

	disp_rdma0@14007000 {
		clocks = <0x39 0x3>;
		compatible = "mediatek,disp_rdma0", "mediatek,mt6781-disp-rdma";
		interrupts = <0x0 0x12b 0x4>;
		iommus = <0x6c 0x22>;
		mediatek,larb = <0x6d>;
		mediatek,smi-id = <0x1>;
		phandle = <0x10d>;
		reg = <0x0 0x14007000 0x0 0x1000>;
	};

	disp_rsz0@14008000 {
		clocks = <0x39 0x7>;
		compatible = "mediatek,disp_rsz0", "mediatek,mt6781-disp-rsz";
		interrupts = <0x0 0x12c 0x4>;
		phandle = <0x10e>;
		reg = <0x0 0x14008000 0x0 0x1000>;
	};

	disp_smi_2x1_sub_common_u0@1401b000 {
		clock-names = "scp-dis";
		clocks = <0x2d 0x3>;
		compatible = "mediatek,disp_smi_2x1_sub_common_u0", "mediatek,smi_common";
		mediatek,smi-id = <0x16>;
		reg = <0x0 0x1401b000 0x0 0x1000>;
	};

	disp_smi_2x1_sub_common_u1@1401c000 {
		clock-names = "scp-dis";
		clocks = <0x2d 0x3>;
		compatible = "mediatek,disp_smi_2x1_sub_common_u1", "mediatek,smi_common";
		mediatek,smi-id = <0x17>;
		reg = <0x0 0x1401c000 0x0 0x1000>;
	};

	disp_wdma0@14014000 {
		clocks = <0x39 0x5>;
		compatible = "mediatek,disp_wdma0", "mediatek,mt6781-disp-wdma";
		interrupts = <0x0 0x138 0x4>;
		iommus = <0x6c 0x23>;
		mediatek,larb = <0x6d>;
		mediatek,smi-id = <0x1>;
		phandle = <0x118>;
		reg = <0x0 0x14014000 0x0 0x1000>;
	};

	dispsys_config@14000000 {
		clock-num = <0x4>;
		clocks = <0x2d 0x3 0x39 0x19 0x39 0x1 0x39 0x0>;
		compatible = "mediatek,dispsys_config", "syscon", "mediatek,mt6781-mmsys";
		fake-engine = <0x6e 0x3 0x6d 0x24>;
		gce-client-names = "CLIENT_CFG0", "CLIENT_CFG1", "CLIENT_CFG2", "CLIENT_TRIG_LOOP0", "CLIENT_SODI_LOOP0", "CLIENT_SUB_CFG0", "CLIENT_DSI_CFG0", "CLIENT_SEC_CFG0", "CLIENT_SEC_CFG1", "CLIENT_SEC_CFG2";
		gce-event-names = "disp_mutex0_eof", "disp_token_stream_dirty0", "disp_token_sodi0", "disp_wait_dsi0_te", "disp_token_stream_eof0", "disp_dsi0_eof", "disp_token_esd_eof0", "disp_rdma0_eof0", "disp_wdma0_eof0", "disp_token_stream_block0", "disp_token_cabc_eof0", "disp_wdma0_eof2", "disp_dsi0_sof0";
		gce-events = <0x38 0x1b2 0x38 0x280 0x38 0x29f 0x38 0x1c2 0x38 0x281 0x38 0x19a 0x38 0x282 0x38 0x19e 0x38 0x19b 0x38 0x283 0x38 0x284 0x38 0x19b 0x38 0x18e>;
		gce-subsys = <0x38 0x14000000 0x1 0x38 0x14010000 0x2 0x38 0x14020000 0x3>;
		helper-name = "MTK_DRM_OPT_STAGE", "MTK_DRM_OPT_USE_CMDQ", "MTK_DRM_OPT_USE_M4U", "MTK_DRM_OPT_SODI_SUPPORT", "MTK_DRM_OPT_IDLE_MGR", "MTK_DRM_OPT_IDLEMGR_SWTCH_DECOUPLE", "MTK_DRM_OPT_IDLEMGR_BY_REPAINT", "MTK_DRM_OPT_IDLEMGR_ENTER_ULPS", "MTK_DRM_OPT_IDLEMGR_KEEP_LP11", "MTK_DRM_OPT_DYNAMIC_RDMA_GOLDEN_SETTING", "MTK_DRM_OPT_IDLEMGR_DISABLE_ROUTINE_IRQ", "MTK_DRM_OPT_MET_LOG", "MTK_DRM_OPT_USE_PQ", "MTK_DRM_OPT_ESD_CHECK_RECOVERY", "MTK_DRM_OPT_ESD_CHECK_SWITCH", "MTK_DRM_OPT_PRESENT_FENCE", "MTK_DRM_OPT_RDMA_UNDERFLOW_AEE", "MTK_DRM_OPT_DSI_UNDERRUN_AEE", "MTK_DRM_OPT_HRT", "MTK_DRM_OPT_HRT_MODE", "MTK_DRM_OPT_DELAYED_TRIGGER", "MTK_DRM_OPT_OVL_EXT_LAYER", "MTK_DRM_OPT_AOD", "MTK_DRM_OPT_RPO", "MTK_DRM_OPT_DUAL_PIPE", "MTK_DRM_OPT_DC_BY_HRT", "MTK_DRM_OPT_OVL_WCG", "MTK_DRM_OPT_OVL_SBCH", "MTK_DRM_OPT_COMMIT_NO_WAIT_VBLANK", "MTK_DRM_OPT_MET", "MTK_DRM_OPT_REG_PARSER_RAW_DUMP", "MTK_DRM_OPT_VP_PQ", "MTK_DRM_OPT_GAME_PQ", "MTK_DRM_OPT_MMPATH", "MTK_DRM_OPT_HBM", "MTK_DRM_OPT_VDS_PATH_SWITCH", "MTK_DRM_OPT_LAYER_REC", "MTK_DRM_OPT_CLEAR_LAYER", "MTK_DRM_OPT_LFR", "MTK_DRM_OPT_DYN_MIPI_CHANGE", "MTK_DRM_OPT_SF_PF";
		helper-value = <0x0 0x1 0x1 0x0 0x1 0x0 0x1 0x0 0x0 0x0 0x1 0x0 0x1 0x1 0x1 0x1 0x0 0x1 0x1 0x1 0x0 0x1 0x0 0x1 0x0 0x0 0x0 0x0 0x1 0x0 0x0 0x0 0x0 0x0 0x0 0x0 0x0 0x1 0x0 0x1 0x1>;
		iommus = <0x6c 0x21>;
		mboxes = <0x38 0x0 0x0 0x4 0x38 0x5 0x0 0x4 0x38 0x2 0x0 0x4 0x38 0x3 0xffffffff 0x2 0x38 0x1 0xffffffff 0x6 0x38 0x4 0x0 0x4 0x38 0x6 0x0 0x3 0x3a 0x8 0x0 0x3 0x3a 0x9 0x0 0x3 0x3a 0x9 0x0 0x3>;
		mediatek,larb = <0x6d>;
		mediatek,mailbox-gce = <0x38>;
		phandle = <0x107>;
		reg = <0x0 0x14000000 0x0 0x1000>;
	};

	dma-controller@10200d80 {
		#dma-cells = <0x1>;
		clock-names = "apdma";
		clocks = <0x30 0x2b>;
		compatible = "mediatek,mt6577-uart-dma";
		dma-bits = <0x22>;
		interrupts = <0x0 0x178 0x4 0x0 0x179 0x4 0x0 0x17a 0x4 0x0 0x17b 0x4>;
		phandle = <0x3c>;
		reg = <0x0 0x10200d80 0x0 0x80 0x0 0x10200e00 0x0 0x80 0x0 0x10200e80 0x0 0x80 0x0 0x10200f00 0x0 0x80>;
	};

	dpmaif@10014000 {
		clock-names = "infra-dpmaif-clk";
		clocks = <0x30 0x73>;
		compatible = "mediatek,dpmaif";
		interrupts = <0x0 0xb4 0x4>;
		mediatek,dpmaif_capability = <0x6>;
		phandle = <0xd1>;
		reg = <0x0 0x10014000 0x0 0x1000 0x0 0x10014400 0x0 0x1000 0x0 0x1021d000 0x0 0x1000 0x0 0x1021d100 0x0 0x1000 0x0 0x1021d400 0x0 0x1000 0x0 0x1021c000 0x0 0x1000 0x0 0x1022e000 0x0 0x1000>;
	};

	dramc@10220000 {
		compatible = "mediatek,dramc";
		reg = <0x0 0x10220000 0x0 0x2000 0x0 0x10230000 0x0 0x2000 0x0 0x10224000 0x0 0x1000 0x0 0x10234000 0x0 0x1000 0x0 0x10228000 0x0 0x2000 0x0 0x10238000 0x0 0x2000 0x0 0x10226000 0x0 0x1000 0x0 0x10236000 0x0 0x1000>;
	};

	dsi@14013000 {
		clock-names = "engine", "digital", "hs";
		clocks = <0x39 0x13 0x39 0x18 0x75>;
		compatible = "mediatek,dsi0", "mediatek,mt6781-dsi";
		interrupts = <0x0 0x137 0x4>;
		phandle = <0x116>;
		phy-names = "dphy";
		phys = <0x75>;
		reg = <0x0 0x14013000 0x0 0x1000>;
	};

	dsi_te {
		compatible = "mediatek, dsi_te-eint";
		phandle = <0x117>;
		status = "disabled";
	};

	dsu-pmu-0 {
		compatible = "arm,dsu-pmu";
		cpus = <0x8 0x9 0xa 0xb 0xc 0xd 0xe 0xf>;
		interrupts = <0x0 0x12 0x4>;
	};

	dvfsp@0011bc00 {
		B-table = <0x802 0x63 0x1 0x1 0x7c2 0x5f 0x1 0x1 0x783 0x5a 0x1 0x1 0x744 0x56 0x1 0x1 0x704 0x52 0x1 0x1 0x6c5 0x4d 0x1 0x1 0x686 0x49 0x1 0x1 0x5fa 0x42 0x2 0x1 0x58b 0x3c 0x2 0x1 0x51c 0x37 0x2 0x1 0x491 0x30 0x2 0x1 0x43d 0x2c 0x2 0x1 0x3ea 0x27 0x2 0x1 0x397 0x23 0x2 0x1 0x343 0x1f 0x2 0x1 0x306 0x1c 0x4 0x1>;
		CCI-table = <0x578 0x55 0x2 0x1 0x532 0x4f 0x2 0x1 0x4ec 0x48 0x2 0x1 0x4a6 0x41 0x2 0x1 0x483 0x3e 0x2 0x1 0x460 0x3a 0x2 0x1 0x41a 0x37 0x2 0x1 0x3d4 0x33 0x2 0x1 0x39f 0x30 0x2 0x1 0x36b 0x2d 0x2 0x1 0x336 0x2b 0x2 0x1 0x2f0 0x27 0x2 0x1 0x2aa 0x23 0x4 0x1 0x264 0x1f 0x4 0x1 0x230 0x1c 0x4 0x1 0x1f4 0x10 0x4 0x1>;
		L-table = <0x7d0 0x55 0x1 0x1 0x78d 0x51 0x1 0x1 0x74a 0x4d 0x1 0x1 0x708 0x48 0x1 0x1 0x6c5 0x44 0x1 0x1 0x682 0x40 0x2 0x1 0x652 0x3c 0x2 0x1 0x5dc 0x39 0x2 0x1 0x55f 0x34 0x2 0x1 0x4fb 0x30 0x2 0x1 0x497 0x2c 0x2 0x1 0x433 0x28 0x2 0x1 0x3cf 0x24 0x2 0x1 0x36b 0x20 0x2 0x1 0x306 0x1c 0x4 0x1 0x1f4 0x10 0x4 0x1>;
		big-down-time = <0x2ee>;
		big-rise-time = <0x3e8>;
		change_flag = <0x0>;
		compatible = "mediatek,mt6781-dvfsp";
		imax_state = <0x2>;
		little-down-time = <0x2ee>;
		little-rise-time = <0x3e8>;
		phandle = <0xd5>;
		reg = <0x0 0x11bc00 0x0 0x1400 0x0 0x11bc00 0x0 0x1400>;
		state = <0x1>;
	};

	dvfsp@10227000 {
		compatible = "mediatek,dvfsp";
		reg = <0x0 0x10227000 0x0 0x1000>;
	};

	dvfsrc@10012000 {
		compatible = "mediatek,dvfsrc";
		interrupts = <0x0 0x122 0x4>;
		phandle = <0xcf>;
		reg = <0x0 0x10012000 0x0 0x1000 0x0 0x10006000 0x0 0x1000>;
	};

	dxcc_sec@10210000 {
		compatible = "mediatek,dxcc_sec";
		reg = <0x0 0x10210000 0x0 0x1000>;
	};

	eem_fsm@1100b000 {
		compatible = "mediatek,eem_fsm";
		eem-clamp-big = <0x0>;
		eem-clamp-cci = <0x0>;
		eem-clamp-gpu = <0x0>;
		eem-clamp-little = <0x0>;
		eem-initmon-big = <0xf>;
		eem-initmon-cci = <0xf>;
		eem-initmon-gpu = <0xf>;
		eem-initmon-little = <0xf>;
		eem-offset-big = <0xff>;
		eem-offset-cci = <0xff>;
		eem-offset-gpu = <0xff>;
		eem-offset-little = <0xff>;
		eem-status = <0x1>;
		interrupts = <0x0 0x8e 0x4>;
		phandle = <0xf7>;
		reg = <0x0 0x1100b000 0x0 0x1000>;
	};

	efuse_dbg@10004000 {
		compatible = "mediatek,efuse_dbg";
		reg = <0x0 0x10004000 0x0 0x1000>;
	};

	efusec@11cb0000 {
		compatible = "mediatek,efusec";
		reg = <0x0 0x11cb0000 0x0 0x10000>;
	};

	emicen@10219000 {
		compatible = "mediatek,mt6781-emicen", "mediatek,common-emicen";
		mediatek,emi-reg = <0x32>;
		phandle = <0x33>;
		reg = <0x0 0x10219000 0x0 0x1000>;
	};

	emichn@10225000 {
		compatible = "mediatek,mt6781-emichn", "mediatek,common-emichn";
		phandle = <0x32>;
		reg = <0x0 0x10225000 0x0 0x1000 0x0 0x10235000 0x0 0x1000>;
	};

	emiisu {
		compatible = "mediatek,mt6781-emiisu", "mediatek,common-emiisu";
		ctrl_intf = <0x1>;
	};

	emimpu@1021b000 {
		addr_align = <0x10>;
		ap_apc = <0x0 0x5 0x5 0x5 0x2 0x0 0x6 0x5 0x0 0x0 0x5 0x0 0x0 0x0 0x5 0x5>;
		ap_region = <0x1f>;
		clear = <0x160 0xffffffff 0x10 0x200 0x3 0x10 0x1f0 0x80000000 0x1>;
		clear_md = <0x1fc 0x80000000 0x1>;
		compatible = "mediatek,mt6781-emimpu", "mediatek,common-emimpu";
		ctrl_intf = <0x1>;
		domain_cnt = <0x10>;
		dump = <0x1f0 0x1f8 0x1fc>;
		interrupts = <0x0 0xa1 0x4>;
		mediatek,emi-reg = <0x33>;
		reg = <0x0 0x1021b000 0x0 0x1000>;
		region_cnt = <0x20>;
		slverr = <0x0>;
	};

	fdvt@1c001000 {
		clock-names = "FD_CLK_IPE_FD";
		clocks = <0x73 0x3>;
		compatible = "mediatek,fdvt";
		fdvt_frame_done = <0xa1>;
		interrupts = <0x0 0x152 0x4>;
		mboxes = <0x38 0xe 0x0 0x1 0x3a 0xb 0x0 0x1>;
		reg = <0x0 0x1c001000 0x0 0x1000>;
	};

	fe@1c002000 {
		compatible = "mediatek,fe";
		reg = <0x0 0x1c002000 0x0 0x1000>;
	};

	fhctl@1000ce00 {
		compatible = "mediatek,fhctl";
		reg = <0x0 0x1000ce00 0x0 0x200>;
	};

	flashlight_core {
		compatible = "mediatek,flashlight_core";
		phandle = <0x122>;
	};

	flashlights_mt6370 {
		compatible = "mediatek,flashlights_mt6370";
		decouple = <0x1>;
		phandle = <0x123>;

		channel@1 {
			ct = <0x0>;
			part = <0x0>;
			type = <0x0>;
		};

		channel@2 {
			ct = <0x1>;
			part = <0x0>;
			type = <0x0>;
		};
	};

	flashlights_ocp8132 {
		compatible = "mediatek,flashlights_ocp8132";
		decouple = <0x1>;
		phandle = <0x124>;

		channel@1 {
			ct = <0x0>;
			part = <0x0>;
			type = <0x0>;
		};

		channel@2 {
			ct = <0x1>;
			part = <0x0>;
			type = <0x0>;
		};
	};

	fpsensor_finger {
		compatible = "mediatek,fingerprint", "mediatek,goodix-fp";
		fpc,enable-wakeup;
		phandle = <0xd8>;
	};

	fpsensor_fp_eint {
		compatible = "mediatek,fpsensor_fp_eint";
		int-gpios = <0x22 0x4 0x0>;
		phandle = <0xd7>;
	};

	g3d_secure_reg@13fbc000 {
		compatible = "mediatek,g3d_secure_reg";
		reg = <0x0 0x13fbc000 0x0 0x1000>;
	};

	g3d_testbench@13fbd000 {
		compatible = "mediatek,g3d_testbench", "syscon";
		reg = <0x0 0x13fbd000 0x0 0x1000>;
	};

	gce_mbox@1022c000 {
		#gce-event-cells = <0x1>;
		#gce-subsys-cells = <0x2>;
		#mbox-cells = <0x3>;
		clock-names = "gce", "gce-timer";
		clocks = <0x30 0x9 0x30 0x19>;
		compatible = "mediatek,mt6781-gce";
		default_tokens = [02 bc 02 bd 02 be 02 bf 02 c0 02 c6 02 c7];
		interrupts = <0x0 0xaa 0x4 0x0 0xab 0x4>;
		phandle = <0x38>;
		reg = <0x0 0x1022c000 0x0 0x4000>;
	};

	gce_mbox_sec@1022c000 {
		#mbox-cells = <0x3>;
		clock-names = "gce";
		clocks = <0x30 0x9>;
		compatible = "mediatek,mailbox-gce-sec";
		mboxes = <0x38 0xf 0xffffffff 0x1>;
		phandle = <0x3a>;
		reg = <0x0 0x1022c000 0x0 0x4000>;
	};

	gpio@10005000 {
		compatible = "mediatek,gpio";
		phandle = <0x23>;
		reg = <0x0 0x10005000 0x0 0x1000>;
	};

	gpio_usage_mapping {
		compatible = "mediatek,gpio_usage_mapping";
		phandle = <0x136>;
	};

	gps@18c00000 {
		compatible = "mediatek,gps";
		phandle = <0x12a>;
	};

	gpufreq {
		_vgpu-supply = <0x69>;
		_vsram_gpu-supply = <0x6a>;
		clock-names = "clk_mux", "clk_main_parent", "clk_sub_parent", "subsys_mfg_cg", "mtcmos_mfg_async", "mtcmos_mfg", "mtcmos_mfg_core0", "mtcmos_mfg_core1";
		clocks = <0x21 0x3 0x21 0x88 0x21 0x37 0x68 0x1 0x2d 0x7 0x2d 0x4 0x2d 0xa 0x2d 0x9>;
		compatible = "mediatek,gpufreq";
	};

	gyro {
		phandle = <0x138>;
	};

	hacc@1000a000 {
		compatible = "mediatek,hacc";
		reg = <0x0 0x1000a000 0x0 0x1000>;
	};

	hwrng {
		compatible = "mediatek,mt67xx-rng";
		phandle = <0xd4>;
	};

	i2c0@11007000 {
		aed = <0x1a>;
		apdma_size = <0xff>;
		clock-div = <0x5>;
		clock-names = "main", "dma";
		clocks = <0x3d 0x0 0x30 0x2b>;
		compatible = "mediatek,i2c";
		eh_cfg = <0x10>;
		gpio_start = <0x10002200>;
		id = <0x0>;
		interrupts = <0x0 0x69 0x4>;
		mem_len = <0x200>;
		phandle = <0xe2>;
		pu_cfg = <0x40>;
		reg = <0x0 0x11007000 0x0 0x1000 0x0 0x10200100 0x0 0x100>;
		rsel_cfg = <0x60>;
		scl-gpio-id = <0x90>;
		sda-gpio-id = <0x91>;
	};

	i2c1@11008000 {
		aed = <0x1a>;
		clock-div = <0x5>;
		clock-names = "main", "dma";
		clocks = <0x3d 0x1 0x30 0x2b>;
		compatible = "mediatek,i2c";
		eh_cfg = <0x40>;
		gpio_start = <0x10002a00>;
		id = <0x1>;
		interrupts = <0x0 0x6a 0x4>;
		mem_len = <0x200>;
		phandle = <0xe3>;
		pu_cfg = <0xb0>;
		reg = <0x0 0x11008000 0x0 0x1000 0x0 0x10200200 0x0 0x100>;
		rsel_cfg = <0xe0>;
		scl-gpio-id = <0x92>;
		sda-gpio-id = <0x93>;
	};

	i2c2@11009000 {
		aed = <0x1a>;
		apdma_size = <0xff>;
		clock-div = <0x5>;
		clock-names = "main", "dma";
		clocks = <0x3d 0x2 0x30 0x2b>;
		compatible = "mediatek,i2c";
		eh_cfg = <0x40>;
		gpio_start = <0x10002a00>;
		id = <0x2>;
		interrupts = <0x0 0x6b 0x4>;
		mem_len = <0x200>;
		phandle = <0xe4>;
		pu_cfg = <0xa0>;
		reg = <0x0 0x11009000 0x0 0x1000 0x0 0x10200300 0x0 0x180>;
		rsel_cfg = <0xe0>;
		scl-gpio-id = <0x94>;
		sda-gpio-id = <0x95>;
	};

	i2c3@1100f000 {
		aed = <0x1a>;
		clock-div = <0x5>;
		clock-names = "main", "dma";
		clocks = <0x3d 0x3 0x30 0x2b>;
		compatible = "mediatek,i2c";
		eh_cfg = <0x30>;
		gpio_start = <0x10002000>;
		id = <0x3>;
		interrupts = <0x0 0x6c 0x4>;
		mem_len = <0x200>;
		phandle = <0xe5>;
		pu_cfg = <0x90>;
		reg = <0x0 0x1100f000 0x0 0x1000 0x0 0x10200480 0x0 0x100>;
		rsel_cfg = <0xc0>;
		scl-gpio-id = <0x96>;
		sda-gpio-id = <0x97>;
	};

	i2c4@11011000 {
		aed = <0x1a>;
		apdma_size = <0xff>;
		clock-div = <0x5>;
		clock-names = "main", "dma";
		clocks = <0x3d 0x4 0x30 0x2b>;
		compatible = "mediatek,i2c";
		eh_cfg = <0x40>;
		gpio_start = <0x10002a00>;
		id = <0x4>;
		interrupts = <0x0 0x6d 0x4>;
		mem_len = <0x200>;
		phandle = <0xe6>;
		pu_cfg = <0xa0>;
		reg = <0x0 0x11011000 0x0 0x1000 0x0 0x10200580 0x0 0x180>;
		rsel_cfg = <0xe0>;
		scl-gpio-id = <0x98>;
		sda-gpio-id = <0x99>;
	};

	i2c5@11016000 {
		aed = <0x1a>;
		clock-div = <0x5>;
		clock-names = "main", "dma";
		clocks = <0x3d 0x5 0x30 0x2b>;
		compatible = "mediatek,i2c";
		eh_cfg = <0x30>;
		gpio_start = <0x10002000>;
		id = <0x5>;
		interrupts = <0x0 0x162 0x4>;
		mem_len = <0x200>;
		phandle = <0xe7>;
		pu_cfg = <0x90>;
		reg = <0x0 0x11016000 0x0 0x1000 0x0 0x10200700 0x0 0x100>;
		rsel_cfg = <0xc0>;
		scl-gpio-id = <0x9a>;
		sda-gpio-id = <0x9b>;

		rt5133@18 {
			#gpio-cells = <0x2>;
			compatible = "richtek,rt5133";
			enable-gpio = <0x22 0x19 0x0>;
			gpio-controller;
			gpio-supply = <0x3e>;
			interrupts-extended = <0x22 0xb 0x0>;
			phandle = <0x94>;
			reg = <0x18>;
			regulator_nb = "rt5133-ldo1", "rt5133-ldo2", "rt5133-ldo3", "rt5133-ldo4", "rt5133-ldo5", "rt5133-ldo6", "rt5133-ldo7", "rt5133-ldo8";
			status = "ok";
			wakeup-source;

			regulators {

				BASE {
					oc_shutdown_all = <0x0>;
					pgb_shutdown_all = <0x0>;
					regulator-name = "rt5133,base";
				};

				LDO1 {
					oc_ptsel = <0x1>;
					pgb_ptsel = <0x1>;
					phandle = <0x3e>;
					regulator-active-discharge;
					regulator-max-microvolt = <0x1b7740>;
					regulator-min-microvolt = <0x1b7740>;
					regulator-name = "rt5133-ldo1";
					soft_start_time_sel = <0x1>;
				};

				LDO2 {
					oc_ptsel = <0x1>;
					pgb_ptsel = <0x1>;
					phandle = <0xe8>;
					regulator-active-discharge;
					regulator-max-microvolt = <0x30d400>;
					regulator-min-microvolt = <0x1b7740>;
					regulator-name = "rt5133-ldo2";
					soft_start_time_sel = <0x1>;
				};

				LDO3 {
					oc_ptsel = <0x1>;
					pgb_ptsel = <0x1>;
					phandle = <0xe9>;
					regulator-active-discharge;
					regulator-max-microvolt = <0x2dc6c0>;
					regulator-min-microvolt = <0x19f0a0>;
					regulator-name = "rt5133-ldo3";
					soft_start_time_sel = <0x1>;
				};

				LDO4 {
					oc_ptsel = <0x1>;
					pgb_ptsel = <0x1>;
					phandle = <0xea>;
					regulator-active-discharge;
					regulator-max-microvolt = <0x2dc6c0>;
					regulator-min-microvolt = <0x19f0a0>;
					regulator-name = "rt5133-ldo4";
					soft_start_time_sel = <0x1>;
				};

				LDO5 {
					oc_ptsel = <0x1>;
					pgb_ptsel = <0x1>;
					phandle = <0xeb>;
					regulator-active-discharge;
					regulator-max-microvolt = <0x2dc6c0>;
					regulator-min-microvolt = <0x19f0a0>;
					regulator-name = "rt5133-ldo5";
					soft_start_time_sel = <0x1>;
				};

				LDO6 {
					oc_ptsel = <0x1>;
					pgb_ptsel = <0x1>;
					phandle = <0xec>;
					regulator-active-discharge;
					regulator-max-microvolt = <0x2dc6c0>;
					regulator-min-microvolt = <0x19f0a0>;
					regulator-name = "rt5133-ldo6";
					soft_start_time_sel = <0x1>;
				};

				LDO7 {
					oc_ptsel = <0x1>;
					pgb_ptsel = <0x1>;
					phandle = <0xed>;
					regulator-active-discharge;
					regulator-max-microvolt = <0x124f80>;
					regulator-min-microvolt = <0xdbba0>;
					regulator-name = "rt5133-ldo7";
					soft_start_time_sel = <0x1>;
				};

				LDO8 {
					oc_ptsel = <0x1>;
					pgb_ptsel = <0x1>;
					phandle = <0xee>;
					regulator-active-discharge;
					regulator-max-microvolt = <0x124f80>;
					regulator-min-microvolt = <0xdbba0>;
					regulator-name = "rt5133-ldo8";
					soft_start_time_sel = <0x1>;
				};
			};
		};
	};

	i2c6@1100d000 {
		aed = <0x1a>;
		clock-div = <0x5>;
		clock-names = "main", "dma";
		clocks = <0x3d 0x6 0x30 0x2b>;
		compatible = "mediatek,i2c";
		eh_cfg = <0x30>;
		gpio_start = <0x10002000>;
		id = <0x6>;
		interrupts = <0x0 0x163 0x4>;
		mem_len = <0x200>;
		phandle = <0xef>;
		pu_cfg = <0x90>;
		reg = <0x0 0x1100d000 0x0 0x1000 0x0 0x10200800 0x0 0x100>;
		rsel_cfg = <0xc0>;
		scl-gpio-id = <0x9c>;
		sda-gpio-id = <0x9d>;

		speaker_amp@34 {
			#sound-dai-cells = <0x0>;
			compatible = "mediatek,speaker_amp";
			phandle = <0x59>;
			reg = <0x34>;
			status = "okay";
		};
	};

	i2c7@11004000 {
		aed = <0x1a>;
		apdma_size = <0xff>;
		clock-div = <0x5>;
		clock-names = "main", "dma";
		clocks = <0x3d 0x7 0x30 0x2b>;
		compatible = "mediatek,i2c";
		eh_cfg = <0x10>;
		gpio_start = <0x10002200>;
		id = <0x7>;
		interrupts = <0x0 0x6e 0x4>;
		mem_len = <0x200>;
		phandle = <0xf0>;
		pu_cfg = <0x40>;
		reg = <0x0 0x11004000 0x0 0x1000 0x0 0x10200900 0x0 0x180>;
		rsel_cfg = <0x60>;
		scl-gpio-id = <0x9e>;
		sda-gpio-id = <0x9f>;
	};

	i2c8@11005000 {
		aed = <0x1a>;
		apdma_size = <0xff>;
		clock-div = <0x5>;
		clock-names = "main", "dma";
		clocks = <0x3d 0x8 0x30 0x2b>;
		compatible = "mediatek,i2c";
		eh_cfg = <0x40>;
		gpio_start = <0x10002a00>;
		id = <0x8>;
		interrupts = <0x0 0x6f 0x4>;
		mem_len = <0x200>;
		phandle = <0xf1>;
		pu_cfg = <0xa0>;
		reg = <0x0 0x11005000 0x0 0x1000 0x0 0x10200a80 0x0 0x180>;
		rsel_cfg = <0xe0>;
		scl-gpio-id = <0xa0>;
		sda-gpio-id = <0xa1>;
	};

	i2c9@11019000 {
		aed = <0x1a>;
		apdma_size = <0xff>;
		clock-div = <0x5>;
		clock-names = "main", "dma";
		clocks = <0x3d 0x9 0x30 0x2b>;
		compatible = "mediatek,i2c";
		eh_cfg = <0x40>;
		gpio_start = <0x10002a00>;
		id = <0x9>;
		interrupts = <0x0 0x164 0x4>;
		mem_len = <0x200>;
		phandle = <0xf2>;
		pu_cfg = <0xa0>;
		reg = <0x0 0x11019000 0x0 0x1000 0x0 0x10200c00 0x0 0x180>;
		rsel_cfg = <0xe0>;
		scl-gpio-id = <0xa2>;
		sda-gpio-id = <0xa3>;
	};

	i2c_common {
		check_max_freq = [01];
		cnt_constraint = [01];
		compatible = "mediatek,i2c_common";
		dma_support = [03];
		ext_time_config = [18 01];
		idvfs = [01];
		phandle = <0xe1>;
		set_dt_div = [01];
		set_ltiming = [01];
		ver = [02];
	};

	img1_smi_2x1_sub_common@1401e000 {
		clock-names = "scp-dis";
		clocks = <0x2d 0x3>;
		compatible = "mediatek,img1_smi_2x1_sub_common", "mediatek,smi_common";
		mediatek,smi-id = <0x18>;
		reg = <0x0 0x1401e000 0x0 0x1000>;
	};

	imgsys1@15020000 {
		#clock-cells = <0x1>;
		compatible = "mediatek,imgsys1", "syscon";
		phandle = <0x83>;
		reg = <0x0 0x15020000 0x0 0x1000>;
	};

	imgsys2@15820000 {
		#clock-cells = <0x1>;
		compatible = "mediatek,imgsys2", "syscon";
		phandle = <0x84>;
		reg = <0x0 0x15820000 0x0 0x1000>;
	};

	imgsys2_config@15820000 {
		compatible = "mediatek,imgsys2_config", "syscon";
		reg = <0x0 0x15820000 0x0 0x1000>;
	};

	imgsys_config@15020000 {
		clock-names = "DIP_CG_IMG_LARB9", "DIP_CG_IMG_DIP", "DIP_CG_IMG_LARB11", "DIP_CG_IMG_DIP_MSS", "DIP_CG_IMG_MFB_DIP";
		clocks = <0x83 0x0 0x83 0x2 0x84 0x0 0x84 0x4 0x84 0x2>;
		compatible = "mediatek,imgsys", "syscon";
		phandle = <0x11e>;
		reg = <0x0 0x15020000 0x0 0x1000>;
	};

	imgsys_mfb_b@15820000 {
		compatible = "mediatek,imgsys_mfb_b";
		reg = <0x0 0x15820000 0x0 0x1000>;
	};

	imp_iic@11017000 {
		compatible = "mediatek,imp_iic";
		reg = <0x0 0x11017000 0x0 0x1000>;
	};

	imp_iic_wrap@11017000 {
		#clock-cells = <0x1>;
		compatible = "mediatek,imp_iic_wrap", "mediatek,mt6781-imp_iic_wrap", "syscon";
		phandle = <0x3d>;
		pwr-regmap = <0x21>;
		reg = <0x0 0x11017000 0x0 0x1000>;
	};

	infra_dbgsystop_cpu0@0e000000 {
		compatible = "mediatek,infra_dbgsystop_cpu0";
		reg = <0x0 0xe000000 0x0 0x100000>;
	};

	infra_dbgsystop_cpu1@0e100000 {
		compatible = "mediatek,infra_dbgsystop_cpu1";
		reg = <0x0 0xe100000 0x0 0x100000>;
	};

	infra_dbgsystop_cpu2@0e200000 {
		compatible = "mediatek,infra_dbgsystop_cpu2";
		reg = <0x0 0xe200000 0x0 0x100000>;
	};

	infra_dbgsystop_cpu3@0e300000 {
		compatible = "mediatek,infra_dbgsystop_cpu3";
		reg = <0x0 0xe300000 0x0 0x100000>;
	};

	infra_dbgsystop_cpu4@0e400000 {
		compatible = "mediatek,infra_dbgsystop_cpu4";
		reg = <0x0 0xe400000 0x0 0x100000>;
	};

	infra_dbgsystop_cpu5@0e500000 {
		compatible = "mediatek,infra_dbgsystop_cpu5";
		reg = <0x0 0xe500000 0x0 0x100000>;
	};

	infra_dbgsystop_cpu6@0e600000 {
		compatible = "mediatek,infra_dbgsystop_cpu6";
		reg = <0x0 0xe600000 0x0 0x100000>;
	};

	infra_dbgsystop_cpu7@0e700000 {
		compatible = "mediatek,infra_dbgsystop_cpu7";
		reg = <0x0 0xe700000 0x0 0x100000>;
	};

	infra_mbist@1020d000 {
		compatible = "mediatek,infra_mbist";
		reg = <0x0 0x1020d000 0x0 0x1000>;
	};

	infracfg@1020e000 {
		compatible = "mediatek,infracfg";
		reg = <0x0 0x1020e000 0x0 0x1000>;
	};

	infracfg_ao@10001000 {
		#clock-cells = <0x1>;
		compatible = "mediatek,infracfg_ao", "syscon";
		phandle = <0x30>;
		reg = <0x0 0x10001000 0x0 0x1000>;
	};

	interrupt-controller {
		#address-cells = <0x2>;
		#interrupt-cells = <0x3>;
		#redistributor-regions = <0x1>;
		#size-cells = <0x2>;
		compatible = "arm,gic-v3";
		interrupt-controller;
		interrupt-parent = <0x1>;
		interrupts = <0x1 0x9 0x4>;
		phandle = <0x1>;
		reg = <0x0 0xc000000 0x0 0x40000 0x0 0xc040000 0x0 0x200000>;
	};

	iocfg_0@10002000 {
		compatible = "mediatek,iocfg_0";
		reg = <0x0 0x10002000 0x0 0x200>;
	};

	iocfg_1@10002200 {
		compatible = "mediatek,iocfg_1";
		reg = <0x0 0x10002200 0x0 0x200>;
	};

	iocfg_2@10002400 {
		compatible = "mediatek,iocfg_2";
		reg = <0x0 0x10002400 0x0 0x200>;
	};

	iocfg_3@10002600 {
		compatible = "mediatek,iocfg_3";
		reg = <0x0 0x10002600 0x0 0x200>;
	};

	iocfg_4@10002800 {
		compatible = "mediatek,iocfg_4";
		reg = <0x0 0x10002800 0x0 0x200>;
	};

	iocfg_5@10002a00 {
		compatible = "mediatek,iocfg_5";
		reg = <0x0 0x10002a00 0x0 0x200>;
	};

	iocfg_bl@10002600 {
		compatible = "mediatek,iocfg_bl";
		phandle = <0x27>;
		reg = <0x0 0x10002600 0x0 0x200>;
	};

	iocfg_bm@10002800 {
		compatible = "mediatek,iocfg_bm";
		phandle = <0x28>;
		reg = <0x0 0x10002800 0x0 0x200>;
	};

	iocfg_lb@10002400 {
		compatible = "mediatek,iocfg_lb";
		phandle = <0x26>;
		reg = <0x0 0x10002400 0x0 0x200>;
	};

	iocfg_lm@10002200 {
		compatible = "mediatek,iocfg_lm";
		phandle = <0x25>;
		reg = <0x0 0x10002200 0x0 0x200>;
	};

	iocfg_lt@10002000 {
		compatible = "mediatek,iocfg_lt";
		phandle = <0x24>;
		reg = <0x0 0x10002000 0x0 0x200>;
	};

	iocfg_rm@10002A00 {
		compatible = "mediatek,iocfg_rm";
		phandle = <0x29>;
		reg = <0x0 0x10002a00 0x0 0x200>;
	};

	iocfg_rt@10002C00 {
		compatible = "mediatek,iocfg_rt";
		phandle = <0x2a>;
		reg = <0x0 0x10002c00 0x0 0x200>;
	};

	iocfg_tl@10002E00 {
		compatible = "mediatek,iocfg_tl";
		phandle = <0x2b>;
		reg = <0x0 0x10002e00 0x0 0x200>;
	};

	iommu {
		compatible = "mediatek,ion";
		iommus = <0x6c 0x3>;
		phandle = <0x119>;
	};

	ipe_smi_subcom@1c00e000 {
		clock-names = "scp-ipe", "ipe-smisubcom";
		clocks = <0x2d 0xd 0x73 0x2>;
		compatible = "mediatek,ipe_smi_subcom", "mediatek,smi_common";
		mediatek,smi-id = <0x19>;
		reg = <0x0 0x1c00e000 0x0 0x1000>;
	};

	ipesys@1c000000 {
		#clock-cells = <0x1>;
		compatible = "mediatek,ipesys", "syscon";
		phandle = <0x73>;
		reg = <0x0 0x1c000000 0x0 0x1000>;
	};

	ipesys_config@1c000000 {
		compatible = "mediatek,ipesys_config";
		reg = <0x0 0x1c000000 0x0 0x1000>;
	};

	irq_nfc {
		compatible = "mediatek,irq_nfc-eint";
		phandle = <0x134>;
	};

	irtx_pwm {
		compatible = "mediatek,irtx-pwm";
		phandle = <0xda>;
		pwm_ch = <0x1>;
		pwm_data_invert = <0x0>;
	};

	jpgenc@17030000 {
		clock-names = "jpgenc";
		clocks = <0x86 0x3>;
		compatible = "mediatek,jpgenc";
		cshot-spec = <0x170>;
		interrupts = <0x0 0xf5 0x4>;
		iommus = <0x6c 0xe9>;
		mediatek,larb = <0x79>;
		port-id = <0xe9 0xea 0xeb 0xec>;
		reg = <0x0 0x17030000 0x0 0x10000>;
	};

	kd_camera_hw1@1a004000 {
		compatible = "mediatek,imgsensor";
		phandle = <0xa6>;
	};

	kp@10010000 {
		compatible = "mediatek,kp";
		interrupts = <0x0 0x49 0x1>;
		phandle = <0x1c>;
		reg = <0x0 0x10010000 0x0 0x1000>;
	};

	lastbus@10001000 {
		compatible = "mediatek,lastbus-v1";
		reg = <0x0 0x10001000 0x0 0x1000 0x0 0x10003000 0x0 0x1000>;
	};

	lk_charger {
		ac_charger_current = <0x16e360>;
		ac_charger_input_current = <0x16e360>;
		charging_host_charger_current = <0x16e360>;
		compatible = "mediatek,lk_charger";
		enable_anime;
		fast_charge_voltage = <0x2dc6c0>;
		max_charger_voltage = <0x632ea0>;
		min_charger_voltage = <0x3d0900>;
		non_std_ac_charger_current = <0xf4240>;
		pd_charger_current = <0x16e360>;
		phandle = <0x141>;
		ta_ac_charger_current = <0x16e360>;
		temp_t0_threshold = <0xfffffff6>;
		temp_t1_threshold = <0xf>;
		temp_t2_threshold = <0x30>;
		temp_t3_threshold = <0x3a>;
		usb_charger_current = <0x7a120>;
	};

	m4u@14016000 {
		#iommu-cells = <0x1>;
		cell-index = <0x0>;
		clock-names = "disp-iommu-ck", "power";
		clocks = <0x39 0x17 0x2d 0x3>;
		compatible = "mediatek,iommu_v0";
		interrupts = <0x0 0x139 0x4>;
		mediatek,larbs = <0x6e 0x6d 0x77 0x78 0x79 0x7a 0x7b 0x7c 0x7d 0x7e 0x7f 0x80 0x81 0x82>;
		phandle = <0x6c>;
		reg = <0x0 0x14016000 0x0 0x1000>;
	};

	m4u@14017000 {
		cell-index = <0x0>;
		compatible = "mediatek,bank1_m4u0";
		interrupts = <0x0 0x13a 0x4>;
		phandle = <0x11a>;
		reg = <0x0 0x14017000 0x0 0x1000>;
	};

	m4u@14018000 {
		cell-index = <0x0>;
		compatible = "mediatek,bank2_m4u0";
		interrupts = <0x0 0x13b 0x4>;
		phandle = <0x11b>;
		reg = <0x0 0x14018000 0x0 0x1000>;
	};

	m4u@14019000 {
		cell-index = <0x0>;
		compatible = "mediatek,bank3_m4u0";
		interrupts = <0x0 0x13c 0x4>;
		phandle = <0x11c>;
		reg = <0x0 0x14019000 0x0 0x1000>;
	};

	m4u@1401a000 {
		cell-index = <0x0>;
		compatible = "mediatek,sec_m4u0";
		interrupts = <0x0 0x13d 0x4>;
		phandle = <0x11d>;
		reg = <0x0 0x1401a000 0x0 0x1000>;
	};

	mali@13000000 {
		compatible = "mediatek,mali", "arm,mali-valhall";
		interrupt-names = "GPU", "MMU", "JOB", "EVENT", "PWR";
		interrupts = <0x0 0x112 0x4 0x0 0x113 0x4 0x0 0x114 0x4 0x0 0x115 0x4 0x0 0x116 0x4>;
		phandle = <0x103>;
		reg = <0x0 0x13000000 0x0 0x4000>;
	};

	maxim_ds28e16 {
		compatible = "maxim,ds28e16";
		label = "max_ds28e16";
		maxim,version = <0x1>;
		phandle = <0x147>;
		status = "ok";
	};

	mbist@17060000 {
		compatible = "mediatek,mbist";
		reg = <0x0 0x17060000 0x0 0x10000>;
	};

	mbist_ao@10013000 {
		compatible = "mediatek,mbist_ao";
		reg = <0x0 0x10013000 0x0 0x1000>;
	};

	mcucfg@0c530000 {
		compatible = "mediatek,mcucfg";
		phandle = <0x1f>;
		reg = <0x0 0xc530000 0x0 0x10000>;
	};

	mcucfg_mp0_counter {
		compatible = "mediatek,mcucfg_mp0_counter";
		reg_mp0_counter_base = <0x1f>;
	};

	mcupm_reg@10216000 {
		compatible = "mediatek,mcupm_reg";
		reg = <0x0 0x10216000 0x0 0x1000>;
	};

	mcupm_sram0@10217000 {
		compatible = "mediatek,mcupm_sram0";
		reg = <0x0 0x10217000 0x0 0x1000>;
	};

	mcupm_sram1@10218000 {
		compatible = "mediatek,mcupm_sram1";
		reg = <0x0 0x10218000 0x0 0x1000>;
	};

	mcupm_sram2@10211000 {
		compatible = "mediatek,mcupm_sram2";
		reg = <0x0 0x10211000 0x0 0x1000>;
	};

	mcupm_sram3@10213000 {
		compatible = "mediatek,mcupm_sram3";
		reg = <0x0 0x10213000 0x0 0x1000>;
	};

	md1_sim1_hot_plug_eint {
		phandle = <0x13d>;
	};

	md1_sim2_hot_plug_eint {
		phandle = <0x13e>;
	};

	md_auxadc {
		compatible = "mediatek,md_auxadc";
		io-channel-names = "md-channel";
		io-channels = <0x3b 0x2>;
		phandle = <0x135>;
	};

	md_ccif0@1020a000 {
		compatible = "mediatek,md_ccif0";
		reg = <0x0 0x1020a000 0x0 0x1000>;
	};

	md_ccif1@1020c000 {
		compatible = "mediatek,md_ccif1";
		reg = <0x0 0x1020c000 0x0 0x1000>;
	};

	md_ccif2@1023d000 {
		compatible = "mediatek,md_ccif2";
		reg = <0x0 0x1023d000 0x0 0x1000>;
	};

	md_ccif3@1023f000 {
		compatible = "mediatek,md_ccif3";
		reg = <0x0 0x1023f000 0x0 0x1000>;
	};

	md_ccif4@10213000 {
		compatible = "mediatek,md_ccif4";
		reg = <0x0 0x10213000 0x0 0x1000>;
	};

	mddriver {
		clock-names = "scp-sys-md1-main", "infra-dpmaif-clk", "infra-ccif-ap", "infra-ccif-md", "infra-ccif1-ap", "infra-ccif1-md", "infra-ccif2-ap", "infra-ccif2-md", "infra-ccif4-md";
		clocks = <0x2d 0x1 0x30 0x37 0x30 0x2e 0x30 0x31 0x30 0x26 0x30 0x27 0x30 0x5d 0x30 0x5e 0x30 0x67>;
		compatible = "mediatek,mddriver";
		interrupts = <0x0 0x4b 0x1 0x0 0xa4 0x4 0x0 0xa5 0x4>;
		mediatek,cldma_capability = <0x6>;
		mediatek,md_id = <0x0>;
		mediatek,mdhif_type = <0x6>;
		phandle = <0x1d>;
		reg = <0x0 0x10209000 0x0 0x1000 0x0 0x1020a000 0x0 0x1000>;
	};

	mdp_aal0@1b005000 {
		clock-names = "MDP_AAL0";
		clocks = <0x6f 0xf>;
		compatible = "mediatek,mdp_aal0";
		phandle = <0x92>;
		reg = <0x0 0x1b005000 0x0 0x1000>;
	};

	mdp_hdr0@1b007000 {
		clock-names = "MDP_HDR0";
		clocks = <0x6f 0xa>;
		compatible = "mediatek,mdp_hdr0";
		phandle = <0x93>;
		reg = <0x0 0x1b007000 0x0 0x1000>;
	};

	mdp_mutex@1b001000 {
		clock-names = "MDP_MUTEX0";
		clocks = <0x6f 0xb>;
		compatible = "mediatek,mdp_mutex";
		phandle = <0x8b>;
		reg = <0x0 0x1b001000 0x0 0x1000>;
	};

	mdp_rdma0@1b003000 {
		ap_dma_base = <0x18010000 0x17 0xffff0000>;
		audio_base = <0x17000000 0x12 0xffff0000>;
		camsys1_base = <0x180a0000 0x1c 0xffff0000>;
		camsys2_base = <0x180b0000 0x1d 0xffff0000>;
		camsys_base = <0x18080000 0x1b 0xffff0000>;
		clock-names = "MDP_RDMA0", "GCE", "GCE_TIMER";
		clocks = <0x6f 0x0 0x30 0x9 0x30 0x19>;
		compatible = "mediatek,mdp_rdma0", "mediatek,mdp";
		conn_peri_base = <0x18820000 0x7 0xffff0000>;
		dip2_cq_thread21_frame_done = <0xd6>;
		dip2_cq_thread23_frame_done = <0xd8>;
		dip_cq_thread0_frame_done = <0xe1>;
		dip_cq_thread10_frame_done = <0xeb>;
		dip_cq_thread11_frame_done = <0xec>;
		dip_cq_thread12_frame_done = <0xed>;
		dip_cq_thread13_frame_done = <0xee>;
		dip_cq_thread14_frame_done = <0xef>;
		dip_cq_thread15_frame_done = <0xf0>;
		dip_cq_thread16_frame_done = <0xf1>;
		dip_cq_thread17_frame_done = <0xf2>;
		dip_cq_thread18_frame_done = <0xf3>;
		dip_cq_thread1_frame_done = <0xe2>;
		dip_cq_thread2_frame_done = <0xe3>;
		dip_cq_thread3_frame_done = <0xe4>;
		dip_cq_thread4_frame_done = <0xe5>;
		dip_cq_thread5_frame_done = <0xe6>;
		dip_cq_thread6_frame_done = <0xe7>;
		dip_cq_thread7_frame_done = <0xe8>;
		dip_cq_thread8_frame_done = <0xe9>;
		dip_cq_thread9_frame_done = <0xea>;
		disp_dither_base = <0x14010000 0x2 0xffff0000>;
		dre30_hist_sram_start = <0x600>;
		g3d_config_base = <0x13000000 0x0 0xffff0000>;
		gce_base = <0x18020000 0x18 0xffff0000>;
		gcpu_base = <0x10050000 0xf 0xffff0000>;
		img_dl_relay1_sof = <0x10c>;
		img_dl_relay_sof = <0x10b>;
		imgsys_base = <0x15020000 0x4 0xffff0000>;
		infra_na3_base = <0x10010000 0xb 0xffff0000>;
		infra_na4_base = <0x10020000 0xc 0xffff0000>;
		kp_base = <0x18840000 0x9 0xffff0000>;
		mboxes = <0x3a 0xa 0x0 0x1 0x38 0x13 0x0 0x1 0x38 0x14 0x0 0x1 0x38 0x15 0x0 0x1 0x38 0x16 0x0 0x1>;
		mcucfg_base = <0x10040000 0xe 0xffff0000>;
		mdp_aal0 = <0x92>;
		mdp_aal_frame_done = <0x136>;
		mdp_aal_sof = <0x102>;
		mdp_hdr0 = <0x93>;
		mdp_hdr0_frame_done = <0x131>;
		mdp_hdr0_sof = <0x104>;
		mdp_rdma0 = <0x8c>;
		mdp_rdma0_frame_done = <0x12f>;
		mdp_rdma0_sof = <0x100>;
		mdp_rsz0 = <0x8d>;
		mdp_rsz0_frame_done = <0x12b>;
		mdp_rsz0_sof = <0x105>;
		mdp_rsz1 = <0x8e>;
		mdp_rsz1_frame_done = <0x12a>;
		mdp_rsz1_sof = <0x106>;
		mdp_tdshp0 = <0x91>;
		mdp_tdshp_frame_done = <0x127>;
		mdp_tdshp_sof = <0x109>;
		mdp_wrot0 = <0x8f>;
		mdp_wrot0_sof = <0x107>;
		mdp_wrot0_write_frame_done = <0x123>;
		mdp_wrot1 = <0x90>;
		mdp_wrot1_sof = <0x108>;
		mdp_wrot1_write_frame_done = <0x122>;
		mediatek,mailbox-gce = <0x38>;
		mm_mutex = <0x8b>;
		mm_na_base = <0x14020000 0x3 0xffff0000>;
		mmsys_config = <0x6f>;
		mmsys_config_base = <0x14000000 0x1 0xffff0000>;
		msdc2_base = <0x17020000 0x14 0xffff0000>;
		msdc3_base = <0x18000000 0x16 0xffff0000>;
		phandle = <0x8c>;
		reg = <0x0 0x1b003000 0x0 0x1000>;
		scp_base = <0x10030000 0xd 0xffff0000>;
		scp_sram_base = <0x10000000 0xa 0xffff0000>;
		thread_count = <0x18>;
		topckgen_base = <0x18830000 0x8 0xffff0000>;
		usb0_base = <0x10200000 0x10 0xffff0000>;
		usb_sif_base = <0x10280000 0x11 0xffff0000>;
		vdec1_base = <0x17030000 0x15 0xffff0000>;
		vdec2_base = <0x18040000 0x19 0xffff0000>;
		vdec3_base = <0x18050000 0x1a 0xffff0000>;
		vdec_base = <0x17010000 0x13 0xffff0000>;
		vdec_gcon_base = <0x18800000 0x5 0xffff0000>;
		venc_gcon_base = <0x18810000 0x6 0xffff0000>;
		wpe_b_frame_done = <0xd7>;
	};

	mdp_rsz1@1bf009000 {
		clock-names = "MDP_RSZ1";
		clocks = <0x6f 0xd>;
		compatible = "mediatek,mdp_rsz1";
		phandle = <0x8e>;
		reg = <0x0 0x1b009000 0x0 0x1000>;
	};

	mdp_rsz@1b008000 {
		clock-names = "MDP_RSZ0";
		clocks = <0x6f 0x9>;
		compatible = "mediatek,mdp_rsz0";
		phandle = <0x8d>;
		reg = <0x0 0x1b008000 0x0 0x1000>;
	};

	mdp_smi_larb0@1b002000 {
		compatible = "mediatek,mdp_smi_larb0";
		reg = <0x0 0x1b002000 0x0 0x1000>;
	};

	mdp_tdshp0@1b00c000 {
		clock-names = "MDP_TDSHP0";
		clocks = <0x6f 0x1>;
		compatible = "mediatek,mdp_tdshp0";
		phandle = <0x91>;
		reg = <0x0 0x1b00c000 0x0 0x1000>;
	};

	mdp_wrot0@1b00a000 {
		clock-names = "MDP_WROT0";
		clocks = <0x6f 0x8>;
		compatible = "mediatek,mdp_wrot0";
		phandle = <0x8f>;
		reg = <0x0 0x1b00a000 0x0 0x1000>;
	};

	mdp_wrot1@1b00b000 {
		clock-names = "MDP_WROT1";
		clocks = <0x6f 0xc>;
		compatible = "mediatek,mdp_wrot1";
		phandle = <0x90>;
		reg = <0x0 0x1b00b000 0x0 0x1000>;
	};

	mdpsys_config@1b000000 {
		#clock-cells = <0x1>;
		clock-names = "MDP_IMG_DL_ASYNC0", "MDP_IMG_DL_ASYNC1", "MDP_IMG_DL_RELAY0_ASYNC0", "MDP_IMG_DL_RELAY1_ASYNC1", "MDP_APB_BUS";
		clocks = <0x6f 0x2 0x6f 0x3 0x6f 0x12 0x6f 0x13 0x6f 0x7>;
		compatible = "mediatek,mdpsys_config", "syscon";
		phandle = <0x6f>;
		reg = <0x0 0x1b000000 0x0 0x1000>;
	};

	memory {
		device_type = "memory";
		reg = <0x0 0x40000000 0x0 0x3e605000>;
	};

	memory-ssmr-features {
		2d_fr-size = <0x0 0x0>;
		compatible = "mediatek,memory-ssmr-features";
		iris-recognition-size = <0x0 0x10000000>;
		phandle = <0x131>;
		prot-sharedmem-size = <0x0 0x8000000>;
		sdsp-firmware-size = <0x0 0x1000000>;
		sdsp-tee-sharedmem-size = <0x0 0x1000000>;
		svp-size = <0x0 0x10000000>;
		ta-elf-size = <0x0 0x1000000>;
		ta-stack-heap-size = <0x0 0x6000000>;
		tui-size = <0x0 0x4000000>;
		wfd-size = <0x0 0x4000000>;
	};

	mfb@15010000 {
		compatible = "mediatek,mfb";
		reg = <0x0 0x15010000 0x0 0x1000>;
	};

	mfb@15012000 {
		compatible = "mediatek,mfb";
		reg = <0x0 0x15012000 0x0 0x1000>;
	};

	mfgcfg@13fbf000 {
		#clock-cells = <0x1>;
		compatible = "mediatek,mfgcfg", "mediatek,mt6781-mfgsys", "syscon", "mediatek,g3d_config";
		phandle = <0x68>;
		pwr-regmap = <0x6b>;
		reg = <0x0 0x13fbf000 0x0 0x1000>;
	};

	mipi_rx_ana_csi0@11c10000 {
		compatible = "mediatek,mipi_rx_ana_csi0";
		reg = <0x0 0x11c10000 0x0 0x10000>;
	};

	mipi_tx0@10215000 {
		compatible = "mediatek,mipi_tx0";
		reg = <0x0 0x10215000 0x0 0x1000>;
	};

	mipi_tx0@11c80000 {
		compatible = "mediatek,mipi_tx0";
		reg = <0x0 0x11c80000 0x0 0x10000>;
	};

	mipi_tx_config@11c80000 {
		#clock-cells = <0x0>;
		#phy-cells = <0x0>;
		clock-output-names = "mipi_tx0_pll";
		clocks = <0x20>;
		compatible = "mediatek,mipi_tx_config0", "mediatek,mt6781-mipi-tx";
		phandle = <0x75>;
		reg = <0x0 0x11c80000 0x0 0x1000>;
	};

	mmdvfs_pmqos {
		cam_freq = "cam_step0", "cam_step1", "cam_step2";
		cam_step0 = <0x222 0x1 0x1 0x8>;
		cam_step1 = <0x1a0 0x1 0x1 0x9>;
		cam_step2 = <0x138 0x1 0x1 0xa>;
		clock-names = "TOP_MUX_DISP", "TOP_MUX_CAM", "TOP_MUX_IMG1", "TOP_MUX_IPE", "TOP_MUX_VENC", "TOP_MUX_VDEC", "TOP_MUX_MDP", "TOP_MMPLL_CK", "TOP_MAINPLL_D2", "TOP_UNIVPLL_D3", "TOP_UNIVPLL_D2_D2", "TOP_MAINPLL_D3";
		clocks = <0x21 0x2b 0x21 0x26 0x21 0x27 0x21 0x28 0x21 0x25 0x21 0x2a 0x21 0x2c 0x21 0x6c 0x21 0x35 0x21 0x46 0x21 0x49 0x21 0x36>;
		compatible = "mediatek,mmdvfs";
		disp_freq = "disp_step0", "disp_step1", "disp_step2";
		disp_step0 = <0x230 0x1 0x0 0x7>;
		disp_step0_ext = <0x230 0x2 0x9 0x1589d8>;
		disp_step1 = <0x1c2 0x1 0x0 0x7>;
		disp_step1_ext = <0x1c2 0x2 0x9 0x114ec4>;
		disp_step2 = <0x138 0x1 0x0 0xa>;
		img_freq = "img_step0", "img_step1", "img_step2";
		img_step0 = <0x222 0x1 0x2 0x8>;
		img_step1 = <0x16c 0x1 0x2 0xb>;
		img_step2 = <0x138 0x1 0x2 0xa>;
		ipe_freq = "ipe_step0", "ipe_step1", "ipe_step2";
		ipe_step0 = <0x222 0x1 0x3 0x8>;
		ipe_step1 = <0x16c 0x1 0x3 0xb>;
		ipe_step2 = <0x138 0x1 0x3 0xa>;
		mdp_freq = "mdp_step0", "mdp_step1", "mdp_step2";
		mdp_step0 = <0x230 0x1 0x6 0x7>;
		mdp_step1 = <0x1c2 0x1 0x6 0x7>;
		mdp_step2 = <0x138 0x1 0x6 0xa>;
		phandle = <0x109>;
		vcore-supply = <0x74>;
		vdec_freq = "vdec_step0", "vdec_step1", "vdec_step2";
		vdec_step0 = <0x222 0x1 0x5 0x8>;
		vdec_step1 = <0x1a0 0x1 0x5 0x9>;
		vdec_step2 = <0x138 0x1 0x5 0xa>;
		venc_freq = "venc_step0", "venc_step1", "venc_step2";
		venc_step0 = <0x230 0x1 0x4 0x7>;
		venc_step1 = <0x1c2 0x1 0x4 0x7>;
		venc_step2 = <0x16c 0x1 0x4 0xb>;
		vopp_steps = <0x0 0x1 0x2>;
	};

	mmqos {
		cam_larb = <0xd 0xe 0x10 0x11>;
		comm_freq = <0x0>;
		compatible = "mediatek,mmqos";
		larb0 = <0x8 0x7 0x8 0x8>;
		larb1 = <0x7 0x8 0x8 0x9 0x8>;
		larb11 = <0x7 0x7 0x7 0x7 0x7 0x7 0x8 0x8 0x8 0x8 0x7 0x7 0x8 0x9 0x8 0x6 0x6 0x7 0x7 0x7 0x7 0x7 0x7 0x7 0x8 0x8 0x8 0x8 0x7>;
		larb13 = <0x7 0x8 0x8 0x8 0x8 0x8 0x8 0x8 0x8 0x7 0x8 0x7>;
		larb14 = <0x7 0x8 0x8 0x8 0x7 0x8>;
		larb16 = <0x8 0x8 0x7 0x7 0x8 0x7 0x7 0x7 0x8 0x8 0x8 0x8 0x8 0x8 0x8 0x8 0x7>;
		larb17 = <0x8 0x8 0x7 0x7 0x8 0x7 0x7 0x7 0x8 0x8 0x8 0x8 0x8 0x8 0x8 0x8 0x7>;
		larb19 = <0x7 0x8 0x7 0x8>;
		larb2 = <0x7 0x7 0x8 0x8 0x8>;
		larb20 = <0x7 0x7 0x8 0x8 0x6 0x7>;
		larb4 = <0x6 0x7 0x8 0x7 0x7 0x7 0x7 0x7 0x7 0x6 0x6 0x7 0x8 0x9>;
		larb7 = <0x7 0x8 0x8 0x8 0x7 0x7 0x7 0x7 0x7 0x7 0x7 0x7 0x8>;
		larb9 = <0x7 0x7 0x7 0x7 0x7 0x7 0x8 0x8 0x8 0x8 0x7 0x7 0x8 0x9 0x8 0x6 0x6 0x7 0x7 0x7 0x7 0x7 0x7 0x7 0x8 0x8 0x8 0x8 0x7>;
		larb_groups = <0x0 0x1 0x2 0x4 0x7 0x9 0xb 0xd 0xe 0x10 0x11 0x13 0x14>;
		max_ostd = <0x28>;
		max_ostd_larb = <0x0 0x1>;
		phandle = <0x10a>;
	};

	mobicore {
		compatible = "trustonic,mobicore";
		interrupts = <0x0 0x40 0x1>;
	};

	modem_temp_share@10018000 {
		compatible = "mediatek,modem_temp_share";
		reg = <0x0 0x10018000 0x0 0x1000>;
	};

	mrdump_ext_rst {
		compatible = "mediatek, mrdump_ext_rst-eint";
		mode = "IRQ";
		phandle = <0x137>;
		status = "okay";
	};

	msdc0@11230000 {
		bootable;
		bus-width = <0x8>;
		cap-mmc-highspeed;
		clk_src = [01];
		clock-names = "msdc0-src-hclock", "msdc0-clock", "msdc0-hclock", "msdc0-aes-clock";
		clocks = <0x21 0xd 0x30 0x76 0x30 0x1d 0x30 0x70>;
		compatible = "mediatek,msdc";
		host_function = [00];
		index = [00];
		interrupts = <0x0 0x64 0x4>;
		max-frequency = <0xbebc200>;
		mmc-ddr-1_8v;
		mmc-hs200-1_8v;
		mmc-hs400-1_8v;
		no-sd;
		no-sdio;
		non-removable;
		phandle = <0x100>;
		pinctl = <0x5a>;
		pinctl_hs200 = <0x5c>;
		pinctl_hs400 = <0x5b>;
		reg = <0x0 0x11230000 0x0 0x10000>;
		register_setting = <0x5d>;
		status = "okay";
		vmmc-supply = <0x5e>;
	};

	msdc0_top@11cd0000 {
		compatible = "mediatek,msdc0_top";
		reg = <0x0 0x11cd0000 0x0 0x10000>;
	};

	msdc1@11240000 {
		bus-width = <0x4>;
		cap-mmc-highspeed;
		cap-sd-highspeed;
		cd-gpios = <0x22 0x9 0x0>;
		cd_level = [01];
		clk_src = [02];
		clock-names = "msdc1-clock", "msdc1-hclock";
		clocks = <0x30 0x77 0x30 0x1e>;
		compatible = "mediatek,msdc";
		host_function = [01];
		index = [01];
		interrupts = <0x0 0x65 0x4>;
		max-frequency = <0xbebc200>;
		mmc-ddr-1_8v;
		mmc-hs200-1_8v;
		no-sdio;
		phandle = <0x101>;
		pinctl = <0x5f>;
		pinctl_ddr50 = <0x62>;
		pinctl_hs200 = <0x63>;
		pinctl_sdr104 = <0x60>;
		pinctl_sdr50 = <0x61>;
		reg = <0x0 0x11240000 0x0 0x10000>;
		register_setting = <0x64>;
		sd-uhs-ddr50;
		sd-uhs-sdr104;
		sd-uhs-sdr12;
		sd-uhs-sdr25;
		sd-uhs-sdr50;
		status = "okay";
		vmmc-supply = <0x65>;
		vqmmc-supply = <0x66>;
	};

	msdc1_ins {
		phandle = <0x139>;
	};

	msdc1_top@11c90000 {
		compatible = "mediatek,msdc1_top";
		reg = <0x0 0x11c90000 0x0 0x10000>;
	};

	msf_b@15810000 {
		clock-names = "MFB_CG_IMG2_LARB11", "MFB_CG_IMG2_MSS", "MFB_CG_IMG2_MFB", "MFB_CG_IMG1_GALS";
		clocks = <0x84 0x0 0x84 0x4 0x84 0x2 0x2d 0x5>;
		compatible = "mediatek,msf_b";
		interrupts = <0x0 0xe9 0x4>;
		mboxes = <0x38 0x12 0x0 0x1>;
		msf_frame_done = [00 d6];
		msf_token = [02 9a];
		reg = <0x0 0x15810000 0x0 0x1000>;
	};

	msfdl@15810000 {
		compatible = "mediatek,msfdl";
		interrupts = <0x0 0xe2 0x4>;
		reg = <0x0 0x15810000 0x0 0x1000>;
	};

	mss_b@15812000 {
		compatible = "mediatek,mss_b";
		interrupts = <0x0 0xec 0x4>;
		mboxes = <0x38 0x11 0x0 0x1>;
		mss_frame_done = [00 d8];
		mss_token = [02 99];
		reg = <0x0 0x15812000 0x0 0x1000>;
	};

	mssdl@15812000 {
		compatible = "mediatek,mssdl";
		interrupts = <0x0 0xe5 0x4>;
		reg = <0x0 0x15812000 0x0 0x1000>;
	};

	mt6358_gauge {
		alias_name = "MT6358";
		compatible = "mediatek,mt6358_gauge";
		gauge_name = "gauge";
	};

	mt6366_snd {
		compatible = "mediatek,mt6366-sound";
		mediatek,pwrap-regmap = <0x2f>;
		phandle = <0x56>;
	};

	mt6370_pmu_dts {
		#interrupt-cells = <0x1>;
		interrupt-controller;
		mt6370,intr_gpio = <0x22 0x3 0x0>;
		mt6370,intr_gpio_num = <0x3>;
		phandle = <0x148>;

		bled {
			compatible = "mediatek,mt6370_pmu_bled";
			interrupt-names = "bled_ocp";
			mt,bl_ocp_level = <0x2>;
			mt,bl_ovp_level = <0x3>;
			mt,bled_curr_scale = <0x0>;
			mt,bled_flash_ramp = <0x1>;
			mt,bled_name = "mt6370_pmu_bled";
			mt,bled_ramptime = <0x3>;
			mt,chan_en = <0xf>;
			mt,map_linear;
			mt,max_bled_brightness = <0x200>;
			mt,pwm_avg_cycle = <0x0>;
			mt,pwm_deglitch = <0x1>;
			mt,pwm_fsample = <0x2>;
			mt,pwm_hys = <0x0>;
			mt,pwm_hys_en = <0x1>;
			mt,pwm_lpf_coef = <0x0>;
			mt,use_pwm;
		};

		charger {
			aicr = <0x7a120>;
			charger_name = "primary_chg";
			compatible = "mediatek,mt6370_pmu_charger";
			cv = <0x426030>;
			dc_wdt = <0x3d0900>;
			enable_te;
			enable_wdt;
			fast_unknown_ta_dect;
			ichg = <0x1e8480>;
			ieoc = <0x249f0>;
			interrupt-names = "chg_mivr", "chg_aiclmeasi", "attachi", "ovpctrl_uvp_d_evt", "chg_wdtmri", "chg_vbusov", "chg_tmri", "chg_treg", "dcdti";
			ircmp_resistor = <0x61a8>;
			ircmp_vclamp = <0x7d00>;
			lbp_dt = <0x1>;
			lbp_hys_sel = <0x1>;
			load_switch_name = "primary_load_switch";
			mivr = <0x432380>;
			safety_timer = <0xc>;
		};

		core {
			compatible = "mediatek,mt6370_pmu_core";
			i2cstmr_rst_tmr = <0x0>;
			int_deg = <0x0>;
			int_wdt = <0x0>;
			interrupt-names = "otp", "vdda_ovp", "vdda_uv";
			mrstb_en;
			mrstb_tmr = <0x3>;
		};

		dsv {
			compatible = "mediatek,mt6370_pmu_dsv";
			db_delay = <0x3>;
			db_ext_en = <0x0>;
			db_freq_pm = <0x0>;
			db_periodic_fix = <0x0>;
			db_periodic_mode = <0x0>;
			db_single_pin = <0x0>;
			db_startup = <0x0>;
			db_vbst = <0x1644>;
			db_vneg_20ms = <0x1>;
			db_vneg_disc = <0x0>;
			db_vneg_slew = <0x1>;
			db_vpos_20ms = <0x1>;
			db_vpos_disc = <0x1>;
			db_vpos_slew = <0x1>;
			interrupt-names = "dsv_vneg_ocp", "dsv_vpos_ocp", "dsv_bst_ocp", "dsv_vneg_scp", "dsv_vpos_scp";

			mt6370_dsvn {
				regulator-max-microvolt = <0x5b8d80>;
				regulator-min-microvolt = <0x3d0900>;
				regulator-name = "dsv_neg";
			};

			mt6370_dsvp {
				regulator-max-microvolt = <0x5b8d80>;
				regulator-min-microvolt = <0x3d0900>;
				regulator-name = "dsv_pos";
			};
		};

		ldo {
			compatible = "mediatek,mt6370_pmu_ldo";
			interrupt-names = "ldo_oc";
			ldo_oms = <0x1>;
			ldo_vrc_lt = <0x1>;

			mt6370_ldo {
				regulator-max-microvolt = <0x3d0900>;
				regulator-min-microvolt = <0x186a00>;
				regulator-name = "irtx_ldo";
			};
		};

		mt6370_pmu_fled1 {
			compatible = "mediatek,mt6370_pmu_fled1";
			fled_enable = <0x1>;
			interrupt-names = "fled_lvf", "fled2_short", "fled1_short";
			strobe_cur = <0x124f80>;
			strobe_timeout = <0x960>;
			torch_cur = <0x493e0>;
		};

		mt6370_pmu_fled2 {
			compatible = "mediatek,mt6370_pmu_fled2";
			fled_enable = <0x1>;
			strobe_cur = <0xf4240>;
			strobe_timeout = <0x4b0>;
			torch_cur = <0x30d40>;
		};

		rgbled {
			compatible = "mediatek,mt6370_pmu_rgbled";
			interrupt-names = "isink4_short", "isink3_short", "isink2_short", "isink1_short", "isink4_open", "isink3_open", "isink2_open", "isink1_open";
			mt,led_default_trigger = "cc_mode", "cc_mode", "cc_mode", "none";
			mt,led_name = "mt6370_pmu_led1", "mt6370_pmu_led2", "mt6370_pmu_led3", "mt6370_pmu_led4";
		};
	};

	mt6370_pmu_eint {
		phandle = <0x129>;
	};

	mt6781-afe-pcm@11210000 {
		apmixed = <0x40>;
		clock-names = "aud_afe_clk", "aud_dac_clk", "aud_dac_predis_clk", "aud_adc_clk", "aud_adda6_adc_clk", "aud_apll22m_clk", "aud_apll24m_clk", "aud_apll1_tuner_clk", "aud_apll2_tuner_clk", "aud_tdm_clk", "aud_tml_clk", "aud_nle", "aud_dac_hires_clk", "aud_adc_hires_clk", "aud_adc_hires_tml", "aud_adda6_adc_hires_clk", "aud_3rd_dac_clk", "aud_3rd_dac_predis_clk", "aud_3rd_dac_tml", "aud_3rd_dac_hires_clk", "aud_infra_clk", "mtkaif_26m_clk", "top_mux_audio", "top_mux_audio_int", "top_mainpll_d2_d4", "top_mux_aud_1", "top_apll1_ck", "top_mux_aud_2", "top_apll2_ck", "top_mux_aud_eng1", "top_apll1_d8", "top_mux_aud_eng2", "top_apll2_d8", "top_i2s0_m_sel", "top_i2s1_m_sel", "top_i2s2_m_sel", "top_i2s3_m_sel", "top_i2s4_m_sel", "top_i2s5_m_sel", "top_apll12_div0", "top_apll12_div1", "top_apll12_div2", "top_apll12_div3", "top_apll12_div4", "top_apll12_divb", "top_apll12_div5", "top_mux_audio_h", "top_clk26m_clk";
		clocks = <0x41 0x1 0x41 0x8 0x41 0x9 0x41 0x7 0x41 0x15 0x41 0x2 0x41 0x3 0x41 0x5 0x41 0x4 0x41 0x6 0x41 0xa 0x41 0xb 0x41 0x14 0x41 0x16 0x41 0x17 0x41 0x18 0x41 0x19 0x41 0x1a 0x41 0x1b 0x41 0x1c 0x30 0x30 0x30 0x38 0x21 0x10 0x21 0x11 0x21 0x3a 0x21 0x12 0x21 0x52 0x21 0x13 0x21 0x56 0x21 0x14 0x21 0x55 0x21 0x15 0x21 0x59 0x21 0x76 0x21 0x77 0x21 0x78 0x21 0x79 0x21 0x7a 0x21 0x7b 0x21 0x7c 0x21 0x7d 0x21 0x7e 0x21 0x7f 0x21 0x80 0x21 0x81 0x21 0x82 0x21 0x2d 0x20>;
		compatible = "mediatek,mt6781-sound";
		infracfg_ao = <0x30>;
		interrupts = <0x0 0xa9 0x4>;
		phandle = <0x57>;
		pinctrl-0 = <0x42>;
		pinctrl-1 = <0x43>;
		pinctrl-10 = <0x4c>;
		pinctrl-11 = <0x4d>;
		pinctrl-12 = <0x4e>;
		pinctrl-13 = <0x4f>;
		pinctrl-14 = <0x50>;
		pinctrl-15 = <0x51>;
		pinctrl-16 = <0x52>;
		pinctrl-17 = <0x53>;
		pinctrl-18 = <0x54>;
		pinctrl-19 = <0x55>;
		pinctrl-2 = <0x44>;
		pinctrl-3 = <0x45>;
		pinctrl-4 = <0x46>;
		pinctrl-5 = <0x47>;
		pinctrl-6 = <0x48>;
		pinctrl-7 = <0x49>;
		pinctrl-8 = <0x4a>;
		pinctrl-9 = <0x4b>;
		pinctrl-names = "aud_clk_mosi_off", "aud_clk_mosi_on", "aud_dat_mosi_off", "aud_dat_mosi_on", "aud_dat_miso0_off", "aud_dat_miso0_on", "aud_dat_miso1_off", "aud_dat_miso1_on", "vow_dat_miso_off", "vow_dat_miso_on", "vow_clk_miso_off", "vow_clk_miso_on", "aud_gpio_i2s0_off", "aud_gpio_i2s0_on", "aud_gpio_i2s1_off", "aud_gpio_i2s1_on", "aud_gpio_i2s2_off", "aud_gpio_i2s2_on", "aud_gpio_i2s3_off", "aud_gpio_i2s3_on";
		reg = <0x0 0x11210000 0x0 0x2000>;
		topckgen = <0x21>;
	};

	mt_charger {
		compatible = "mediatek,mt-charger";
		phandle = <0x13f>;
	};

	mt_cpufreq {
		compatible = "mediatek,mt-cpufreq";
		phandle = <0xd6>;
		proc1-supply = <0x34>;
		proc2-supply = <0x35>;
		sram_proc1-supply = <0x36>;
		sram_proc2-supply = <0x37>;
	};

	mt_soc_playback_offload {
		compatible = "mediatek,mt_soc_offload_common";
	};

	mtk-btcvsd-snd@18050000 {
		compatible = "mediatek,mtk-btcvsd-snd";
		disable_write_silence = <0x1>;
		interrupts = <0x0 0x11b 0x4>;
		mediatek,infracfg = <0x30>;
		mediatek,offset = <0xf00 0x800 0x140 0x144 0x148>;
		phandle = <0xff>;
		reg = <0x0 0x18050000 0x0 0x1000 0x0 0x18080000 0x0 0x10000>;
	};

	mtk_lpm {
		#address-cells = <0x2>;
		#size-cells = <0x2>;
		compatible = "mediatek,mtk-lpm";
		constraints = <0x19 0x1a 0x1b>;
		cpupm-method = "mcu";
		irq-remain = <0x10 0x11 0x12 0x13>;
		phandle = <0x9c>;
		ranges;
		resource-ctrl = <0x14 0x15 0x16 0x17 0x18>;
		suspend-method = "s2idle";

		constraint-list {

			rc_bus26m {
				id = <0x0>;
				phandle = <0x19>;
				value = <0x1>;
			};

			rc_dram {
				id = <0x2>;
				phandle = <0x1b>;
				value = <0x1>;
			};

			rc_syspll {
				id = <0x1>;
				phandle = <0x1a>;
				value = <0x1>;
			};
		};

		cpupm-sysram@0011b000 {
			compatible = "mediatek,cpupm-sysram";
			phandle = <0x9d>;
			reg = <0x0 0x11b000 0x0 0x500>;
		};

		irq-remain-list {

			edge_keypad {
				phandle = <0x10>;
				target = <0x1c>;
				value = <0x1 0x0 0x0 0x4>;
			};

			edge_mdwdt {
				phandle = <0x11>;
				target = <0x1d>;
				value = <0x1 0x0 0x0 0x2000000>;
			};

			level_btif_rx {
				phandle = <0x13>;
				target = <0x1e>;
				value = <0x0 0x2 0x0 0x0>;
			};

			level_btif_tx {
				phandle = <0x12>;
				target = <0x1e>;
				value = <0x0 0x1 0x0 0x0>;
			};
		};

		lpm_sysram@0011b500 {
			compatible = "mediatek,lpm-sysram";
			phandle = <0x9f>;
			reg = <0x0 0x11b500 0x0 0x300>;
		};

		mcusys-ctrl@0c53a000 {
			compatible = "mediatek,mcusys-ctrl";
			phandle = <0x9e>;
			reg = <0x0 0xc53a000 0x0 0x1000>;
		};

		resource-ctrl-list {

			bus26m {
				id = <0x0>;
				phandle = <0x14>;
				value = <0x0>;
			};

			dram_s0 {
				id = <0x3>;
				phandle = <0x17>;
				value = <0x0>;
			};

			dram_s1 {
				id = <0x4>;
				phandle = <0x18>;
				value = <0x0>;
			};

			infra {
				id = <0x1>;
				phandle = <0x15>;
				value = <0x0>;
			};

			syspll {
				id = <0x2>;
				phandle = <0x16>;
				value = <0x0>;
			};
		};
	};

	mtkfb@0 {
		compatible = "mediatek,mtkfb";
		phandle = <0x106>;
	};

	nebula {
		#address-cells = <0x2>;
		#size-cells = <0x2>;
		compatible = "android,nebula-smc-v1";
		ranges;
		tee-id = <0x1>;
		tee-name = "nebula";

		nebula-gz-log {
			compatible = "android,nebula-gz-log-v1";
		};

		nebula-irq {
			compatible = "android,nebula-irq-v1";
			ppi-interrupt-parent = <0x1>;
		};

		nebula-virtio {
			compatible = "android,nebula-virtio-v1";
		};
	};

	nfc {
		compatible = "mediatek,nfc-gpio-v2";
		gpio-irq = <0x5>;
		gpio-irq-std = <0x22 0x5 0x0>;
		gpio-rst = <0x1f>;
		gpio-rst-std = <0x22 0x1f 0x0>;
		phandle = <0x133>;
	};

	odm {
		compatible = "simple-bus";
		phandle = <0x12b>;

		rt5133-gpio1 {
			compatible = "regulator-fixed";
			enable-active-high;
			gpio = <0x94 0x0 0x0>;
			phandle = <0x12d>;
			regulator-max-microvolt = <0x1b7740>;
			regulator-min-microvolt = <0x1b7740>;
			regulator-name = "rt5133-gpio1";
			vin-supply = <0x3e>;
		};

		rt5133-gpio2 {
			compatible = "regulator-fixed";
			enable-active-high;
			gpio = <0x94 0x1 0x0>;
			phandle = <0x12e>;
			regulator-max-microvolt = <0x1b7740>;
			regulator-min-microvolt = <0x1b7740>;
			regulator-name = "rt5133-gpio2";
			vin-supply = <0x3e>;
		};

		rt5133-gpio3 {
			compatible = "regulator-fixed";
			enable-active-high;
			gpio = <0x94 0x2 0x0>;
			phandle = <0x12f>;
			regulator-max-microvolt = <0x1b7740>;
			regulator-min-microvolt = <0x1b7740>;
			regulator-name = "rt5133-gpio3";
			vin-supply = <0x3e>;
		};

		rt5133_eint {
			phandle = <0x12c>;
		};
	};

	onewire_gpio {
		compatible = "xiaomi,onewire_gpio";
		label = "xm_onewire";
		mi,onewire-gpio-din-addr = <0x10005200>;
		mi,onewire-gpio-dir-addr = <0x10005000>;
		mi,onewire-gpio-dir-clr-addr = <0x10005008>;
		mi,onewire-gpio-dir-set-addr = <0x10005004>;
		mi,onewire-gpio-dout-addr = <0x10005100>;
		mi,onewire-gpio-dout-clr-addr = <0x10005108>;
		mi,onewire-gpio-dout-set-addr = <0x10005104>;
		phandle = <0x146>;
		pinctrl-0 = <0x95>;
		pinctrl-1 = <0x96>;
		pinctrl-names = "onewire_active", "onewire_sleep";
		status = "ok";
		xiaomi,gpio_number = <0xe>;
		xiaomi,ow_gpio = <0x22 0xe 0x0>;
		xiaomi,version = <0x1>;
	};

	pd_adapter {
		adapter_name = "pd_adapter";
		compatible = "mediatek,pd_adapter";
		mi,non-mtk-pps-ctrl;
		phandle = <0x143>;
	};

	pericfg@10003000 {
		compatible = "mediatek,pericfg", "syscon";
		phandle = <0x67>;
		reg = <0x0 0x10003000 0x0 0x1000>;
	};

	pinctrl {
		#gpio-cells = <0x2>;
		#interrupt-cells = <0x2>;
		compatible = "mediatek,mt6781-pinctrl";
		gpio-controller;
		gpio-ranges = <0x22 0x0 0x0 0xca>;
		interrupt-controller;
		interrupt-parent = <0x1>;
		interrupts = <0x0 0xba 0x4>;
		phandle = <0x22>;
		pins-are-numbered;
		reg_base_eint = <0x2c>;
		reg_bases = <0x23 0x24 0x25 0x26 0x27 0x28 0x29 0x2a 0x2b>;

		aud_clk_mosi_off {
			phandle = <0x42>;

			pins_cmd0_dat {
				bias-pull-down;
				input-enable;
				pinmux = <0xb700>;
			};

			pins_cmd1_dat {
				bias-pull-down;
				input-enable;
				pinmux = <0xb800>;
			};
		};

		aud_clk_mosi_on {
			phandle = <0x43>;

			pins_cmd0_dat {
				bias-disable;
				input-schmitt-enable;
				pinmux = <0xb701>;
			};

			pins_cmd1_dat {
				bias-disable;
				input-schmitt-enable;
				pinmux = <0xb801>;
			};
		};

		aud_dat_miso0_off {
			phandle = <0x46>;

			pins_cmd1_dat {
				bias-pull-down;
				input-enable;
				pinmux = <0xbd00>;
			};
		};

		aud_dat_miso0_on {
			phandle = <0x47>;

			pins_cmd1_dat {
				bias-disable;
				input-schmitt-enable;
				pinmux = <0xbd01>;
			};
		};

		aud_dat_miso1_off {
			phandle = <0x48>;

			pins_cmd2_dat {
				bias-pull-down;
				input-enable;
				pinmux = <0xbe00>;
			};
		};

		aud_dat_miso1_on {
			phandle = <0x49>;

			pins_cmd2_dat {
				bias-disable;
				input-schmitt-enable;
				pinmux = <0xbe01>;
			};
		};

		aud_dat_mosi_off {
			phandle = <0x44>;

			pins_cmd1_dat {
				bias-pull-down;
				input-enable;
				pinmux = <0xb900>;
			};

			pins_cmd2_dat {
				bias-pull-down;
				input-enable;
				pinmux = <0xba00>;
			};
		};

		aud_dat_mosi_on {
			phandle = <0x45>;

			pins_cmd1_dat {
				bias-disable;
				input-schmitt-enable;
				pinmux = <0xb901>;
			};

			pins_cmd2_dat {
				bias-disable;
				input-schmitt-enable;
				pinmux = <0xba01>;
			};
		};

		aud_gpio_i2s0_off {
			phandle = <0x4e>;

			pins_cmd1_dat {
				bias-pull-down;
				input-enable;
				pinmux = <0x3b00>;
			};
		};

		aud_gpio_i2s0_on {
			phandle = <0x4f>;

			pins_cmd1_dat {
				bias-disable;
				input-schmitt-enable;
				pinmux = <0x3b02>;
			};
		};

		aud_gpio_i2s1_off {
			phandle = <0x50>;
		};

		aud_gpio_i2s1_on {
			phandle = <0x51>;
		};

		aud_gpio_i2s2_off {
			phandle = <0x52>;
		};

		aud_gpio_i2s2_on {
			phandle = <0x53>;
		};

		aud_gpio_i2s3_off {
			phandle = <0x54>;

			pins_cmd1_dat {
				bias-pull-down;
				input-enable;
				pinmux = <0x3800>;
			};

			pins_cmd2_dat {
				bias-pull-down;
				input-enable;
				pinmux = <0x3900>;
			};

			pins_cmd3_dat {
				bias-pull-down;
				input-enable;
				pinmux = <0x3a00>;
			};
		};

		aud_gpio_i2s3_on {
			phandle = <0x55>;

			pins_cmd1_dat {
				bias-disable;
				input-schmitt-enable;
				pinmux = <0x3802>;
			};

			pins_cmd2_dat {
				bias-disable;
				input-schmitt-enable;
				pinmux = <0x3902>;
			};

			pins_cmd3_dat {
				bias-disable;
				input-schmitt-enable;
				pinmux = <0x3a02>;
			};
		};

		consys_default {
			phandle = <0x87>;
		};

		gpslna@0 {
			phandle = <0x88>;

			pins_cmd_dat {
				bias-disable;
				output-low;
				pinmux = <0xac00>;
				slew-rate = <0x0>;
			};
		};

		gpslna@1 {
			phandle = <0x89>;

			pins_cmd_dat {
				output-high;
				pinmux = <0xac00>;
				slew-rate = <0x1>;
			};
		};

		gpslna@2 {
			phandle = <0x8a>;

			pins_cmd_dat {
				output-low;
				pinmux = <0xac00>;
				slew-rate = <0x1>;
			};
		};

		haptic_gpio_aw8622_default@gpio171 {
			phandle = <0x97>;

			pins_cmd_dat {
				bias-disable;
				input-schmitt-enable = <0x0>;
				output-low;
				pinmux = <0xab00>;
				slew-rate = <0x1>;
			};
		};

		haptic_gpio_aw8622_set@gpio171 {
			phandle = <0x98>;

			pins_cmd_dat {
				output-high;
				pinmux = <0xab01>;
				slew-rate = <0x1>;
			};
		};

		msdc0@default {
			phandle = <0x5a>;

			pins_clk {
				drive-strength = [04];
			};

			pins_cmd {
				drive-strength = [04];
			};

			pins_dat {
				drive-strength = [04];
			};

			pins_ds {
				drive-strength = [04];
			};

			pins_rst {
				drive-strength = [04];
			};
		};

		msdc0@hs200 {
			phandle = <0x5c>;

			pins_clk {
				drive-strength = [04];
			};

			pins_cmd {
				drive-strength = [04];
			};

			pins_dat {
				drive-strength = [04];
			};

			pins_ds {
				drive-strength = [04];
			};

			pins_rst {
				drive-strength = [04];
			};
		};

		msdc0@hs400 {
			phandle = <0x5b>;

			pins_clk {
				drive-strength = [04];
			};

			pins_cmd {
				drive-strength = [04];
			};

			pins_dat {
				drive-strength = [04];
			};

			pins_ds {
				drive-strength = [04];
			};

			pins_rst {
				drive-strength = [04];
			};
		};

		msdc0@register_default {
			cmd_edge = [00];
			phandle = <0x5d>;
			rdata_edge = [00];
			wdata_edge = [00];
		};

		msdc1@ddr50 {
			phandle = <0x62>;

			pins_clk {
				drive-strength = [03];
			};

			pins_cmd {
				drive-strength = [03];
			};

			pins_dat {
				drive-strength = [03];
			};
		};

		msdc1@default {
			phandle = <0x5f>;

			pins_clk {
				drive-strength = [03];
			};

			pins_cmd {
				drive-strength = [03];
			};

			pins_dat {
				drive-strength = [03];
			};
		};

		msdc1@hs200 {
			phandle = <0x63>;

			pins_clk {
				drive-strength = [03];
			};

			pins_cmd {
				drive-strength = [03];
			};

			pins_dat {
				drive-strength = [03];
			};
		};

		msdc1@register_default {
			cmd_edge = [00];
			phandle = <0x64>;
			rdata_edge = [00];
			wdata_edge = [00];
		};

		msdc1@sdr104 {
			phandle = <0x60>;

			pins_clk {
				drive-strength = [03];
			};

			pins_cmd {
				drive-strength = [03];
			};

			pins_dat {
				drive-strength = [03];
			};
		};

		msdc1@sdr50 {
			phandle = <0x61>;

			pins_clk {
				drive-strength = [03];
			};

			pins_cmd {
				drive-strength = [03];
			};

			pins_dat {
				drive-strength = [03];
			};
		};

		onewire_gpio_active@gpio14 {
			phandle = <0x95>;

			pins_cmd_dat {
				drive-strength = <0x4>;
				output-high;
				pinmux = <0xe00>;
				slew-rate = <0x1>;
			};
		};

		onewire_gpio_sleep@gpio14 {
			phandle = <0x96>;

			pins_cmd_dat {
				drive-strength = <0x4>;
				output-high;
				pinmux = <0xe00>;
				slew-rate = <0x1>;
			};
		};

		vow_clk_miso_off {
			phandle = <0x4c>;

			pins_cmd3_dat {
				bias-pull-down;
				input-enable;
				pinmux = <0xbe00>;
			};
		};

		vow_clk_miso_on {
			phandle = <0x4d>;

			pins_cmd1_dat {
				bias-disable;
				input-schmitt-enable;
				pinmux = <0xbe04>;
			};
		};

		vow_dat_miso_off {
			phandle = <0x4a>;

			pins_cmd1_dat {
				bias-pull-down;
				input-enable;
				pinmux = <0xbd00>;
			};
		};

		vow_dat_miso_on {
			phandle = <0x4b>;

			pins_cmd1_dat {
				bias-disable;
				input-schmitt-enable;
				pinmux = <0xbd04>;
			};
		};
	};

	pmic_clock_buffer_ctrl {
		compatible = "mediatek,pmic_clock_buffer";
		mediatek,clkbuf-config = <0x2 0x1 0x1 0x2 0x0 0x0 0x0>;
		mediatek,clkbuf-driving-current = <0x1 0x1 0x1 0x1 0x1 0x1 0x1>;
		mediatek,clkbuf-quantity = <0x7>;
		phandle = <0x132>;
	};

	pmu {
		compatible = "arm,armv8-pmuv3";
		interrupt-parent = <0x1>;
		interrupts = <0x1 0x7 0x4>;
	};

	psci {
		compatible = "arm,psci-1.0";
		method = "smc";
	};

	pseudo_m4u {
		compatible = "mediatek,mt-pseudo_m4u";
		iommus = <0x6c 0x3>;
	};

	pseudo_m4u-ccu0 {
		compatible = "mediatek,mt-pseudo_m4u-port";
		iommus = <0x6c 0x1a9 0x6c 0x1aa 0x6c 0x2c0>;
		mediatek,larbid = <0x16>;
	};

	pseudo_m4u-ccu1 {
		compatible = "mediatek,mt-pseudo_m4u-port";
		iommus = <0x6c 0x1c4 0x6c 0x1c5 0x6c 0x2e0>;
		mediatek,larbid = <0x17>;
	};

	pseudo_m4u-larb0 {
		compatible = "mediatek,mt-pseudo_m4u-port";
		iommus = <0x6c 0x0 0x6c 0x1 0x6c 0x2 0x6c 0x3>;
		mediatek,larbid = <0x0>;
	};

	pseudo_m4u-larb1 {
		compatible = "mediatek,mt-pseudo_m4u-port";
		iommus = <0x6c 0x20 0x6c 0x21 0x6c 0x22 0x6c 0x23 0x6c 0x24>;
		mediatek,larbid = <0x1>;
	};

	pseudo_m4u-larb11 {
		compatible = "mediatek,mt-pseudo_m4u-port";
		iommus = <0x6c 0x160 0x6c 0x161 0x6c 0x162 0x6c 0x163 0x6c 0x164 0x6c 0x165 0x6c 0x166 0x6c 0x167 0x6c 0x168 0x6c 0x169 0x6c 0x16a 0x6c 0x16b 0x6c 0x16c 0x6c 0x16d 0x6c 0x16e 0x6c 0x16f 0x6c 0x170 0x6c 0x171 0x6c 0x172 0x6c 0x173 0x6c 0x174 0x6c 0x175 0x6c 0x176 0x6c 0x177 0x6c 0x178 0x6c 0x179 0x6c 0x17a 0x6c 0x17b 0x6c 0x17c>;
		mediatek,larbid = <0xb>;
	};

	pseudo_m4u-larb13 {
		compatible = "mediatek,mt-pseudo_m4u-port";
		iommus = <0x6c 0x1a0 0x6c 0x1a1 0x6c 0x1a2 0x6c 0x1a3 0x6c 0x1a4 0x6c 0x1a5 0x6c 0x1a6 0x6c 0x1a7 0x6c 0x1a8 0x6c 0x1a9 0x6c 0x1aa 0x6c 0x1ab>;
		mediatek,larbid = <0xd>;
	};

	pseudo_m4u-larb14 {
		compatible = "mediatek,mt-pseudo_m4u-port";
		iommus = <0x6c 0x1c0 0x6c 0x1c1 0x6c 0x1c2 0x6c 0x1c3 0x6c 0x1c4 0x6c 0x1c5>;
		mediatek,larbid = <0xe>;
	};

	pseudo_m4u-larb16 {
		compatible = "mediatek,mt-pseudo_m4u-port";
		iommus = <0x6c 0x200 0x6c 0x201 0x6c 0x202 0x6c 0x203 0x6c 0x204 0x6c 0x205 0x6c 0x206 0x6c 0x207 0x6c 0x208 0x6c 0x209 0x6c 0x20a 0x6c 0x20b 0x6c 0x20c 0x6c 0x20d 0x6c 0x20e 0x6c 0x20f 0x6c 0x210>;
		mediatek,larbid = <0x10>;
	};

	pseudo_m4u-larb17 {
		compatible = "mediatek,mt-pseudo_m4u-port";
		iommus = <0x6c 0x220 0x6c 0x221 0x6c 0x222 0x6c 0x223 0x6c 0x224 0x6c 0x225 0x6c 0x226 0x6c 0x227 0x6c 0x228 0x6c 0x229 0x6c 0x22a 0x6c 0x22b 0x6c 0x22c 0x6c 0x22d 0x6c 0x22e 0x6c 0x22f 0x6c 0x230>;
		mediatek,larbid = <0x11>;
	};

	pseudo_m4u-larb18 {
		compatible = "mediatek,mt-pseudo_m4u-port";
		iommus = <0x6c 0x240 0x6c 0x241 0x6c 0x242 0x6c 0x243 0x6c 0x244 0x6c 0x245 0x6c 0x246 0x6c 0x247 0x6c 0x248 0x6c 0x249 0x6c 0x24a 0x6c 0x24b 0x6c 0x24c 0x6c 0x24d 0x6c 0x24e 0x6c 0x24f 0x6c 0x250>;
		mediatek,larbid = <0x12>;
	};

	pseudo_m4u-larb19 {
		compatible = "mediatek,mt-pseudo_m4u-port";
		iommus = <0x6c 0x260 0x6c 0x261 0x6c 0x262 0x6c 0x263>;
		mediatek,larbid = <0x13>;
	};

	pseudo_m4u-larb2 {
		compatible = "mediatek,mt-pseudo_m4u-port";
		iommus = <0x6c 0x40 0x6c 0x41 0x6c 0x42 0x6c 0x43 0x6c 0x44>;
		mediatek,larbid = <0x2>;
	};

	pseudo_m4u-larb20 {
		compatible = "mediatek,mt-pseudo_m4u-port";
		iommus = <0x6c 0x280 0x6c 0x281 0x6c 0x282 0x6c 0x283 0x6c 0x284 0x6c 0x285>;
		mediatek,larbid = <0x14>;
	};

	pseudo_m4u-larb4 {
		compatible = "mediatek,mt-pseudo_m4u-port";
		iommus = <0x6c 0x80 0x6c 0x81 0x6c 0x82 0x6c 0x83 0x6c 0x84 0x6c 0x85 0x6c 0x86 0x6c 0x87 0x6c 0x88 0x6c 0x89 0x6c 0x8a 0x6c 0x8b 0x6c 0x8c 0x6c 0x8d>;
		mediatek,larbid = <0x4>;
	};

	pseudo_m4u-larb7 {
		compatible = "mediatek,mt-pseudo_m4u-port";
		iommus = <0x6c 0xe0 0x6c 0xe1 0x6c 0xe2 0x6c 0xe3 0x6c 0xe4 0x6c 0xe5 0x6c 0xe6 0x6c 0xe7 0x6c 0xe8 0x6c 0xe9 0x6c 0xea 0x6c 0xeb 0x6c 0xec>;
		mediatek,larbid = <0x7>;
	};

	pseudo_m4u-larb9 {
		compatible = "mediatek,mt-pseudo_m4u-port";
		iommus = <0x6c 0x120 0x6c 0x121 0x6c 0x122 0x6c 0x123 0x6c 0x124 0x6c 0x125 0x6c 0x126 0x6c 0x127 0x6c 0x128 0x6c 0x129 0x6c 0x12a 0x6c 0x12b 0x6c 0x12c 0x6c 0x12d 0x6c 0x12e 0x6c 0x12f 0x6c 0x130 0x6c 0x131 0x6c 0x132 0x6c 0x133 0x6c 0x134 0x6c 0x135 0x6c 0x136 0x6c 0x137 0x6c 0x138 0x6c 0x139 0x6c 0x13a 0x6c 0x13b 0x6c 0x13c>;
		mediatek,larbid = <0x9>;
	};

	pseudo_m4u-misc {
		compatible = "mediatek,mt-pseudo_m4u-port";
		iommus = <0x6c 0x3>;
		mediatek,larbid = <0x18>;
	};

	pwm@11006000 {
		clock-names = "PWM1-main", "PWM2-main", "PWM3-main", "PWM-HCLK-main", "PWM-main";
		clocks = <0x30 0x10 0x30 0x11 0x30 0x12 0x30 0xf 0x30 0x14>;
		compatible = "mediatek,pwm";
		interrupts = <0x0 0x62 0x4>;
		reg = <0x0 0x11006000 0x0 0x1000>;
	};

	pwmleds {
		compatible = "mediatek,pwm-leds";

		backlight {
			default-state = "on";
			label = "lcd-backlight";
			led-bits = <0x8>;
			max-brightness = <0xff>;
			pwm-names = "lcd-backlight";
			pwms = <0x76 0x0 0x99d9>;
		};
	};

	pwrap@1000d000 {
		clock-names = "spi", "wrap";
		clocks = <0x20 0x20>;
		compatible = "mediatek,mt6781-pwrap";
		interrupts = <0x0 0xc2 0x4>;
		phandle = <0x2f>;
		reg = <0x0 0x1000d000 0x0 0x1000>;
		reg-names = "pwrap";

		mt6358-pmic {
			#interrupt-cells = <0x2>;
			compatible = "mediatek,mt6358-pmic";
			interrupt-controller;
			interrupt-names = "vproc11_oc", "vproc12_oc", "vcore_oc", "vgpu_oc", "vmodem_oc", "vdram1_oc", "vs1_oc", "vs2_oc", "vpa_oc", "vcore_preoc", "vfe28_oc", "vxo22_oc", "vrf18_oc", "vrf12_oc", "vefuse_oc", "vcn33_oc", "vcn28_oc", "vcn18_oc", "vm18_oc", "vmddr_oc", "vsram_core_oc", "va12_oc", "vaux18_oc", "vaud28_oc", "vio28_oc", "vio18_oc", "vsram_proc11_oc", "vsram_proc12_oc", "vsram_others_oc", "vsram_gpu_oc", "vdram2_oc", "vmc_oc", "vmch_oc", "vemc_oc", "vsim1_oc", "vsim2_oc", "vibr_oc", "vusb_oc", "vbif28_oc", "pwrkey", "homekey", "pwrkey_r", "homekey_r", "ni_lbat_int", "chrdet", "chrdet_edge", "vcdt_hv_det", "rtc", "fg_bat0_h", "fg_bat0_l", "fg_cur_h", "fg_cur_l", "fg_zcv", "fg_bat1_h", "fg_bat1_l", "fg_n_charge_l", "fg_iavg_h", "fg_iavg_l", "fg_time_h", "fg_discharge", "fg_charge", "baton_lv", "baton_ht", "baton_bat_in", "baton_bat_out", "bif", "bat_h", "bat_l", "bat2_h", "bat2_l", "bat_temp_h", "bat_temp_l", "auxadc_imp", "nag_c_dltv", "audio", "accdet", "accdet_eint0", "accdet_eint1", "spi_cmd_alert";
			interrupt-parent = <0x22>;
			interrupts = <0x90 0x4 0x90 0x0>;
			mediatek,num-pmic-irqs = <0x91>;
			mediatek,pmic-irqs = <0x0 0x0 0x1 0x0 0x2 0x0 0x3 0x0 0x4 0x0 0x5 0x0 0x6 0x0 0x7 0x0 0x8 0x0 0x9 0x0 0x10 0x1 0x11 0x1 0x12 0x1 0x13 0x1 0x14 0x1 0x15 0x1 0x16 0x1 0x17 0x1 0x18 0x1 0x19 0x1 0x1a 0x1 0x1d 0x1 0x1e 0x1 0x1f 0x1 0x20 0x1 0x21 0x1 0x22 0x1 0x23 0x1 0x24 0x1 0x25 0x1 0x26 0x1 0x27 0x1 0x28 0x1 0x29 0x1 0x2a 0x1 0x2b 0x1 0x2c 0x1 0x2d 0x1 0x2e 0x1 0x30 0x2 0x31 0x2 0x32 0x2 0x33 0x2 0x34 0x2 0x35 0x2 0x36 0x2 0x37 0x2 0x40 0x3 0x50 0x4 0x51 0x4 0x52 0x4 0x53 0x4 0x54 0x4 0x55 0x4 0x56 0x4 0x57 0x4 0x58 0x4 0x59 0x4 0x5a 0x4 0x5b 0x4 0x5c 0x4 0x60 0x4 0x61 0x4 0x62 0x4 0x63 0x4 0x64 0x4 0x70 0x5 0x71 0x5 0x72 0x5 0x73 0x5 0x74 0x5 0x75 0x5 0x76 0x5 0x77 0x5 0x80 0x6 0x85 0x6 0x86 0x6 0x87 0x6 0x90 0x7>;
			phandle = <0xab>;
			status = "okay";

			mt-pmic {
				compatible = "mediatek,mt-pmic";
				interrupt-names = "pwrkey", "pwrkey_r", "homekey", "homekey_r", "bat_h", "bat_l", "fg_cur_h", "fg_cur_l";
				interrupts = <0x30 0x4 0x32 0x4 0x31 0x4 0x33 0x4 0x70 0x4 0x71 0x4 0x52 0x4 0x53 0x4>;
				phandle = <0xad>;
				pmic,init_gpio = <0x22 0xc8 0x0>;
			};

			mt6358_misc {
				base = <0x580>;
				compatible = "mediatek,mt6358-misc";
				dcxo-switch;
				phandle = <0xcd>;
			};

			mt6358_rtc {
				base = <0x580>;
				compatible = "mediatek,mt6358-rtc";
				interrupt-names = "rtc";
				interrupts = <0x40 0x0>;
				phandle = <0xcc>;
			};

			mt6358regulator {
				compatible = "mediatek,mt6358-regulator";
				interrupt-names = "VPROC11", "VPROC12", "VCORE", "VGPU", "VMODEM", "VDRAM1", "VS1", "VS2", "VPA", "VFE28", "VXO22", "VRF18", "VRF12", "VEFUSE", "VCN33_BT", "VCN28", "VCN18", "VM18", "VMDDR", "VSRAM_CORE", "VA12", "VAUX18", "VAUD28", "VIO28", "VIO18", "VSRAM_PROC11", "VSRAM_PROC12", "VSRAM_OTHERS", "VSRAM_GPU", "VDRAM2", "VMC", "VMCH", "VEMC", "VSIM1", "VSIM2", "VIBR", "VUSB", "VBIF28";
				interrupts = <0x0 0x4 0x1 0x4 0x2 0x4 0x3 0x4 0x4 0x4 0x5 0x4 0x6 0x4 0x7 0x4 0x8 0x4 0x10 0x4 0x11 0x4 0x12 0x4 0x13 0x4 0x14 0x4 0x15 0x4 0x16 0x4 0x17 0x4 0x18 0x4 0x19 0x4 0x1a 0x4 0x1d 0x4 0x1e 0x4 0x1f 0x4 0x20 0x4 0x21 0x4 0x22 0x4 0x23 0x4 0x24 0x4 0x25 0x4 0x26 0x4 0x27 0x4 0x28 0x4 0x29 0x4 0x2a 0x4 0x2b 0x4 0x2c 0x4 0x2d 0x4 0x2e 0x4>;
				phandle = <0xaf>;

				buck_vcore {
					phandle = <0x74>;
					regulator-enable-ramp-delay = <0xc8>;
					regulator-max-microvolt = <0x13bdb6>;
					regulator-min-microvolt = <0x7a120>;
					regulator-name = "vcore";
				};

				buck_vdram1 {
					phandle = <0xb0>;
					regulator-enable-ramp-delay = <0x0>;
					regulator-max-microvolt = <0x1fda4c>;
					regulator-min-microvolt = <0x7a120>;
					regulator-name = "vdram1";
				};

				buck_vgpu {
					phandle = <0x69>;
					regulator-enable-ramp-delay = <0xc8>;
					regulator-max-microvolt = <0x13bdb6>;
					regulator-min-microvolt = <0x7a120>;
					regulator-name = "vgpu";
				};

				buck_vmodem {
					phandle = <0xb3>;
					regulator-enable-ramp-delay = <0x384>;
					regulator-max-microvolt = <0x13bdb6>;
					regulator-min-microvolt = <0x7a120>;
					regulator-name = "vmodem";
				};

				buck_vpa {
					phandle = <0xb1>;
					regulator-enable-ramp-delay = <0xfa>;
					regulator-max-microvolt = <0x37b1d0>;
					regulator-min-microvolt = <0x7a120>;
					regulator-name = "vpa";
				};

				buck_vproc11 {
					phandle = <0x34>;
					regulator-enable-ramp-delay = <0xc8>;
					regulator-max-microvolt = <0x13bdb6>;
					regulator-min-microvolt = <0x7a120>;
					regulator-name = "vproc11";
				};

				buck_vproc12 {
					phandle = <0x35>;
					regulator-enable-ramp-delay = <0xc8>;
					regulator-max-microvolt = <0x13bdb6>;
					regulator-min-microvolt = <0x7a120>;
					regulator-name = "vproc12";
				};

				buck_vs1 {
					phandle = <0xb4>;
					regulator-enable-ramp-delay = <0x0>;
					regulator-max-microvolt = <0x277b6c>;
					regulator-min-microvolt = <0xf4240>;
					regulator-name = "vs1";
				};

				buck_vs2 {
					phandle = <0xb2>;
					regulator-enable-ramp-delay = <0x0>;
					regulator-max-microvolt = <0x1fda4c>;
					regulator-min-microvolt = <0x7a120>;
					regulator-name = "vs2";
				};

				ldo_va09 {
					compatible = "regulator-fixed";
					phandle = <0xcb>;
					regulator-boot-on;
					regulator-enable-ramp-delay = <0x108>;
					regulator-max-microvolt = <0xdbba0>;
					regulator-min-microvolt = <0xdbba0>;
					regulator-name = "va09";
				};

				ldo_va12 {
					compatible = "regulator-fixed";
					phandle = <0xc5>;
					regulator-enable-ramp-delay = <0x10e>;
					regulator-max-microvolt = <0x124f80>;
					regulator-min-microvolt = <0x124f80>;
					regulator-name = "va12";
				};

				ldo_vaud28 {
					compatible = "regulator-fixed";
					phandle = <0xc9>;
					regulator-enable-ramp-delay = <0x10e>;
					regulator-max-microvolt = <0x2ab980>;
					regulator-min-microvolt = <0x2ab980>;
					regulator-name = "vaud28";
				};

				ldo_vaux18 {
					compatible = "regulator-fixed";
					phandle = <0xc2>;
					regulator-enable-ramp-delay = <0x10e>;
					regulator-max-microvolt = <0x1b7740>;
					regulator-min-microvolt = <0x1b7740>;
					regulator-name = "vaux18";
				};

				ldo_vbif28 {
					compatible = "regulator-fixed";
					phandle = <0xc3>;
					regulator-enable-ramp-delay = <0x10e>;
					regulator-max-microvolt = <0x2ab980>;
					regulator-min-microvolt = <0x2ab980>;
					regulator-name = "vbif28";
				};

				ldo_vcn18 {
					compatible = "regulator-fixed";
					phandle = <0xbb>;
					regulator-enable-ramp-delay = <0x10e>;
					regulator-max-microvolt = <0x1b7740>;
					regulator-min-microvolt = <0x1b7740>;
					regulator-name = "vcn18";
				};

				ldo_vcn28 {
					compatible = "regulator-fixed";
					phandle = <0xbd>;
					regulator-enable-ramp-delay = <0x10e>;
					regulator-max-microvolt = <0x2ab980>;
					regulator-min-microvolt = <0x2ab980>;
					regulator-name = "vcn28";
				};

				ldo_vcn33_bt {
					phandle = <0xc7>;
					regulator-enable-ramp-delay = <0x10e>;
					regulator-max-microvolt = <0x3567e0>;
					regulator-min-microvolt = <0x325aa0>;
					regulator-name = "vcn33_bt";
				};

				ldo_vcn33_wifi {
					phandle = <0xc8>;
					regulator-enable-ramp-delay = <0x10e>;
					regulator-max-microvolt = <0x3567e0>;
					regulator-min-microvolt = <0x325aa0>;
					regulator-name = "vcn33_wifi";
				};

				ldo_vdram2 {
					phandle = <0xb5>;
					regulator-enable-ramp-delay = <0xce4>;
					regulator-max-microvolt = <0x1b7740>;
					regulator-min-microvolt = <0x927c0>;
					regulator-name = "vdram2";
				};

				ldo_vefuse {
					phandle = <0xc1>;
					regulator-enable-ramp-delay = <0x10e>;
					regulator-max-microvolt = <0x1cfde0>;
					regulator-min-microvolt = <0x19f0a0>;
					regulator-name = "vefuse";
				};

				ldo_vemc {
					phandle = <0x5e>;
					regulator-enable-ramp-delay = <0x3c>;
					regulator-max-microvolt = <0x325aa0>;
					regulator-min-microvolt = <0x2c4020>;
					regulator-name = "vemc";
				};

				ldo_vfe28 {
					compatible = "regulator-fixed";
					phandle = <0xbc>;
					regulator-enable-ramp-delay = <0x10e>;
					regulator-max-microvolt = <0x2ab980>;
					regulator-min-microvolt = <0x2ab980>;
					regulator-name = "vfe28";
				};

				ldo_vibr {
					phandle = <0xb7>;
					regulator-enable-ramp-delay = <0x3c>;
					regulator-max-microvolt = <0x325aa0>;
					regulator-min-microvolt = <0x124f80>;
					regulator-name = "vibr";
				};

				ldo_vio18 {
					compatible = "regulator-fixed";
					phandle = <0xb9>;
					regulator-enable-ramp-delay = <0xa8c>;
					regulator-max-microvolt = <0x1b7740>;
					regulator-min-microvolt = <0x1b7740>;
					regulator-name = "vio18";
				};

				ldo_vio28 {
					compatible = "regulator-fixed";
					phandle = <0xc4>;
					regulator-always-on;
					regulator-boot-no;
					regulator-enable-ramp-delay = <0x10e>;
					regulator-max-microvolt = <0x2ab980>;
					regulator-min-microvolt = <0x2ab980>;
					regulator-name = "vio28";
				};

				ldo_vmc {
					phandle = <0x66>;
					regulator-enable-ramp-delay = <0x3c>;
					regulator-max-microvolt = <0x325aa0>;
					regulator-min-microvolt = <0x1b7740>;
					regulator-name = "vmc";
				};

				ldo_vmch {
					phandle = <0x65>;
					regulator-enable-ramp-delay = <0x3c>;
					regulator-max-microvolt = <0x325aa0>;
					regulator-min-microvolt = <0x2c4020>;
					regulator-name = "vmch";
				};

				ldo_vrf12 {
					compatible = "regulator-fixed";
					phandle = <0xb8>;
					regulator-enable-ramp-delay = <0x78>;
					regulator-max-microvolt = <0x124f80>;
					regulator-min-microvolt = <0x124f80>;
					regulator-name = "vrf12";
				};

				ldo_vrf18 {
					compatible = "regulator-fixed";
					phandle = <0xc6>;
					regulator-enable-ramp-delay = <0x78>;
					regulator-max-microvolt = <0x1b7740>;
					regulator-min-microvolt = <0x1b7740>;
					regulator-name = "vrf18";
				};

				ldo_vsim1 {
					phandle = <0xb6>;
					regulator-enable-ramp-delay = <0x21c>;
					regulator-max-microvolt = <0x2f4d60>;
					regulator-min-microvolt = <0x19f0a0>;
					regulator-name = "vsim1";
				};

				ldo_vsim2 {
					phandle = <0xca>;
					regulator-enable-ramp-delay = <0x21c>;
					regulator-max-microvolt = <0x2f4d60>;
					regulator-min-microvolt = <0x19f0a0>;
					regulator-name = "vsim2";
				};

				ldo_vsram_core {
					phandle = <0xbe>;
					regulator-enable-ramp-delay = <0xf0>;
					regulator-max-microvolt = <0x13bdb6>;
					regulator-min-microvolt = <0x7a120>;
					regulator-name = "vsram_core";
				};

				ldo_vsram_gpu {
					phandle = <0x6a>;
					regulator-enable-ramp-delay = <0xf0>;
					regulator-max-microvolt = <0x13bdb6>;
					regulator-min-microvolt = <0x7a120>;
					regulator-name = "vsram_gpu";
				};

				ldo_vsram_others {
					phandle = <0xbf>;
					regulator-enable-ramp-delay = <0xf0>;
					regulator-max-microvolt = <0x13bdb6>;
					regulator-min-microvolt = <0x7a120>;
					regulator-name = "vsram_others";
				};

				ldo_vsram_proc11 {
					phandle = <0x36>;
					regulator-enable-ramp-delay = <0xf0>;
					regulator-max-microvolt = <0x13bdb6>;
					regulator-min-microvolt = <0x7a120>;
					regulator-name = "vsram_proc11";
				};

				ldo_vsram_proc12 {
					phandle = <0x37>;
					regulator-enable-ramp-delay = <0xf0>;
					regulator-max-microvolt = <0x13bdb6>;
					regulator-min-microvolt = <0x7a120>;
					regulator-name = "vsram_proc12";
				};

				ldo_vusb {
					phandle = <0xba>;
					regulator-enable-ramp-delay = <0x10e>;
					regulator-max-microvolt = <0x2f4d60>;
					regulator-min-microvolt = <0x2dc6c0>;
					regulator-name = "vusb";
				};

				ldo_vxo22 {
					compatible = "regulator-fixed";
					phandle = <0xc0>;
					regulator-enable-ramp-delay = <0x78>;
					regulator-max-microvolt = <0x2191c0>;
					regulator-min-microvolt = <0x2191c0>;
					regulator-name = "vxo22";
				};
			};

			mt635x-auxadc {
				#io-channel-cells = <0x1>;
				cali-efuse-offset = <0x1>;
				compatible = "mediatek,mt6358-auxadc";
				phandle = <0xae>;

				accdet {
					channel = <0x9>;
				};

				bat_temp {
					channel = <0x3>;
					resistance-ratio = <0x2 0x1>;
				};

				batadc {
					avg-num = <0x80>;
					channel = <0x0>;
					resistance-ratio = <0x3 0x1>;
				};

				chip_temp {
					channel = <0x5>;
				};

				dcxo_temp {
					avg-num = <0x10>;
					channel = <0xd>;
				};

				dcxo_volt {
					channel = <0xa>;
					resistance-ratio = <0x3 0x2>;
				};

				hpofs_cal {
					avg-num = <0x100>;
					channel = <0xc>;
				};

				tsx_temp {
					avg-num = <0x80>;
					channel = <0xb>;
				};

				vbif {
					channel = <0xe>;
					resistance-ratio = <0x2 0x1>;
				};

				vcdt {
					channel = <0x2>;
				};

				vcore_temp {
					channel = <0x6>;
				};

				vgpu_temp {
					channel = <0x8>;
				};

				vproc_temp {
					channel = <0x7>;
				};
			};

			pmic-oc-debug {
				compatible = "mediatek,pmic-oc-debug";
				phandle = <0xac>;
			};
		};
	};

	pwrap_md32@10448000 {
		compatible = "mediatek,pwrap_md32";
		reg = <0x0 0x10448000 0x0 0x1000>;
	};

	pwrap_mpu@1000d000 {
		compatible = "mediatek,pwrap_mpu";
		reg = <0x0 0x1000d000 0x0 0x1000>;
	};

	pwrap_p2p@1005cb000 {
		compatible = "mediatek,pwrap_p2p";
		reg = <0x0 0x105cb000 0x0 0x1000>;
	};

	pwraphal@ {
		compatible = "mediatek,pwraph";
		mediatek,pwrap-regmap = <0x2f>;
		phandle = <0xce>;
	};

	qos@0011bb80 {
		compatible = "mediatek,qos-2.0";
		reg = <0x0 0x11bb80 0x0 0x80>;
	};

	radio_md_cfg {
		compatible = "mediatek,radio_md_cfg";
		phandle = <0xd2>;
	};

	reserved-memory {
		#address-cells = <0x2>;
		#size-cells = <0x2>;
		phandle = <0xa0>;
		ranges;

		consys-reserve-memory {
			alignment = <0x0 0x1000000>;
			alloc-ranges = <0x0 0x40000000 0x0 0x80000000>;
			compatible = "mediatek,consys-reserve-memory";
			no-map;
			size = <0x0 0x500000>;
		};

		ion-carveout-heap {
			alignment = <0x0 0x1000>;
			alloc-ranges = <0x0 0x40000000 0x0 0x80000000>;
			compatible = "mediatek,ion-carveout-heap";
			no-map;
			size = <0x0 0xc000>;
		};

		reserve-memory-adsp_share {
			alignment = <0x0 0x1000>;
			alloc-ranges = <0x0 0x40000000 0x0 0x40000000>;
			compatible = "mediatek,reserve-memory-adsp_share";
			no-map;
			size = <0x0 0x1000000>;
		};

		reserve-memory-scp_share {
			alignment = <0x0 0x1000000>;
			alloc-ranges = <0x0 0x50000000 0x0 0x40000000>;
			compatible = "mediatek,reserve-memory-scp_share";
			no-map;
			size = <0x0 0x320000>;
		};

		reserve-memory-sspm_share {
			alignment = <0x0 0x10000>;
			alloc-ranges = <0x0 0x40000000 0x0 0x60000000>;
			compatible = "mediatek,reserve-memory-sspm_share";
			no-map;
			size = <0x0 0x510000>;
			status = "okay";
		};

		soter-shared-mem {
			alignment = <0x0 0x1000000>;
			alloc-ranges = <0x0 0x40000000 0x0 0x50000000>;
			compatible = "microtrust,shared_mem";
			no-map;
			size = <0x0 0x800000>;
		};

		wifi-reserve-memory {
			alignment = <0x0 0x1000000>;
			alloc-ranges = <0x0 0x40000000 0x0 0x80000000>;
			compatible = "shared-dma-pool";
			no-map;
			phandle = <0x3f>;
			size = <0x0 0x600000>;
		};

		zmc-default {
			alignment = <0x0 0x1000000>;
			alloc-ranges = <0x0 0xc0000000 0x4 0x0>;
			compatible = "mediatek,zone_movable_cma";
			size = <0x0 0x2d000000>;
		};
	};

	reserved@1400a000 {
		compatible = "mediatek,reserved";
		reg = <0x0 0x1400a000 0x0 0x1000>;
	};

	reserved@14010000 {
		compatible = "mediatek,reserved";
		reg = <0x0 0x14010000 0x0 0x1000>;
	};

	reserved@14011000 {
		compatible = "mediatek,reserved";
		reg = <0x0 0x14011000 0x0 0x1000>;
	};

	reserved@14015000 {
		compatible = "mediatek,reserved";
		reg = <0x0 0x14015000 0x0 0x1000>;
	};

	reserved@1401d000 {
		compatible = "mediatek,reserved";
		reg = <0x0 0x1401d000 0x0 0x1000>;
	};

	reserved@1401f000 {
		compatible = "mediatek,reserved";
		reg = <0x0 0x1401f000 0x0 0xe1000>;
	};

	reserved@1b004000 {
		compatible = "mediatek,reserved";
		reg = <0x0 0x1b004000 0x0 0x1000>;
	};

	reserved@1b006000 {
		compatible = "mediatek,reserved";
		reg = <0x0 0x1b006000 0x0 0x1000>;
	};

	reserved@1b00d000 {
		compatible = "mediatek,reserved";
		reg = <0x0 0x1b00d000 0x0 0x1000>;
	};

	reserved@1b00e000 {
		compatible = "mediatek,reserved";
		reg = <0x0 0x1b00e000 0x0 0x1000>;
	};

	rsc@1c003000 {
		clock-names = "RSC_CLK_IPE_RSC";
		clocks = <0x73 0x5>;
		compatible = "mediatek,rsc";
		gce-event-names = "rsc_eof";
		gce-events = <0x38 0xa3>;
		interrupts = <0x0 0x153 0x4>;
		mboxes = <0x38 0xd 0x0 0x1>;
		mediatek,larb = <0x82>;
		reg = <0x0 0x1c003000 0x0 0x1000>;
	};

	rt-pd-manager {
		compatible = "mediatek,rt-pd-manager";
	};

	rt1711_type_c_port0 {
		phandle = <0x14a>;
		rt-tcpc,name = "type_c_port0";
		rt-tcpc,notifier_supply_num = <0x3>;
		rt-tcpc,role_def = <0x5>;
		rt-tcpc,rp_level = <0x1>;
		rt-tcpc,vconn_supply = <0x1>;
		rt1711pd,intr_gpio = <0x22 0x6 0x0>;
		rt1711pd,intr_gpio_num = <0x6>;

		displayport {
			1st_connection = "dfp_d";
			2nd_connection = "dfp_d";
			signal,dp_v13;
			typec,receptacle;

			dfp_d {
				pin_assignment,mode_c;
				pin_assignment,mode_d;
				pin_assignment,mode_e;
			};

			ufp_d {
			};
		};

		dpm_caps {
			attemp_discover_cable;
			attemp_discover_id;
			attemp_enter_dp_mode;
			dr_check = <0x0>;
			local_dr_data;
			local_dr_power;
			local_no_suspend;
			local_usb_comm;
			local_vconn_supply;
			pr_check = <0x0>;
		};

		pd-data {
			bat,nr = <0x1>;
			pd,charging_policy = <0x31>;
			pd,country_nr = <0x0>;
			pd,id-vdo-data = <0xd14029cf 0x0 0x17110000 0x41800000 0x0 0x21800000>;
			pd,id-vdo-size = <0x6>;
			pd,mfrs = "RichtekTCPC";
			pd,pid = <0x1711>;
			pd,sink-pdo-data = <0x190c8>;
			pd,sink-pdo-size = <0x1>;
			pd,source-cap-ext = <0x171129cf 0x0 0x0 0x0 0x0 0x2000000>;
			pd,source-pdo-data = <0x19032>;
			pd,source-pdo-size = <0x1>;
			pd,vid = <0x29cf>;

			bat-info0 {
				bat,design_cap = <0xbb8>;
				bat,mfrs = "bat1";
				bat,pid = <0x1711>;
				bat,vid = <0x29cf>;
			};
		};
	};

	scp@10500000 {
		compatible = "mediatek,scp";
		core_1 = "enable";
		interrupts = <0x0 0xcd 0x4>;
		reg = <0x0 0x10500000 0x0 0xc0000 0x0 0x105c0000 0x0 0x3000 0x0 0x105c4000 0x0 0x1000 0x0 0x105d4000 0x0 0x6000>;
		scp_sramSize = <0xc0000>;
		status = "okay";
	};

	scp_dvfs {
		clock-names = "clk_mux", "clk_pll_0", "clk_pll_1", "clk_pll_2", "clk_pll_3", "clk_pll_4", "clk_pll_5";
		clocks = <0x21 0x2 0x20 0x21 0x3a 0x21 0x37 0x21 0x39 0x21 0x36 0x21 0x46>;
		compatible = "mediatek,scp_dvfs";
		vsram_chk_gpio = <0x22 0xc8 0x0>;
	};

	scpsys@10001000 {
		#clock-cells = <0x1>;
		compatible = "mediatek,scpsys";
		phandle = <0x2d>;
		reg = <0x0 0x10001000 0x0 0x1000 0x0 0x10006000 0x0 0x1000 0x0 0x1020e000 0x0 0x1000 0x0 0x10000000 0x0 0x1000 0x0 0x14002000 0x0 0x1000>;
	};

	security_ao@1001a000 {
		compatible = "mediatek,security_ao";
		reg = <0x0 0x1001a000 0x0 0x1000>;
	};

	seninf1@1a004000 {
		compatible = "mediatek,seninf1";
		reg = <0x0 0x1a004000 0x0 0x1000>;
	};

	seninf2@1a005000 {
		compatible = "mediatek,seninf2";
		reg = <0x0 0x1a005000 0x0 0x1000>;
	};

	seninf3@1a006000 {
		compatible = "mediatek,seninf3";
		reg = <0x0 0x1a006000 0x0 0x1000>;
	};

	seninf4@1a007000 {
		compatible = "mediatek,seninf4";
		reg = <0x0 0x1a007000 0x0 0x1000>;
	};

	seninf5@1a008000 {
		compatible = "mediatek,seninf5";
		reg = <0x0 0x1a008000 0x0 0x1000>;
	};

	seninf6@1a009000 {
		compatible = "mediatek,seninf6";
		reg = <0x0 0x1a009000 0x0 0x1000>;
	};

	seninf7@1a00A000 {
		compatible = "mediatek,seninf7";
		reg = <0x0 0x1a00a000 0x0 0x1000>;
	};

	seninf8@1a00B000 {
		compatible = "mediatek,seninf8";
		reg = <0x0 0x1a00b000 0x0 0x1000>;
	};

	seninf_n3d_top@1a004000 {
		clock-names = "SCP_SYS_CAM", "CAMSYS_SENINF_CGPDN", "CAMSYS_CAMTG_CGPDN";
		clocks = <0x2d 0x8 0x2e 0x5 0x2e 0x4>;
		compatible = "mediatek,seninf_n3d_top";
		interrupts = <0x0 0xf8 0x4>;
		phandle = <0xa8>;
		reg = <0x0 0x1a004000 0x0 0x100 0x0 0x1a004100 0x0 0x100 0x0 0x1a004200 0x0 0x100>;
		reg-names = "seninf_top", "seninf_n3d_a", "seninf_n3d_b";
	};

	seninf_top@1a004000 {
		clock-names = "SCP_SYS_CAM", "SCP_SYS_CSI", "CAMSYS_SENINF_CGPDN", "TOP_MUX_SENINF", "TOP_MUX_SENINF1", "TOP_MUX_SENINF2", "TOP_MUX_SENINF3", "TOP_MUX_CAMTG", "TOP_MUX_CAMTG1", "TOP_MUX_CAMTG2", "TOP_MUX_CAMTG3", "TOP_MUX_CAMTG4", "TOP_MUX_CAMTG5", "TOP_MUX_CAMTG6", "TOP_UNIVP_192M_D32", "TOP_UNIVP_192M_D16", "TOP_UNIVPLL_D3_D32", "TOP_UNIVP_192M_D8", "TOP_CLK26M", "TOP_UNIVP_192M_D4", "TOP_UNIVPLL_D3_D8";
		clocks = <0x2d 0x8 0x2d 0x10 0x2e 0x5 0x21 0x1e 0x21 0x1f 0x21 0x20 0x21 0x21 0x21 0x4 0x21 0x5 0x21 0x6 0x21 0x7 0x21 0x8 0x21 0x9 0x21 0xa 0x21 0x6b 0x21 0x6a 0x21 0x89 0x21 0x69 0x20 0x21 0x68 0x21 0x4e>;
		compatible = "mediatek,seninf_top";
		reg = <0x0 0x1a004000 0x0 0x1000>;
	};

	serial@11002000 {
		clock-names = "baud", "bus";
		clocks = <0x20 0x30 0x15>;
		compatible = "mediatek,mt6577-uart";
		dma-names = "tx", "rx";
		dmas = <0x3c 0x0 0x3c 0x1>;
		interrupts = <0x0 0x70 0x4>;
		phandle = <0xdf>;
		reg = <0x0 0x11002000 0x0 0x1000>;
	};

	serial@11003000 {
		clock-names = "baud", "bus";
		clocks = <0x20 0x30 0x16>;
		compatible = "mediatek,mt6577-uart";
		dma-names = "tx", "rx";
		dmas = <0x3c 0x2 0x3c 0x3>;
		interrupts = <0x0 0x71 0x4>;
		phandle = <0xe0>;
		reg = <0x0 0x11003000 0x0 0x1000>;
	};

	simtray {
		compatible = "xiaomi,simtray-status";
		phandle = <0x130>;
		status-gpio = <0x22 0x9 0x0>;
	};

	sleep@10006000 {
		compatible = "mediatek,sleep";
		phandle = <0x6b>;
		reg = <0x0 0x10006000 0x0 0x1000>;
	};

	sleep_reg_md@1000f000 {
		compatible = "mediatek,sleep_reg_md";
		reg = <0x0 0x1000f000 0x0 0x1000>;
	};

	smart_pa {
		phandle = <0x13c>;
	};

	smi_common@14002000 {
		clock-names = "scp-dis", "mm-comm", "mm-gals", "mm-infra", "mm-iommu";
		clocks = <0x2d 0x3 0x39 0x11 0x39 0x16 0x39 0xb 0x39 0x17>;
		compatible = "mediatek,disp_smi_common", "mediatek,smi_common";
		mediatek,smi-cnt = <0x1d>;
		mediatek,smi-id = <0x15>;
		mmsys_config = <0x39>;
		reg = <0x0 0x14002000 0x0 0x1000>;
	};

	smi_larb0@14003000 {
		clock-names = "scp-dis";
		clocks = <0x2d 0x3>;
		compatible = "mediatek,smi_larb0", "mediatek,smi_larb";
		mediatek,larb-id = <0x0>;
		mediatek,smi-id = <0x0>;
		phandle = <0x6e>;
		reg = <0x0 0x14003000 0x0 0x1000>;
	};

	smi_larb10@15030000 {
		clock-names = "scp-isp";
		clocks = <0x2d 0x5>;
		compatible = "mediatek,smi_larb10", "mediatek,smi_larb";
		mediatek,larb-id = <0xa>;
		mediatek,smi-id = <0xa>;
		reg = <0x0 0x15030000 0x0 0x1000>;
	};

	smi_larb11@1582e000 {
		clock-names = "scp-isp2", "img2-larb9";
		clocks = <0x2d 0xb 0x84 0x0>;
		common-reset = <0x1502f000 0x1>;
		compatible = "mediatek,smi_larb11", "mediatek,smi_larb";
		mediatek,larb-id = <0xb>;
		mediatek,smi-id = <0xb>;
		phandle = <0x7b>;
		power-reset = <0x1502000c 0x2 0x1582000c 0x0>;
		reg = <0x0 0x1582e000 0x0 0x1000>;
	};

	smi_larb12@15830000 {
		clock-names = "scp-isp2";
		clocks = <0x2d 0xb>;
		compatible = "mediatek,smi_larb12", "mediatek,smi_larb";
		mediatek,larb-id = <0xc>;
		mediatek,smi-id = <0xc>;
		reg = <0x0 0x15830000 0x0 0x1000>;
	};

	smi_larb13@1a001000 {
		clock-names = "scp-cam", "cam-larb13";
		clocks = <0x2d 0x8 0x2e 0x0>;
		compatible = "mediatek,smi_larb13", "mediatek,smi_larb";
		mediatek,larb-id = <0xd>;
		mediatek,smi-id = <0xd>;
		phandle = <0x7c>;
		reg = <0x0 0x1a001000 0x0 0x1000>;
	};

	smi_larb14@1a002000 {
		clock-names = "scp-cam", "cam-larb14";
		clocks = <0x2d 0x8 0x2e 0x1>;
		compatible = "mediatek,smi_larb14", "mediatek,smi_larb";
		mediatek,larb-id = <0xe>;
		mediatek,smi-id = <0xe>;
		phandle = <0x7d>;
		reg = <0x0 0x1a002000 0x0 0x1000>;
	};

	smi_larb15@1a003000 {
		clock-names = "scp-cam";
		clocks = <0x2d 0x8>;
		compatible = "mediatek,smi_larb15", "mediatek,smi_larb";
		mediatek,larb-id = <0xf>;
		mediatek,smi-id = <0xf>;
		reg = <0x0 0x1a003000 0x0 0x1000>;
	};

	smi_larb16@1a00f000 {
		clock-names = "scp-cam-rawa", "cam-rawa-larbx";
		clocks = <0x2d 0xe 0x71 0x0>;
		common-reset = <0x1a00c000 0x2>;
		compatible = "mediatek,smi_larb16", "mediatek,smi_larb";
		mediatek,larb-id = <0x10>;
		mediatek,smi-id = <0x10>;
		phandle = <0x7e>;
		power-reset = <0x1a04f00c 0x0>;
		reg = <0x0 0x1a00f000 0x0 0x1000>;
	};

	smi_larb17@1a010000 {
		clock-names = "scp-cam-rawb", "cam-rawb-larbx";
		clocks = <0x2d 0xf 0x72 0x0>;
		common-reset = <0x1a00d000 0x3>;
		compatible = "mediatek,smi_larb17", "mediatek,smi_larb";
		mediatek,larb-id = <0x11>;
		mediatek,smi-id = <0x11>;
		phandle = <0x7f>;
		power-reset = <0x1a06f00c 0x0>;
		reg = <0x0 0x1a010000 0x0 0x1000>;
	};

	smi_larb18@1a011000 {
		clock-names = "scp-cam-rawb";
		clocks = <0x2d 0xf>;
		compatible = "mediatek,smi_larb18", "mediatek,smi_larb";
		mediatek,larb-id = <0x12>;
		mediatek,smi-id = <0x12>;
		phandle = <0x80>;
		reg = <0x0 0x1a011000 0x0 0x1000>;
	};

	smi_larb19@1c10f000 {
		clock-names = "scp-ipe", "ipe-larb19";
		clocks = <0x2d 0xd 0x73 0x0>;
		compatible = "mediatek,smi_larb19", "mediatek,smi_larb";
		mediatek,larb-id = <0x13>;
		mediatek,smi-id = <0x13>;
		phandle = <0x81>;
		reg = <0x0 0x1c10f000 0x0 0x1000>;
	};

	smi_larb1@14004000 {
		clock-names = "scp-dis";
		clocks = <0x2d 0x3>;
		compatible = "mediatek,smi_larb1", "mediatek,smi_larb";
		mediatek,larb-id = <0x1>;
		mediatek,smi-id = <0x1>;
		phandle = <0x6d>;
		reg = <0x0 0x14004000 0x0 0x1000>;
	};

	smi_larb20@1c00f000 {
		clock-names = "scp-ipe", "ipe-larb20";
		clocks = <0x2d 0xd 0x73 0x1>;
		compatible = "mediatek,smi_larb20", "mediatek,smi_larb";
		mediatek,larb-id = <0x14>;
		mediatek,smi-id = <0x14>;
		phandle = <0x82>;
		reg = <0x0 0x1c00f000 0x0 0x1000>;
	};

	smi_larb2@1b002000 {
		clock-names = "scp-dis", "mdp-smi";
		clocks = <0x2d 0x3 0x6f 0x6>;
		compatible = "mediatek,smi_larb2", "mediatek,smi_larb";
		mediatek,larb-id = <0x2>;
		mediatek,smi-id = <0x2>;
		phandle = <0x77>;
		reg = <0x0 0x1b002000 0x0 0x1000>;
	};

	smi_larb3@1f00f000 {
		clock-names = "scp-dis";
		clocks = <0x2d 0x3>;
		compatible = "mediatek,smi_larb3", "mediatek,smi_larb";
		mediatek,larb-id = <0x3>;
		mediatek,smi-id = <0x3>;
		reg = <0x0 0x1f00f000 0x0 0x1000>;
	};

	smi_larb4@1602e000 {
		clock-names = "scp-vdec", "vdec-larb";
		clocks = <0x2d 0xc 0x70 0x1>;
		compatible = "mediatek,smi_larb4", "mediatek,smi_larb";
		mediatek,larb-id = <0x4>;
		mediatek,smi-id = <0x4>;
		phandle = <0x78>;
		reg = <0x0 0x1602e000 0x0 0x1000>;
	};

	smi_larb5@16030000 {
		clock-names = "scp-vdec";
		clocks = <0x2d 0xc>;
		compatible = "mediatek,smi_larb5", "mediatek,smi_larb";
		mediatek,larb-id = <0x5>;
		mediatek,smi-id = <0x5>;
		reg = <0x0 0x16030000 0x0 0x1000>;
	};

	smi_larb6@16031000 {
		clock-names = "scp-vdec";
		clocks = <0x2d 0xc>;
		compatible = "mediatek,smi_larb6", "mediatek,smi_larb";
		mediatek,larb-id = <0x6>;
		mediatek,smi-id = <0x6>;
		reg = <0x0 0x16031000 0x0 0x1000>;
	};

	smi_larb7@17010000 {
		clock-names = "scp-venc", "venc-set1", "venc-set2";
		clocks = <0x2d 0x6 0x86 0x2 0x86 0x3>;
		compatible = "mediatek,smi_larb7", "mediatek,smi_larb";
		mediatek,larb-id = <0x7>;
		mediatek,smi-id = <0x7>;
		phandle = <0x79>;
		reg = <0x0 0x17010000 0x0 0x1000>;
	};

	smi_larb8@17011000 {
		clock-names = "scp-venc";
		clocks = <0x2d 0x6>;
		compatible = "mediatek,smi_larb8", "mediatek,smi_larb";
		mediatek,larb-id = <0x8>;
		mediatek,smi-id = <0x8>;
		reg = <0x0 0x17011000 0x0 0x1000>;
	};

	smi_larb9@1502e000 {
		clock-names = "scp-isp", "img1-larb9";
		clocks = <0x2d 0x5 0x83 0x0>;
		compatible = "mediatek,smi_larb9", "mediatek,smi_larb";
		mediatek,larb-id = <0x9>;
		mediatek,smi-id = <0x9>;
		phandle = <0x7a>;
		reg = <0x0 0x1502e000 0x0 0x1000>;
	};

	snd_audio_dsp {
		compatible = "mediatek,snd_audio_dsp";
		mtk_dsp_a2dp = <0x0 0xffffffff 0xffffffff 0xffffffff 0x40000>;
		mtk_dsp_call_final = <0x5 0x0 0xf 0x13 0x18000>;
		mtk_dsp_capture1 = <0x0 0xffffffff 0xc 0x12 0x20000>;
		mtk_dsp_capture_raw = <0x0 0xffffffff 0xffffffff 0xffffffff 0x20000>;
		mtk_dsp_dataprovider = <0x0 0xffffffff 0xf 0xffffffff 0x30000>;
		mtk_dsp_deep = <0x5 0xffffffff 0xffffffff 0xffffffff 0x30000>;
		mtk_dsp_fast = <0x5 0xffffffff 0xffffffff 0xffffffff 0x5000>;
		mtk_dsp_fm = <0x1 0xffffffff 0xf 0xffffffff 0x10000>;
		mtk_dsp_ktv = <0x1 0x8 0x11 0xffffffff 0x10000>;
		mtk_dsp_mem_afe = <0x1 0x40000>;
		mtk_dsp_music = <0x1 0xffffffff 0xffffffff 0xffffffff 0x0>;
		mtk_dsp_offload = <0x0 0xffffffff 0xffffffff 0xffffffff 0x400000>;
		mtk_dsp_playback = <0x1 0x4 0xffffffff 0x13 0x30000>;
		mtk_dsp_primary = <0x5 0xffffffff 0xffffffff 0xffffffff 0x30000>;
		mtk_dsp_ver = <0x1>;
		mtk_dsp_voip = <0x5 0xffffffff 0xffffffff 0xffffffff 0x30000>;
		phandle = <0x58>;
		swdsp_smartpa_process_enable = <0x5>;
	};

	snd_scp_ultra {
		compatible = "mediatek,snd_scp_ultra";
		phandle = <0xfe>;
		scp_ultra_dl_memif_id = <0x7>;
		scp_ultra_ul_memif_id = <0xe>;
	};

	sound {
		compatible = "mediatek,mt6781-mt6366-sound";
		mediatek,audio-codec = <0x56>;
		mediatek,platform = <0x57>;
		mediatek,snd_audio_dsp = <0x58>;
		mtk_spk_i2s_in = <0x0>;
		mtk_spk_i2s_out = <0x3>;
		phandle = <0xfd>;

		mediatek,speaker-codec {
			sound-dai = <0x59>;
		};
	};

	spi0@1100a000 {
		clock-names = "parent-clk", "sel-clk", "spi-clk";
		clocks = <0x21 0x37 0x21 0xc 0x30 0x1c>;
		compatible = "mediatek,mt6765-spi";
		interrupts = <0x0 0x8a 0x4>;
		mediatek,pad-select = <0x0>;
		phandle = <0xf3>;
		reg = <0x0 0x1100a000 0x0 0x1000>;
	};

	spi1@11010000 {
		clock-names = "parent-clk", "sel-clk", "spi-clk";
		clocks = <0x21 0x37 0x21 0xc 0x30 0x39>;
		compatible = "mediatek,mt6765-spi";
		interrupts = <0x0 0x8b 0x4>;
		mediatek,pad-select = <0x0>;
		phandle = <0xf8>;
		reg = <0x0 0x11010000 0x0 0x1000>;
	};

	spi2@11012000 {
		clock-names = "parent-clk", "sel-clk", "spi-clk";
		clocks = <0x21 0x37 0x21 0xc 0x30 0x3c>;
		compatible = "mediatek,mt6765-spi";
		interrupts = <0x0 0x91 0x4>;
		mediatek,pad-select = <0x0>;
		phandle = <0xf9>;
		reg = <0x0 0x11012000 0x0 0x1000>;
	};

	spi3@11013000 {
		clock-names = "parent-clk", "sel-clk", "spi-clk";
		clocks = <0x21 0x37 0x21 0xc 0x30 0x3d>;
		compatible = "mediatek,mt6765-spi";
		interrupts = <0x0 0x92 0x4>;
		mediatek,pad-select = <0x0>;
		phandle = <0xfa>;
		reg = <0x0 0x11013000 0x0 0x1000>;
	};

	spi4@11014000 {
		clock-names = "parent-clk", "sel-clk", "spi-clk";
		clocks = <0x21 0x37 0x21 0xc 0x30 0x4c>;
		compatible = "mediatek,mt6765-spi";
		interrupts = <0x0 0x74 0x4>;
		mediatek,pad-select = <0x0>;
		phandle = <0xfb>;
		reg = <0x0 0x11014000 0x0 0x1000>;
	};

	spi5@11015000 {
		clock-names = "parent-clk", "sel-clk", "spi-clk";
		clocks = <0x21 0x37 0x21 0xc 0x30 0x4d>;
		compatible = "mediatek,mt6765-spi";
		interrupts = <0x0 0x75 0x4>;
		mediatek,pad-select = <0x1>;
		phandle = <0xfc>;
		reg = <0x0 0x11015000 0x0 0x1000>;
	};

	spmtwam@10006000 {
		compatible = "mediatek,spmtwam";
		interrupts = <0x0 0xc3 0x4>;
		phandle = <0xa9>;
		reg = <0x0 0x10006000 0x0 0x1000>;
		spm_irq_mask = <0xb4>;
		spm_irq_sta = <0x128>;
		spm_twam_con = <0x970>;
		spm_twam_idle_sel = <0x978>;
		spm_twam_last_sta0 = <0x1d0>;
		spm_twam_last_sta1 = <0x1d4>;
		spm_twam_last_sta2 = <0x1d8>;
		spm_twam_last_sta3 = <0x1dc>;
		spm_twam_window_len = <0x974>;
	};

	sramrom@10214000 {
		compatible = "mediatek,sramrom";
		reg = <0x0 0x10214000 0x0 0x1000>;
	};

	sspm@10400000 {
		compatible = "mediatek,sspm";
		interrupt-names = "ipc", "mbox0", "mbox1", "mbox2", "mbox3", "mbox4";
		interrupts = <0x0 0xd7 0x4 0x0 0xda 0x4 0x0 0xdb 0x4 0x0 0xdc 0x4 0x0 0xdd 0x4 0x0 0xde 0x4>;
		reg = <0x0 0x10400000 0x0 0x28000 0x0 0x10440000 0x0 0x10000 0x0 0x10450000 0x0 0x100 0x0 0x10451000 0x0 0x4 0x0 0x10451004 0x0 0x4 0x0 0x10460000 0x0 0x100 0x0 0x10461000 0x0 0x4 0x0 0x10461004 0x0 0x4 0x0 0x10470000 0x0 0x100 0x0 0x10471000 0x0 0x4 0x0 0x10471004 0x0 0x4 0x0 0x10480000 0x0 0x100 0x0 0x10481000 0x0 0x4 0x0 0x10481004 0x0 0x4 0x0 0x10490000 0x0 0x100 0x0 0x10491000 0x0 0x4 0x0 0x10491004 0x0 0x4>;
		reg-names = "sspm_base", "cfgreg", "mbox0_base", "mbox0_set", "mbox0_clr", "mbox1_base", "mbox1_set", "mbox1_clr", "mbox2_base", "mbox2_set", "mbox2_clr", "mbox3_base", "mbox3_set", "mbox3_clr", "mbox4_base", "mbox4_set", "mbox4_clr";
	};

	swtp {
		compatible = "mediatek, swtp-eint";
		phandle = <0xdb>;
	};

	sys_cirq@10204000 {
		compatible = "mediatek,sys_cirq";
		reg = <0x0 0x10204000 0x0 0x1000>;
	};

	sys_timer@10017000 {
		clocks = <0x31>;
		compatible = "mediatek,sys_timer";
		interrupts = <0x0 0xcf 0x4>;
		reg = <0x0 0x10017000 0x0 0x1000>;
		reg-names = "sys_timer_base";
	};

	syson@14000000 {
		#clock-cells = <0x1>;
		compatible = "mediatek,mmsys_config", "mediatek,mt6781-mmsys_config", "syscon";
		phandle = <0x39>;
		pwr-regmap = <0x6b>;
		reg = <0x0 0x14000000 0x0 0x1000>;
	};

	therm_ctrl@1100b000 {
		clock-names = "therm-main";
		clocks = <0x30 0xa>;
		compatible = "mediatek,therm_ctrl";
		interrupts = <0x0 0x63 0x4>;
		reg = <0x0 0x1100b000 0x0 0x1000>;
	};

	thermal-message {
		phandle = <0x140>;
	};

	thermal-sensor1 {
		compatible = "mediatek,mtboard-thermistor1";
		io-channel-names = "thermistor-ch0";
		io-channels = <0x3b 0x0>;
		phandle = <0xf4>;
	};

	thermal-sensor2 {
		compatible = "mediatek,mtboard-thermistor2";
		io-channel-names = "thermistor-ch1";
		io-channels = <0x3b 0x1>;
		phandle = <0xf5>;
	};

	timer {
		clock-frequency = <0xc65d40>;
		compatible = "arm,armv8-timer";
		interrupt-parent = <0x1>;
		interrupts = <0x1 0xd 0x4 0x1 0xe 0x4 0x1 0xb 0x4 0x1 0xa 0x4>;
		phandle = <0xd3>;
	};

	topckgen@10000000 {
		#clock-cells = <0x1>;
		compatible = "mediatek,topckgen", "syscon";
		phandle = <0x21>;
		reg = <0x0 0x10000000 0x0 0x1000>;
	};

	topckgen_ao@1001b000 {
		compatible = "mediatek,topckgen_ao";
		reg = <0x0 0x1001b000 0x0 0x1000>;
	};

	topmisc@10011000 {
		compatible = "mediatek,topmisc";
		reg = <0x0 0x10011000 0x0 0x1000>;
	};

	toprgu@10007000 {
		compatible = "mediatek,toprgu";
		phandle = <0xaa>;
		reg = <0x0 0x10007000 0x0 0x1000>;
	};

	touch {
		compatible = "goodix,touch", "mediatek,touch";
		phandle = <0x13a>;
	};

	trusty {
		#address-cells = <0x2>;
		#size-cells = <0x2>;
		compatible = "android,trusty-smc-v1";
		ranges;
		tee-id = <0x0>;
		tee-name = "trusty";

		gz-main {
			compatible = "mediatek,trusty-gz";
		};

		mtee {
			compatible = "mediatek,trusty-mtee-v1";
		};

		trusty-gz-log {
			compatible = "android,trusty-gz-log-v1";
		};

		trusty-irq {
			compatible = "android,trusty-irq-v1";
			ppi-interrupt-parent = <0x1>;
		};

		trusty-virtio {
			compatible = "android,trusty-virtio-v1";
		};
	};

	type_c_port0 {
		mt-tcpc,name = "type_c_port0";
		mt-tcpc,notifier_supply_num = <0x3>;
		mt-tcpc,role_def = <0x5>;
		mt-tcpc,rp_level = <0x1>;
		mt-tcpc,vconn_supply = <0x1>;
		mt6370pd,intr_gpio = <0x22 0x18 0x0>;
		mt6370pd,intr_gpio_num = <0x18>;
		phandle = <0x149>;

		displayport {
			1st_connection = "dfp_d";
			2nd_connection = "dfp_d";
			signal,dp_v13;
			typec,receptacle;

			dfp_d {
				pin_assignment,mode_c;
				pin_assignment,mode_d;
				pin_assignment,mode_e;
			};

			ufp_d {
			};
		};

		dpm_caps {
			attemp_discover_cable;
			attemp_discover_id;
			attemp_enter_dp_mode;
			dr_check = <0x0>;
			local_dr_data;
			local_dr_power;
			local_no_suspend;
			local_usb_comm;
			local_vconn_supply;
			pr_check = <0x0>;
		};

		pd-data {
			bat,nr = <0x1>;
			pd,charging_policy = <0x31>;
			pd,country_nr = <0x0>;
			pd,id-vdo-data = <0xd14029cf 0x0 0x50810000 0x41800000 0x0 0x21800000>;
			pd,id-vdo-size = <0x6>;
			pd,mfrs = "RichtekTCPC";
			pd,pid = <0x5081>;
			pd,sink-pdo-data = <0x190c8>;
			pd,sink-pdo-size = <0x1>;
			pd,source-cap-ext = <0x508129cf 0x0 0x0 0x0 0x0 0x7000000>;
			pd,source-pdo-data = <0x19096>;
			pd,source-pdo-size = <0x1>;
			pd,vid = <0x29cf>;

			bat-info0 {
				bat,design_cap = <0xbb8>;
				bat,mfrs = "bat1";
				bat,pid = <0x5081>;
				bat,vid = <0x29cf>;
			};
		};
	};

	udi@10005000 {
		compatible = "mediatek,udi";
		ecc_debug = <0x1>;
		phandle = <0xa5>;
		reg = <0x0 0x10005000 0x0 0x1000>;
		udi_offset1 = <0x3a0>;
		udi_offset2 = <0x3b0>;
		udi_value1 = <0x44400000>;
		udi_value2 = <0x44>;
	};

	ufs_mphy@11cc0000 {
		compatible = "mediatek,ufs_mphy";
		reg = <0x0 0x11cc0000 0x0 0xc000>;
	};

	ufshci@11270000 {
		clock-names = "ufs0-clock", "ufs0-unipro-clk", "ufs0-mp-clk", "ufs0-aes-clk";
		clocks = <0x30 0x4f 0x30 0x3e 0x30 0x40 0x30 0x75>;
		compatible = "mediatek,ufshci";
		freq-table-hz = <0x0 0x0 0x0 0x0 0x0 0x0 0x0 0x0>;
		interrupts = <0x0 0x121 0x4>;
		lanes-per-direction = <0x1>;
		mediatek,auto-hibern8-timer = <0xa>;
		mediatek,rpm-autosuspend-delay = <0x7d0>;
		mediatek,rpm-enable = <0x1>;
		mediatek,rpm-level = <0x3>;
		mediatek,spm-level = <0x3>;
		phandle = <0x102>;
		reg = <0x0 0x11270000 0x0 0x2300>;
		vcc-fixed-regulator;
		vcc-supply = <0x5e>;
	};

	usb0@11200000 {
		clock-names = "usb0", "usb0_clk_top_sel", "usb0_clk_univpll5_d2";
		clocks = <0x30 0x8 0x21 0x19 0x21 0x4f>;
		compatible = "mediatek,mt6781-usb20";
		interrupts = <0x0 0x61 0x4>;
		mode = <0x2>;
		multipoint = <0x1>;
		num_eps = <0x10>;
		pericfg = <0x67>;
		reg = <0x0 0x11200000 0x0 0x10000 0x0 0x11ca0000 0x0 0x10000>;
	};

	usb1p@11200000 {
		compatible = "mediatek,usb1p";
		reg = <0x0 0x11200000 0x0 0x10000>;
	};

	usb_phy@11ca0000 {
		compatible = "mediatek,usb_phy";
		reg = <0x0 0x11ca0000 0x0 0x10000>;
	};

	usbpd_pm {
		phandle = <0x145>;
	};

	utos {
		compatible = "microtrust,utos";
		interrupts = <0x0 0x58 0x1 0x0 0x59 0x1>;
	};

	utos_tester {
		compatible = "microtrust,tester-v1";
	};

	vcu@16000000 {
		compatible = "mediatek-vcu";
		gce-event-names = "venc_eof", "venc_cmdq_pause_done", "venc_mb_done", "venc_sps_done", "venc_pps_done", "venc_128B_cnt_done", "vdec_pic_start", "vdec_decode_done", "vdec_pause", "vdec_dec_error", "vdec_mc_busy_overflow_timeout", "vdec_all_dram_req_done", "vdec_ini_fetch_rdy", "vdec_process_flag", "vdec_search_start_code_done", "vdec_ref_reorder_done", "vdec_wp_tble_done", "vdec_count_sram_clr_done", "vdec_gce_cnt_op_threshold";
		gce-events = <0x38 0x81 0x38 0x82 0x38 0x84 0x38 0x89 0x38 0x88 0x38 0x85 0x38 0x0 0x38 0x1 0x38 0x2 0x38 0x3 0x38 0x4 0x38 0x5 0x38 0x6 0x38 0x7 0x38 0x8 0x38 0x9 0x38 0xa 0x38 0xb 0x38 0xf>;
		gce-gpr = <0xa 0xb>;
		iommus = <0x6c 0x80>;
		mboxes = <0x38 0x7 0x0 0x1 0x38 0xc 0x0 0x1 0x3a 0xc 0x0 0x1>;
		mediatek,dec_gce_th_num = <0x1>;
		mediatek,enc_gce_th_num = <0x1>;
		mediatek,mailbox-gce = <0x38>;
		mediatek,vcuid = <0x0>;
		mediatek,vcuname = "vcu";
		phandle = <0x85>;
		reg = <0x0 0x16000000 0x0 0x40000 0x0 0x17020000 0x0 0x10000 0x0 0x17820000 0x0 0x10000>;
	};

	vdec@16000000 {
		clock-names = "MT_CG_VDEC";
		clocks = <0x70 0x1>;
		compatible = "mediatek,mt6781-vcodec-dec";
		interrupts = <0x0 0x157 0x4>;
		iommus = <0x6c 0x80>;
		mediatek,larb = <0x78>;
		mediatek,vcu = <0x85>;
		reg = <0x0 0x1602f000 0x0 0x1000 0x0 0x16029800 0x0 0x400 0x0 0x16020000 0x0 0x400 0x0 0x16021000 0x0 0x1000 0x0 0x16023000 0x0 0x1000 0x0 0x16025000 0x0 0x1000>;
	};

	vdec_fmt@16080000 {
		clock-names = "MT_CG_VDEC";
		clocks = <0x70 0x1>;
		compatible = "mediatek-vdec-fmt";
		gce-gpr = <0xa>;
		mboxes = <0x38 0x17 0x0 0x1>;
		mediatek,fmt_gce_th_num = <0x1>;
		mediatek,fmtname = "vdec-fmt";
		phandle = <0x11f>;
		rdma0_sw_rst_done_eng = [00 10];
		rdma0_tile_done = [00 11];
		reg = <0x0 0x16080000 0x0 0x1000 0x0 0x16081000 0x0 0x1000 0x0 0x1602f000 0x0 0x10000>;
		wdma0_sw_rst_done_eng = [00 12];
		wdma0_tile_done = [00 13];
	};

	vdec_gcon@16010000 {
		compatible = "mediatek,vdec_gcon";
		phandle = <0x120>;
		reg = <0x0 0x16010000 0x0 0x8000>;
	};

	vdec_gcon@16018000 {
		compatible = "mediatek,vdec_gcon";
		reg = <0x0 0x16018000 0x0 0x8000>;
	};

	vdec_gcon@1602f000 {
		#clock-cells = <0x1>;
		compatible = "mediatek,vdec_gcon", "mediatek,mt6833-vdec_gcon", "syscon";
		phandle = <0x70>;
		pwr-regmap = <0x6b>;
		reg = <0x0 0x1602f000 0x0 0x1000>;
	};

	venc@17000000 {
		clock-names = "MT_CG_VENC";
		clocks = <0x86 0x2>;
		compatible = "mediatek,mt6781-vcodec-enc";
		interrupts = <0x0 0xf3 0x4>;
		iommus = <0x6c 0xe4>;
		mediatek,larb = <0x79>;
		mediatek,vcu = <0x85>;
		reg = <0x0 0x17020000 0x0 0x2000>;
	};

	venc@17020000 {
		compatible = "mediatek,venc";
		interrupts = <0x0 0xf3 0x4>;
		reg = <0x0 0x17020000 0x0 0x10000>;
	};

	venc_gcon@17000000 {
		#clock-cells = <0x1>;
		compatible = "mediatek,venc_gcon", "mediatek,mt6833-venc_gcon", "syscon";
		phandle = <0x86>;
		pwr-regmap = <0x6b>;
		reg = <0x0 0x17000000 0x0 0x10000>;
	};

	wifi@18000000 {
		compatible = "mediatek,wifi";
		interrupts = <0x0 0x11d 0x4>;
		memory-region = <0x3f>;
		reg = <0x0 0x18000000 0x0 0x100000>;
	};

	wpe_a@15011000 {
		compatible = "mediatek,wpe_a";
		reg = <0x0 0x15011000 0x0 0x1000>;
	};

	wpe_b@15811000 {
		compatible = "mediatek,wpe_b";
		reg = <0x0 0x15811000 0x0 0x1000>;
	};

	xiaomi_touch {
		phandle = <0x13b>;
	};
};
